# STM32H745xG register map
File version: 1.0
Registers are 32-bit, access not given, reset 0x0 unless marked. A register's access mark holds for its fields unless they carry their own. Offsets are from the block's base; [hi:lo] are bit positions; {n}, {i} and the like mark numbered series.

## PWR
Base 0x58024800
0x00 CR1
  [26] USB33RDY, [2n+15:2n+14] WKUPPUPD{n} (n=1..6), [25] USBREGEN, [24] USB33DEN, [23] TEMPH, [22] TEMPL, [21] VBATH, [20] VBATL, [18] ALS_LEV2, [18:17] ALS_LEV3, [16] AVDEN, [16] AVDO, [16] BRRDY, [16] SMPSEXTRDY, [15:14] SVOS, [15:14] ACTVOS, [15:14] VOS, [13] ACTVOSRDY, [13] VOSRDY, [n+7] WKUPP{n} (n=1..6), [11] RUN_D3, [11] RUN_D3, [10] HOLD2, [10] HOLD1, [9] FLPS, [9] VBRS, [9] CSSF, [9] CSSF, [8] DBP, [8] VBE, [8] SBF_D2, [8] SBF_D2, [7] PLS_LEV4, [7] SBF_D1, [7] SBF_D1, [7:6] PLS_LEV6, [6] SBF, [6] SBF, [7:5] PLS_LEV7, [5] STOPF, [5] STOPF, [n-1] WKUPC{n} (n=1..6), [n-1] WKUPF{n} (n=1..6), [n-1] WKUPEN{n} (n=1..6), [4] PVDEN, [4] PVDO, [4] MONEN, [5:4] SMPSLEVEL, [4] HOLD2F, [4] HOLD1F, [3] SMPSEXTHP, [2] SMPSEN, [2] PDDS_D3, [2] PDDS_D3, [1] LDOEN, [1] PDDS_D2, [1] PDDS_D2, [0] LPDS, [0] BREN, [0] BYPASS, [0] PDDS_D1, [0] PDDS_D1
0x04 CSR1
0x08 CR2
0x0C CR3
0x10 CPUCR
0x14 CPU2CR
0x18 D3CR
0x20 WKUPCR
0x24 WKUPFR
0x28 WKUPEPR

## CRC
Base 0x58024C00
0x00 DR
  [7] REV_OUT, [6:5] REV_IN, [4:3] POLYSIZE, [31:0] DR, [31:0] IDR, [0] RESET, [31:0] INIT, [31:0] POL
0x04 IDR
0x08 CR
0x10 INIT
0x14 POL

## BDMA
Base 0x58025400
0x00 ISR
  [4n+3] TEIF{n} (n=0..7), [4n+3] CTEIF{n} (n=0..7), [4n+2] HTIF{n} (n=0..7), [4n+2] CHTIF{n} (n=0..7), [4n+1] TCIF{n} (n=0..7), [4n+1] CTCIF{n} (n=0..7), [4n] GIF{n} (n=0..7), [4n] CGIF{n} (n=0..7), [16] CT, [16] CT, [16] CT, [16] CT, [16] CT, [16] CT, [16] CT, [16] CT, [15] DBM, [15] DBM, [15] DBM, [15] DBM, [15] DBM, [15] DBM, [15] DBM, [15] DBM, [14] MEM2MEM, [14] MEM2MEM, [14] MEM2MEM, [14] MEM2MEM, [14] MEM2MEM, [14] MEM2MEM, [14] MEM2MEM, [14] MEM2MEM, [13:12] PL, [13:12] PL, [13:12] PL, [13:12] PL, [13:12] PL, [13:12] PL, [13:12] PL, [13:12] PL, [11:10] MSIZE, [11:10] MSIZE, [11:10] MSIZE, [11:10] MSIZE, [11:10] MSIZE, [11:10] MSIZE, [11:10] MSIZE, [11:10] MSIZE, [9:8] PSIZE, [9:8] PSIZE, [9:8] PSIZE, [9:8] PSIZE, [9:8] PSIZE, [9:8] PSIZE, [9:8] PSIZE, [9:8] PSIZE, [7] MINC, [7] MINC, [7] MINC, [7] MINC, [7] MINC, [7] MINC, [7] MINC, [7] MINC, [6] PINC, [6] PINC, [6] PINC, [6] PINC, [6] PINC, [6] PINC, [6] PINC, [6] PINC, [5] CIRC, [5] CIRC, [5] CIRC, [5] CIRC, [5] CIRC, [5] CIRC, [5] CIRC, [5] CIRC, [4] DIR, [4] DIR, [4] DIR, [4] DIR, [4] DIR, [4] DIR, [4] DIR, [4] DIR, [3] TEIE, [3] TEIE, [3] TEIE, [3] TEIE, [3] TEIE, [3] TEIE, [3] TEIE, [3] TEIE, [2] HTIE, [2] HTIE, [2] HTIE, [2] HTIE, [2] HTIE, [2] HTIE, [2] HTIE, [2] HTIE, [1] TCIE, [1] TCIE, [1] TCIE, [1] TCIE, [1] TCIE, [1] TCIE, [1] TCIE, [1] TCIE, [0] EN, [15:0] NDT, [31:0] PA, [0] EN, [31:0] MA, [15:0] NDT, [31:0] PA, [31:0] MA, [0] EN, [31:0] MA, [15:0] NDT, [31:0] PA, [31:0] MA, [0] EN, [31:0] MA, [15:0] NDT, [31:0] PA, [31:0] MA, [0] EN, [31:0] MA, [15:0] NDT, [31:0] PA, [31:0] MA, [0] EN, [31:0] MA, [15:0] NDT, [31:0] PA, [31:0] MA, [0] EN, [31:0] MA, [15:0] NDT, [31:0] PA, [31:0] MA, [0] EN, [31:0] MA, [15:0] NDT, [31:0] PA, [31:0] MA, [31:0] MA, [31:0] MA
0x04 IFCR
{0x8+0x14*i} CCR{i} (i=0..7)
{0xC+0x14*i} CNDTR{i} (i=0..7)
{0x14+0x14*i} CPAR{i} (i=0..7)
{0x20+0x14*i} CM0AR{i} (i=0..7)
{0x30+0x14*i} CM1AR{i} (i=0..7)

## HSEM_COMMON
Base 0x58026500
0x00 IER
0x04 ICR
0x08 ISR
0x0C MISR

## DBGMCU
Base 0x5C001000
0x00 IDCODE
  [29] DBG_HRTIM, [29] DBG_HRTIM, [28] DBG_TRGOEN, [23] DBG_I2C3, [23] DBG_I2C3, [22] DBG_CKD3EN, [22] DBG_I2C2, [22] DBG_I2C2, [21] DBG_CKD1EN, [21] DBG_I2C1, [21] DBG_I2C1, [20] DBG_TRACECKEN, [19] DBG_IWDG2, [19] DBG_IWDG2, [18] DBG_TIM17, [18] DBG_TIM17, [18] DBG_IWDG1, [18] DBG_IWDG1, [17] DBG_TIM16, [17] DBG_TIM16, [31:16] REV_ID, [16] DBG_TIM15, [16] DBG_TIM15, [16] DBG_RTC, [16] DBG_RTC, [12] DBG_LPTIM5, [12] DBG_LPTIM5, [11] DBG_WWDG2, [11] DBG_WWDG2, [11] DBG_LPTIM4, [11] DBG_LPTIM4, [10] DBG_LPTIM3, [10] DBG_LPTIM3, [9] DBG_LPTIM1, [9] DBG_LPTIM1, [9] DBG_LPTIM2, [9] DBG_LPTIM2, [8] DBG_TIM14, [8] DBG_TIM14, [8] DBG_FDCAN, [8] DBG_FDCAN, [7] DBG_TIM13, [7] DBG_TIM13, [7] DBG_I2C4, [7] DBG_I2C4, [6] DBG_WWDG1, [6] DBG_WWDG1, [6] DBG_TIM12, [6] DBG_TIM12, [5] DBG_STANDBYD2, [5] DBG_TIM7, [5] DBG_TIM7, [4] DBG_STOPD2, [4] DBG_TIM6, [4] DBG_TIM6, [3] DBG_SLEEPD2, [3] DBG_TIM5, [3] DBG_TIM5, [2] DBG_STANDBYD1, [2] DBG_TIM4, [2] DBG_TIM4, [1] DBG_STOPD1, [1] DBG_TIM3, [1] DBG_TIM3, [1] DBG_TIM8, [1] DBG_TIM8, [11:0] DEV_ID, [0] DBG_SLEEPD1, [0] DBG_TIM2, [0] DBG_TIM2, [0] DBG_TIM1, [0] DBG_TIM1
0x04 CR
0x34 APB3FZ1
0x38 APB3FZ2
0x3C APB1LFZ1
0x40 APB1LFZ2
0x44 APB1HFZ1
0x48 APB1HFZ2
0x4C APB2FZ1
0x50 APB2FZ2
0x54 APB4FZ1
0x58 APB4FZ2
