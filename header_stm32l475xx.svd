# STM32L475xx register map
File version: 1.0
Registers are 32-bit, access not given, reset 0x0 unless marked. A register's access mark holds for its fields unless they carry their own. Offsets are from the block's base; [hi:lo] are bit positions; {n}, {i} and the like mark numbered series.

## WWDG
Base 0x40002C00
0x00 CR
  [9] EWI, [7] WDGA, [8:7] WDGTB, [6:0] T, [6:0] W, [0] EWIF
0x04 CFR
0x08 SR

## IWDG
Base 0x40003000
0x00 KR
  [2] WVU, [1] RVU, [15:0] KEY, [2:0] PR, [11:0] RL, [0] PVU, [11:0] WIN
0x04 PR
0x08 RLR
0x0C SR
0x10 WINR

## SPI2
Base 0x40003800
Same registers: SPI3 0x40003C00, SPI1 0x40013000
0x00 CR1
  [15] BIDIMODE, [14] BIDIOE, [14] LDMATX, [13] CRCEN, [13] LDMARX, [12] CRCNEXT, [12] FRXTH, [11] CRCL, [12:11] FTLVL, [10] RXONLY, [9] SSM, [10:9] FRLVL, [8] SSI, [11:8] DS, [8] FRE, [7] LSBFIRST, [7] TXEIE, [7] BSY, [6] SPE, [6] RXNEIE, [6] OVR, [5] ERRIE, [5] MODF, [4] FRF, [4] CRCERR, [5:3] BR, [3] NSSP, [3] UDR, [2] MSTR, [2] SSOE, [2] CHSIDE, [1] CPOL, [1] TXDMAEN, [1] TXE, [0] CPHA, [0] RXDMAEN, [0] RXNE, [15:0] DR, [15:0] CRCPOLY, [15:0] RXCRC, [15:0] TXCRC
0x04 CR2
0x08 SR
0x0C DR
0x10 CRCPR
0x14 RXCRCR
0x18 TXCRCR

## USART2
Base 0x40004400
Same registers: USART3 0x40004800, UART4 0x40004C00, UART5 0x40005000, LPUART1 0x40008000, USART1 0x40013800
0x00 CR1
  [28] M1, [27] EOBIE, [26] RTOIE, [31:24] ADD, [31:24] BLEN, [23] RTOEN, [23] UCESM, [22] WUFIE, [22] REACK, [25:21] DEAT, [22:21] ABRMODE, [21] TEACK, [20] ABREN, [21:20] WUS, [20] WUF, [20] WUCF, [19] MSBFIRST, [19] RWU, [18] DATAINV, [18] SBKF, [17] TXINV, [19:17] SCARCNT, [17] CMF, [17] CMCF, [20:16] DEDT, [16] RXINV, [16] BUSY, [15] OVER8, [15] SWAP, [15] DEP, [15] ABRF, [14] CMIE, [14] LINEN, [14] DEM, [14] ABRE, [13] MME, [13] DDRE, [12] M0, [13:12] STOP, [12] OVRDIS, [12] EOBF, [12] EOBCF, [11] WAKE, [11] CLKEN, [11] ONEBIT, [11] RTOF, [11] RTOCF, [10] PCE, [10] CPOL, [10] CTSIE, [10] CTS, [9] PS, [9] CPHA, [9] CTSE, [9] CTSIF, [9] CTSCF, [8] PEIE, [8] LBCL, [8] RTSE, [15:8] GT, [8] LBDF, [8] LBDCF, [7] TXEIE, [7] DMAT, [7] TXE, [6] TCIE, [6] LBDIE, [6] DMAR, [6] TC, [6] TCCF, [5] RXNEIE, [5] LBDL, [5] SCEN, [5] RXNE, [4] IDLEIE, [4] ADDM7, [4] NACK, [15:4] DIV_MANTISSA, [4] TXFRQ, [4] IDLE, [4] IDLECF, [3] TE, [3] HDSEL, [3] RXFRQ, [3] ORE, [3] ORECF, [2] RE, [2] IRLP, [2] MMRQ, [2] NE, [2] NECF, [1] UESM, [1] IREN, [1] SBKRQ, [1] FE, [1] FECF, [0] UE, [0] EIE, [3:0] DIV_FRACTION, [7:0] PSC, [23:0] RTO, [0] ABRRQ, [0] PE, [0] PECF, [8:0] RDR, [8:0] TDR
0x04 CR2
0x08 CR3
0x0C BRR
0x10 GTPR 16-bit
0x14 RTOR
0x18 RQR 16-bit
0x1C ISR
0x20 ICR
0x24 RDR 16-bit
0x28 TDR 16-bit

## I2C1
Base 0x40005400
Same registers: I2C2 0x40005800, I2C3 0x40005C00
0x00 CR1
  [31] TEXTEN, [31:28] PRESC, [26] PECBYTE, [25] AUTOEND, [24] RELOAD, [23] PECEN, [22] ALERTEN, [21] SMBDEN, [20] SMBHEN, [23:20] SCLDEL, [19] GCEN, [18] WUPEN, [17] NOSTRETCH, [23:17] ADDCODE, [16] SBC, [23:16] NBYTES, [19:16] SDADEL, [27:16] TIMEOUTB, [16] DIR, [15] RXDMAEN, [15] NACK, [15] OA1EN, [15] OA2EN, [15] TIMOUTEN, [15] BUSY, [14] TXDMAEN, [14] STOP, [13] SWRST, [13] START, [13] ALERT, [13] ALERTCF, [12] ANFOFF, [12] HEAD10R, [12] TIDLE, [12] TIMEOUT, [12] TIMOUTCF, [11] ADD10, [11] PECERR, [11] PECCF, [10] RD_WRN, [10] OA1MODE, [10] OA2MASK04, [10] OVR, [10] OVRCF, [10:9] OA2MASK06, [9] ARLO, [9] ARLOCF, [11:8] DNF, [10:8] OA2MSK, [15:8] SCLH, [8] BERR, [8] BERRCF, [7] ERRIE, [7] TCR, [6] TCIE, [6] TC, [5] STOPIE, [5] STOPF, [5] STOPCF, [4] NACKIE, [4] NACKF, [4] NACKCF, [3] ADDRIE, [3] ADDR, [3] ADDRCF, [2] RXIE, [2] RXNE, [1] TXIE, [7:1] OA2, [1] TXIS, [0] PE, [9:0] SADD, [9:0] OA1, [7:0] SCLL, [11:0] TIMEOUTA, [0] TXE, [7:0] PEC, [7:0] RXDATA, [7:0] TXDATA
0x04 CR2
0x08 OAR1
0x0C OAR2
0x10 TIMINGR
0x14 TIMEOUTR
0x18 ISR
0x1C ICR
0x20 PECR
0x24 RXDR
0x28 TXDR

## PWR
Base 0x40007000
0x00 CR1
  [15] EIWUL, [15] WUFI, [n+11] PVMO{n} (n=1..4), [n] PA{n} (n=12..15), [15] PB15, [15] PB15, [15] PC15, [15] PC15, [15] PD15, [15] PD15, [15] PE15, [15] PE15, [15] PF15, [15] PF15, [15] PG15, [15] PG15, [14] LPR, [14] PB14, [14] PB14, [14] PC14, [14] PC14, [14] PD14, [14] PD14, [14] PE14, [14] PE14, [14] PF14, [14] PF14, [14] PG14, [14] PG14, [13] PB13, [13] PB13, [13] PC13, [13] PC13, [13] PD13, [13] PD13, [13] PE13, [13] PE13, [13] PF13, [13] PF13, [13] PG13, [13] PG13, [12] PA12, [12] PB12, [12] PB12, [12] PC12, [12] PC12, [12] PD12, [12] PD12, [12] PE12, [12] PE12, [12] PF12, [12] PF12, [12] PG12, [12] PG12, [11] PVDO, [11] PA11, [11] PA11, [11] PB11, [11] PB11, [11] PC11, [11] PC11, [11] PD11, [11] PD11, [11] PE11, [11] PE11, [11] PF11, [11] PF11, [11] PG11, [11] PG11, [10] USV, [10] APC, [10] VOSF, [10] PA10, [10] PA10, [10] PB10, [10] PB10, [10] PC10, [10] PC10, [10] PD10, [10] PD10, [10] PE10, [10] PE10, [10] PF10, [10] PF10, [10] PG10, [10] PG10, [10:9] VOS, [9] IOSV, [9] VBRS, [9] REGLPF, [9] PA9, [9] PA9, [9] PB9, [9] PB9, [9] PC9, [9] PC9, [9] PD9, [9] PD9, [9] PE9, [9] PE9, [9] PF9, [9] PF9, [9] PG9, [9] PG9, [8] DBP, [8] RRS, [8] VBE, [8] SBF, [8] REGLPS, [8] CSBF, [8] PA8, [8] PA8, [8] PB8, [8] PB8, [8] PC8, [8] PC8, [8] PD8, [8] PD8, [8] PE8, [8] PE8, [8] PF8, [8] PF8, [8] PG8, [8] PG8, [n+3] PVME{n} (n=1..4), [7] PA7, [7] PA7, [7] PB7, [7] PB7, [7] PC7, [7] PC7, [7] PD7, [7] PD7, [7] PE7, [7] PE7, [7] PF7, [7] PF7, [7] PG7, [7] PG7, [6] PA6, [6] PA6, [6] PB6, [6] PB6, [6] PC6, [6] PC6, [6] PD6, [6] PD6, [6] PE6, [6] PE6, [6] PF6, [6] PF6, [6] PG6, [6] PG6, [5] PA5, [5] PA5, [5] PB5, [5] PB5, [5] PC5, [5] PC5, [5] PD5, [5] PD5, [5] PE5, [5] PE5, [5] PF5, [5] PF5, [5] PG5, [5] PG5, [n-1] EWUP{n} (n=1..5), [n-1] WP{n} (n=1..5), [n-1] WUF{n} (n=1..5), [n-1] CWUF{n} (n=1..5), [4] PA4, [4] PA4, [4] PB4, [4] PC4, [4] PC4, [4] PD4, [4] PD4, [4] PE4, [4] PE4, [4] PF4, [4] PF4, [4] PG4, [4] PG4, [3] PLS_LEV4, [3] PA3, [3] PA3, [3] PB3, [3] PB3, [3] PC3, [3] PC3, [3] PD3, [3] PD3, [3] PE3, [3] PE3, [3] PF3, [3] PF3, [3] PG3, [3] PG3, [2] LPMS_SHUTDOWN, [3:2] PLS_LEV6, [2] PA2, [2] PA2, [2] PB2, [2] PB2, [2] PC2, [2] PC2, [2] PD2, [2] PD2, [2] PE2, [2] PE2, [2] PF2, [2] PF2, [2] PG2, [2] PG2, [1] LPMS_STOP2, [3:1] PLS_LEV7, [1] PA1, [1] PA1, [1] PB1, [1] PB1, [1] PC1, [1] PC1, [1] PD1, [1] PD1, [1] PE1, [1] PE1, [1] PF1, [1] PF1, [1] PG1, [1] PG1, [1] PH1, [1] PH1, [0] LPMS_STOP1, [0] PVDE, [0] PA0, [0] PA0, [0] PB0, [0] PB0, [0] PC0, [0] PC0, [0] PD0, [0] PD0, [0] PE0, [0] PE0, [0] PF0, [0] PF0, [0] PG0, [0] PG0, [0] PH0, [0] PH0
0x04 CR2
0x08 CR3
0x0C CR4
0x10 SR1
0x14 SR2
0x18 SCR
0x20 PUCRA
0x24 PDCRA
0x28 PUCRB
0x2C PDCRB
0x30 PUCRC
0x34 PDCRC
0x38 PUCRD
0x3C PDCRD
0x40 PUCRE
0x44 PDCRE
0x48 PUCRF
0x4C PDCRF
0x50 PUCRG
0x54 PDCRG
0x58 PUCRH
0x5C PDCRH
