# STM32H725xx register map
File version: 1.0
Registers are 32-bit, access not given, reset 0x0 unless marked. A register's access mark holds for its fields unless they carry their own. Offsets are from the block's base; [hi:lo] are bit positions; {n}, {i} and the like mark numbered series.

## FMC_Bank1E_R
Base 0x52004104
0x00 BWTR.0
  [29:28] ACCMOD, [29:28] ACCMOD, [29:28] ACCMOD, [29:28] ACCMOD, [29:28] ACCMOD, [29:28] ACCMOD, [29:28] ACCMOD, [19:16] BUSTURN, [19:16] BUSTURN, [19:16] BUSTURN, [19:16] BUSTURN, [19:16] BUSTURN, [19:16] BUSTURN, [19:16] BUSTURN, [15:8] DATAST, [15:8] DATAST, [15:8] DATAST, [15:8] DATAST, [15:8] DATAST, [15:8] DATAST, [15:8] DATAST, [7:4] ADDHLD, [7:4] ADDHLD, [7:4] ADDHLD, [7:4] ADDHLD, [7:4] ADDHLD, [7:4] ADDHLD, [7:4] ADDHLD, [3:0] ADDSET, [3:0] ADDSET, [3:0] ADDSET, [3:0] ADDSET, [3:0] ADDSET, [3:0] ADDSET, [3:0] ADDSET
0x04 BWTR.1
0x08 BWTR.2
0x0C BWTR.3
0x10 BWTR.4
0x14 BWTR.5
0x18 BWTR.6

## FMC_Bank5_6_R
Base 0x52004140
0x00 SDCR.0
  [27:24] TRCD, [27:24] TRCD, [23:20] TRP, [23:20] TRP, [19:16] TWR, [19:16] TWR, [14] REIE, [14:13] RPIPE, [14:13] RPIPE, [12] RBURST, [12] RBURST, [15:12] TRC, [15:12] TRC, [11:10] SDCLK, [11:10] SDCLK, [9] WP, [9] WP, [21:9] MRD, [11:8] TRAS, [11:8] TRAS, [8:7] CAS, [8:7] CAS, [6] NB, [6] NB, [8:5] NRFS, [5:4] MWID, [5:4] MWID, [7:4] TXSR, [7:4] TXSR, [4] CTB1, [3] CTB2, [4:3] MODES2, [3:2] NR, [3:2] NR, [13:1] COUNT, [2:1] MODES1, [1:0] NC, [1:0] NC, [3:0] TMRD, [3:0] TMRD, [2:0] MODE, [0] CRE, [0] RE
0x04 SDCR.1
0x08 SDTR.0
0x0C SDTR.1
0x10 SDCMR
0x14 SDRTR
0x18 SDSR

## OCTOSPI1
Base 0x52005000
Same registers: OCTOSPI2 0x5200A000
0x00 CR
  [31] SIOO, [31] SIOO, [31] SIOO, [30] SSHIFT, [30] SSHIFT, [29] DQSE, [29] DQSE, [29] DQSE, [29:28] FMODE, [28] DHQC, [28] DHQC, [27] DDTR, [27] DDTR, [27] DDTR, [26:24] MTYP, [26:24] DMODE, [26:24] DMODE, [26:24] DMODE, [23] PMM, [22] APMS, [20] TOIE, [21:20] ABSIZE, [21:20] ABSIZE, [21:20] ABSIZE, [19] SMIE, [19] ABDTR, [19] ABDTR, [19] ABDTR, [18] FTIE, [17] TCIE, [16] TEIE, [20:16] DEVSIZE, [18:16] WRAPSIZE, [20:16] CSBOUND, [18:16] ABMODE, [18:16] ABMODE, [18:16] ABMODE, [23:16] TRWR, [13:12] ADSIZE, [13:12] ADSIZE, [13:12] ADSIZE, [11] ADDTR, [11] ADDTR, [11] ADDTR, [12:8] FTHRES, [10:8] CSHT, [13:8] FLEVEL, [10:8] ADMODE, [10:8] ADMODE, [10:8] ADMODE, [15:8] TACC, [7] FSEL, [6] DQM, [5] BUSY, [6:4] CKCSHT, [4] TOF, [4] CTOF, [5:4] ISIZE, [5:4] ISIZE, [5:4] ISIZE, [3] TCEN, [3] DLYBYP, [3] SMF, [3] CSMF, [3] IDTR, [3] IDTR, [3] IDTR, [2] DMAEN, [2] FTF, [1] ABORT, [1] FRCK, [1] TCF, [1] CTCF, [1] WZL, [0] EN, [0] CKMODE, [7:0] PRESCALER, [7:0] MAXTRAN, [31:0] REFRESH, [0] TEF, [0] CTEF, [31:0] DL, [31:0] ADDRESS, [31:0] DATA, [31:0] MASK, [31:0] MATCH, [15:0] INTERVAL, [2:0] IMODE, [4:0] DCYC, [31:0] INSTRUCTION, [31:0] ALTERNATE, [15:0] TIMEOUT, [2:0] IMODE, [4:0] DCYC, [31:0] INSTRUCTION, [31:0] ALTERNATE, [2:0] IMODE, [4:0] DCYC, [31:0] INSTRUCTION, [31:0] ALTERNATE, [0] LM, [7:0] VER, [31:0] ID, [31:0] MID
{0x4+4i} DCR{i} (i=1..4)
0x20 SR
0x24 FCR
0x40 DLR
0x48 AR
0x50 DR
0x80 PSMKR
0x88 PSMAR
0x90 PIR
0x100 CCR
0x108 TCR
0x110 IR
0x120 ABR
0x130 LPTR
0x140 WPCCR
0x148 WPTCR
0x150 WPIR
0x160 WPABR
0x180 WCCR
0x188 WTCR
0x190 WIR
0x1A0 WABR
0x200 HLCR
0x3EC HWCFGR
0x3F0 VER
0x3F4 ID
0x3F8 MID

## OCTOSPIM
Base 0x5200B400
0x00 CR
  [26:25] IOHSRC, [26:25] IOHSRC, [26:25] IOHSRC, [24] IOHEN, [24] IOHEN, [24] IOHEN, [18:17] IOLSRC, [18:17] IOLSRC, [18:17] IOLSRC, [23:16] REQ2ACK_TIME, [16] IOLEN, [16] IOLEN, [16] IOLEN, [9] NCSSRC, [9] NCSSRC, [9] NCSSRC, [8] NCSEN, [8] NCSEN, [8] NCSEN, [5] DQSSRC, [5] DQSSRC, [5] DQSSRC, [4] DQSEN, [4] DQSEN, [4] DQSEN, [1] CLKSRC, [1] CLKSRC, [1] CLKSRC, [0] MUXEN, [0] CLKEN, [0] CLKEN, [0] CLKEN
0x04 PCR.0
0x08 PCR.1
0x0C PCR.2

## EXTI
Base 0x58000000
0x00 RTSR1
  [n] IM{n} (n=0..31), [n] EM{n} (n=20..31), [n-32] IM{n} (n=60..63), [n-32] EM{n} (n=60..63), [2n+1:2n] PCS{n} (n=0..15), [n-64] IM{n} (n=85..91), [n-64] EM{n} (n=85..91), [26] IM58, [26] EM58, [24] MR25, [24] MR88, [n-32] IM{n} (n=47..56), [n-32] EM{n} (n=47..56), [22] TR86, [22] TR86, [22] SWIER86, [22] PR86, [21] TR21, [21] TR21, [n] SWIER{n} (n=0..21), [21] MR21, [n-32] MR{n} (n=48..53), [21] TR85, [21] TR85, [21] SWIER85, [n] PR{n} (n=0..21), [21] PR85, [20] TR20, [20] TR20, [20] MR20, [20] PR84, [19] TR19, [19] TR19, [19] MR19, [19] TR51, [19] TR51, [19] SWIER51, [19] PR51, [18] TR18, [18] TR18, [19:18] PCS25, [19:18] PCS41, [n] EM{n} (n=0..18), [17] TR17, [17] TR17, [17] TR49, [17] TR49, [17] SWIER49, [17] PR49, [16] TR16, [16] TR16, [17:16] PCS88, [16] IM80, [16] EM80, [15] TR15, [15] TR15, [n] MR{n} (n=0..15), [14] TR14, [14] TR14, [n-64] IM{n} (n=64..78), [n-64] EM{n} (n=64..78), [13] TR13, [13] TR13, [12] TR12, [12] TR12, [11] TR11, [11] TR11, [n-32] IM{n} (n=32..43), [n-32] EM{n} (n=32..43), [10] TR10, [10] TR10, [11:10] PCS21, [2n-95:2n-96] PCS{n} (n=48..53), [9] TR9, [9] TR9, [9] MR41, [8] TR8, [8] TR8, [9:8] PCS20, [7] TR7, [7] TR7, [6] TR6, [6] TR6, [7:6] PCS19, [7:6] PCS35, [5] TR5, [5] TR5, [4] TR4, [4] TR4, [5:4] PCS34, [3] TR3, [3] TR3, [3] MR35, [2] TR2, [2] TR2, [2] MR34, [1] TR1, [1] TR1, [0] TR0, [0] TR0
0x04 FTSR1
0x08 SWIER1
0x0C D3PMR1
0x10 D3PCR1L
0x14 D3PCR1H
0x20 RTSR2
0x24 FTSR2
0x28 SWIER2
0x2C D3PMR2
0x30 D3PCR2L
0x34 D3PCR2H
0x40 RTSR3
0x44 FTSR3
0x48 SWIER3
0x4C D3PMR3
0x50 D3PCR3L
0x54 D3PCR3H
{0x70+0x10*i} IMR{i} (i=1..3)
{0x74+0x10*i} EMR{i} (i=1..3)
{0x78+0x10*i} PR{i} (i=1..3)
