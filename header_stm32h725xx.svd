# STM32H725xx register map
File version: 1.0
Registers are 32-bit, access not given, reset 0x0 unless marked. A register's access mark holds for its fields unless they carry their own. Offsets are from the block's base; [hi:lo] are bit positions; {n}, {i} and the like mark numbered series.

## FMAC
Base 0x48024000
0x00 X1BUFCFG
  [31] START, [25:24] FULL_WM, [25:24] EMPTY_WM, [30:24] FUNC, [23:16] R, [16] RESET, [15] CLIPEN, [10] SAT, [9] DMAWEN, [9] UNFL, [15:8] X1_BUF_SIZE, [15:8] X2_BUF_SIZE, [15:8] Y_BUF_SIZE, [15:8] Q, [8] DMAREN, [8] OVFL, [4] SATIEN, [3] UNFLIEN, [2] OVFLIEN, [1] WIEN, [1] X1FULL, [7:0] X1_BASE, [7:0] X2_BASE, [7:0] Y_BASE, [7:0] P, [0] RIEN, [0] YEMPTY, [15:0] WDATA, [15:0] RDATA
0x04 X2BUFCFG
0x08 YBUFCFG
0x0C PARAM
0x10 CR
0x14 SR
0x18 WDATA
0x1C RDATA

## CORDIC
Base 0x48024400
0x00 CSR
  [31] RRDY, [22] ARGSIZE, [21] RESSIZE, [20] NARGS, [19] NRES, [18] DMAWEN, [17] DMAREN, [16] IEN, [10:8] SCALE, [7:4] PRECISION, [3:0] FUNC, [31:0] ARG, [31:0] RES
0x04 WDATA
0x08 RDATA

## LTDC
Base 0x50001000
0x08 SSCR
  [31] HSPOL, [30] VSPOL, [29] DEPOL, [28] PCPOL, [27:16] HSW, [27:16] AHBP, [27:16] AAW, [27:16] TOTALW, [16] DEN, [23:16] BCRED, [31:16] CXPOS, [14:12] DRW, [10:8] DGW, [15:8] BCGREEN, [6:4] DBW, [3] RRIE, [3] RRIF, [3] CRRIF, [3] HSYNCS, [2] TERRIE, [2] TERRIF, [2] CTERRIF, [2] VSYNCS, [1] VBR, [1] FUIE, [1] FUIF, [1] CFUIF, [1] HDES, [10:0] VSH, [10:0] AVBP, [10:0] AAH, [10:0] TOTALH, [0] LTDCEN, [0] IMR, [7:0] BCBLUE, [0] LIE, [0] LIF, [0] CLIF, [10:0] LIPOS, [15:0] CYPOS, [0] VDES
0x0C BPCR
0x10 AWCR
0x14 TWCR
0x18 GCR
0x24 SRCR
0x2C BCCR
0x34 IER
0x38 ISR
0x3C ICR
0x40 LIPCR
0x44 CPSR
0x48 CDSR
0x84 CR1
0x88 WHPCR1
0x90 WVPCR1
0x9C CKCR1
0xAC PFCR1
0xC0 CACR1
0xD8 DCCR1
0xF4 BFCR1
0x104 CR2
0x108 WHPCR2
0x110 WVPCR2
0x11C CFBAR1
0x11C CKCR2
0x12C PFCR2
0x140 CACR2
0x148 CFBLR1
0x158 DCCR2
0x174 BFCR2
0x178 CFBLNR1
0x19C CFBAR2
0x1B8 CLUTWR1
0x1C8 CFBLR2
0x1F8 CFBLNR2
0x238 CLUTWR2

## WWDG1
Base 0x50003000
0x00 CR
  [13:11] WDGTB, [9] EWI, [7] WDGA, [6:0] T, [6:0] W, [0] EWIF
0x04 CFR
0x08 SR

## GPV
Base 0x51000000
{0x1FC0+4i} AXI_PERIPH_ID_{i} (i=4..7)
{0x1FE0+4i} AXI_PERIPH_ID_{i} (i=0..3)
{0x1FF0+4i} AXI_COMP_ID_{i} (i=0..3)
{0x1008+0x1000*i} AXI_TARG{i}_FN_MOD_ISS_BM (i=1..8)
0x2024 AXI_TARG1_FN_MOD2
0x202C AXI_TARG1_FN_MOD_LB
0x2108 AXI_TARG1_FN_MOD
0x3024 AXI_TARG2_FN_MOD2
0x302C AXI_TARG2_FN_MOD_LB
0x3108 AXI_TARG2_FN_MOD
0x8024 AXI_TARG7_FN_MOD2
0x802C AXI_TARG7_FN_MOD_LB
0x8108 AXI_TARG7_FN_MOD
0x9024 AXI_TARG8_FN_MOD2
0x9108 AXI_TARG8_FN_MOD
0x42024 AXI_INI1_FN_MOD2
0x42028 AXI_INI1_FN_MOD_AHB
{0x41100+0x1000*i} AXI_INI{i}_READ_QOS (i=1..6)
{0x41104+0x1000*i} AXI_INI{i}_WRITE_QOS (i=1..6)
{0x41108+0x1000*i} AXI_INI{i}_FN_MOD (i=1..6)
0x44024 AXI_INI3_FN_MOD2
0x44028 AXI_INI3_FN_MOD_AHB

## FLASH
Base 0x52002000
0x00 ACR
  [30] OPTCHANGEERRIE, [30] CLR_OPTCHANGEERR, [5:4] WRHIGHFREQ, [1] OPTSTART, [3:0] LATENCY, [0] OPTLOCK, [31:0] CRC_DATA
0x04 KEYR1
0x08 OPTKEYR
0x0C CR1
0x10 SR1
0x14 CCR1
0x18 OPTCR
0x1C OPTSR_CUR
0x20 OPTSR_PRG
0x24 OPTCCR
0x28 PRAR_CUR1
0x2C PRAR_PRG1
0x30 SCAR_CUR1
0x34 SCAR_PRG1
0x38 WPSN_CUR1
0x3C WPSN_PRG1
0x40 BOOT_CUR
0x44 BOOT_PRG
0x50 CRCCR1
0x54 CRCSADD1
0x58 CRCEADD1
0x5C CRCDATA
0x60 ECC_FA1
0x70 OPTSR2_CUR
0x74 OPTSR2_PRG

## FMC_Bank1_R
Base 0x52004000
0x00 BTCR.0
0x04 BTCR.1
0x08 BTCR.2
0x0C BTCR.3
0x10 BTCR.4
0x14 BTCR.5
0x18 BTCR.6
0x1C BTCR.7

## FMC_Bank2_R
Base 0x52004060
0x00 PCR2
0x04 SR2
0x08 PMEM2
0x0C PATT2
0x14 ECCR2

## FMC_Bank3_R
Base 0x52004080
0x00 PCR
  [31:24] MEMHIZ, [31:24] ATTHIZ, [19:17] ECCPS, [23:16] MEMHOLD, [23:16] ATTHOLD, [16:13] TAR, [12:9] TCLR, [15:8] MEMWAIT, [15:8] ATTWAIT, [6] ECCEN, [6] FEMPT, [5] IFEN, [5:4] PWID, [4] ILEN, [3] IREN, [2] PBKEN, [2] IFS, [1] PWAITEN, [1] ILS, [0] IRS, [7:0] MEMSET, [7:0] ATTSET
0x04 SR
0x08 PMEM
0x0C PATT
0x14 ECCR
