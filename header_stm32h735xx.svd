# STM32H735xx register map
File version: 1.0
Registers are 32-bit, access not given, reset 0x0 unless marked. A register's access mark holds for its fields unless they carry their own. Offsets are from the block's base; [hi:lo] are bit positions; {n}, {i} and the like mark numbered series.

## FLASH
Base 0x52002000
0x00 ACR
  [30] OPTCHANGEERRIE, [30] CLR_OPTCHANGEERR, [5:4] WRHIGHFREQ, [1] OPTSTART, [3:0] LATENCY, [0] OPTLOCK, [31:0] CRC_DATA
0x04 KEYR1
0x08 OPTKEYR
0x0C CR1
0x10 SR1
0x14 CCR1
0x18 OPTCR
0x1C OPTSR_CUR
0x20 OPTSR_PRG
0x24 OPTCCR
0x28 PRAR_CUR1
0x2C PRAR_PRG1
0x30 SCAR_CUR1
0x34 SCAR_PRG1
0x38 WPSN_CUR1
0x3C WPSN_PRG1
0x40 BOOT_CUR
0x44 BOOT_PRG
0x50 CRCCR1
0x54 CRCSADD1
0x58 CRCEADD1
0x5C CRCDATA
0x60 ECC_FA1
0x70 OPTSR2_CUR
0x74 OPTSR2_PRG

## FMC_Bank1_R
Base 0x52004000
0x00 BTCR.0
0x04 BTCR.1
0x08 BTCR.2
0x0C BTCR.3
0x10 BTCR.4
0x14 BTCR.5
0x18 BTCR.6
0x1C BTCR.7

## FMC_Bank2_R
Base 0x52004060
0x00 PCR2
0x04 SR2
0x08 PMEM2
0x0C PATT2
0x14 ECCR2

## FMC_Bank3_R
Base 0x52004080
0x00 PCR
  [31:24] MEMHIZ, [31:24] ATTHIZ, [19:17] ECCPS, [23:16] MEMHOLD, [23:16] ATTHOLD, [16:13] TAR, [12:9] TCLR, [15:8] MEMWAIT, [15:8] ATTWAIT, [6] ECCEN, [6] FEMPT, [5] IFEN, [5:4] PWID, [4] ILEN, [3] IREN, [2] PBKEN, [2] IFS, [1] PWAITEN, [1] ILS, [0] IRS, [7:0] MEMSET, [7:0] ATTSET
0x04 SR
0x08 PMEM
0x0C PATT
0x14 ECCR

## FMC_Bank1E_R
Base 0x52004104
0x00 BWTR.0
  [29:28] ACCMOD, [29:28] ACCMOD, [29:28] ACCMOD, [29:28] ACCMOD, [29:28] ACCMOD, [29:28] ACCMOD, [29:28] ACCMOD, [19:16] BUSTURN, [19:16] BUSTURN, [19:16] BUSTURN, [19:16] BUSTURN, [19:16] BUSTURN, [19:16] BUSTURN, [19:16] BUSTURN, [15:8] DATAST, [15:8] DATAST, [15:8] DATAST, [15:8] DATAST, [15:8] DATAST, [15:8] DATAST, [15:8] DATAST, [7:4] ADDHLD, [7:4] ADDHLD, [7:4] ADDHLD, [7:4] ADDHLD, [7:4] ADDHLD, [7:4] ADDHLD, [7:4] ADDHLD, [3:0] ADDSET, [3:0] ADDSET, [3:0] ADDSET, [3:0] ADDSET, [3:0] ADDSET, [3:0] ADDSET, [3:0] ADDSET
0x04 BWTR.1
0x08 BWTR.2
0x0C BWTR.3
0x10 BWTR.4
0x14 BWTR.5
0x18 BWTR.6

## FMC_Bank5_6_R
Base 0x52004140
0x00 SDCR.0
  [27:24] TRCD, [27:24] TRCD, [23:20] TRP, [23:20] TRP, [19:16] TWR, [19:16] TWR, [14] REIE, [14:13] RPIPE, [14:13] RPIPE, [12] RBURST, [12] RBURST, [15:12] TRC, [15:12] TRC, [11:10] SDCLK, [11:10] SDCLK, [9] WP, [9] WP, [21:9] MRD, [11:8] TRAS, [11:8] TRAS, [8:7] CAS, [8:7] CAS, [6] NB, [6] NB, [8:5] NRFS, [5:4] MWID, [5:4] MWID, [7:4] TXSR, [7:4] TXSR, [4] CTB1, [3] CTB2, [4:3] MODES2, [3:2] NR, [3:2] NR, [13:1] COUNT, [2:1] MODES1, [1:0] NC, [1:0] NC, [3:0] TMRD, [3:0] TMRD, [2:0] MODE, [0] CRE, [0] RE
0x04 SDCR.1
0x08 SDTR.0
0x0C SDTR.1
0x10 SDCMR
0x14 SDRTR
0x18 SDSR

## OCTOSPI1
Base 0x52005000
Same registers: OCTOSPI2 0x5200A000
0x00 CR
  [31] SIOO, [31] SIOO, [31] SIOO, [30] SSHIFT, [30] SSHIFT, [29] DQSE, [29] DQSE, [29] DQSE, [29:28] FMODE, [28] DHQC, [28] DHQC, [27] DDTR, [27] DDTR, [27] DDTR, [26:24] MTYP, [26:24] DMODE, [26:24] DMODE, [26:24] DMODE, [23] PMM, [22] APMS, [20] TOIE, [21:20] ABSIZE, [21:20] ABSIZE, [21:20] ABSIZE, [19] SMIE, [19] ABDTR, [19] ABDTR, [19] ABDTR, [18] FTIE, [17] TCIE, [16] TEIE, [20:16] DEVSIZE, [18:16] WRAPSIZE, [20:16] CSBOUND, [18:16] ABMODE, [18:16] ABMODE, [18:16] ABMODE, [23:16] TRWR, [13:12] ADSIZE, [13:12] ADSIZE, [13:12] ADSIZE, [11] ADDTR, [11] ADDTR, [11] ADDTR, [12:8] FTHRES, [10:8] CSHT, [13:8] FLEVEL, [10:8] ADMODE, [10:8] ADMODE, [10:8] ADMODE, [15:8] TACC, [7] FSEL, [6] DQM, [5] BUSY, [6:4] CKCSHT, [4] TOF, [4] CTOF, [5:4] ISIZE, [5:4] ISIZE, [5:4] ISIZE, [3] TCEN, [3] DLYBYP, [3] SMF, [3] CSMF, [3] IDTR, [3] IDTR, [3] IDTR, [2] DMAEN, [2] FTF, [1] ABORT, [1] FRCK, [1] TCF, [1] CTCF, [1] WZL, [0] EN, [0] CKMODE, [7:0] PRESCALER, [7:0] MAXTRAN, [31:0] REFRESH, [0] TEF, [0] CTEF, [31:0] DL, [31:0] ADDRESS, [31:0] DATA, [31:0] MASK, [31:0] MATCH, [15:0] INTERVAL, [2:0] IMODE, [4:0] DCYC, [31:0] INSTRUCTION, [31:0] ALTERNATE, [15:0] TIMEOUT, [2:0] IMODE, [4:0] DCYC, [31:0] INSTRUCTION, [31:0] ALTERNATE, [2:0] IMODE, [4:0] DCYC, [31:0] INSTRUCTION, [31:0] ALTERNATE, [0] LM, [7:0] VER, [31:0] ID, [31:0] MID
{0x4+4i} DCR{i} (i=1..4)
0x20 SR
0x24 FCR
0x40 DLR
0x48 AR
0x50 DR
0x80 PSMKR
0x88 PSMAR
0x90 PIR
0x100 CCR
0x108 TCR
0x110 IR
0x120 ABR
0x130 LPTR
0x140 WPCCR
0x148 WPTCR
0x150 WPIR
0x160 WPABR
0x180 WCCR
0x188 WTCR
0x190 WIR
0x1A0 WABR
0x200 HLCR
0x3EC HWCFGR
0x3F0 VER
0x3F4 ID
0x3F8 MID
