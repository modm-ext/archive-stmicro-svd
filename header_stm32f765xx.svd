# STM32F765xx register map
File version: 1.0
Registers are 32-bit, access not given, reset 0x0 unless marked. A register's access mark holds for its fields unless they carry their own. Offsets are from the block's base; [hi:lo] are bit positions; {n}, {i} and the like mark numbered series.

## USART2
Base 0x40004400
Same registers: USART3 0x40004800, UART4 0x40004C00, UART5 0x40005000, UART7 0x40007800, UART8 0x40007C00, USART1 0x40011000, USART6 0x40011400
0x00 CR1
  [27] EOBIE, [26] RTOIE, [31:24] ADD, [31:24] BLEN, [23] RTOEN, [23] UCESM, [22] WUFIE, [22] REACK, [25:21] DEAT, [22:21] ABRMODE, [21] TEACK, [20] ABREN, [21:20] WUS, [20] WUF, [20] WUCF, [19] MSBFIRST, [19] RWU, [18] DATAINV, [18] SBKF, [17] TXINV, [19:17] SCARCNT, [17] CMF, [17] CMCF, [20:16] DEDT, [16] RXINV, [16] BUSY, [15] OVER8, [15] SWAP, [15] DEP, [15] ABRF, [14] CMIE, [14] LINEN, [14] DEM, [14] ABRE, [13] MME, [13] DDRE, [28:12] M, [13:12] STOP, [12] OVRDIS, [12] EOBF, [12] EOBCF, [11] WAKE, [11] CLKEN, [11] ONEBIT, [11] RTOF, [11] RTOCF, [10] PCE, [10] CPOL, [10] CTSIE, [10] CTS, [9] PS, [9] CPHA, [9] CTSE, [9] CTSIF, [9] CTSCF, [8] PEIE, [8] LBCL, [8] RTSE, [15:8] GT, [8] LBDF, [8] LBDCF, [7] TXEIE, [7] DMAT, [7] TXE, [6] TCIE, [6] LBDIE, [6] DMAR, [6] TC, [6] TCCF, [5] RXNEIE, [5] LBDL, [5] SCEN, [5] RXNE, [4] IDLEIE, [4] ADDM7, [4] NACK, [15:4] DIV_MANTISSA, [4] TXFRQ, [4] IDLE, [4] IDLECF, [3] TE, [3] HDSEL, [3] RXFRQ, [3] ORE, [3] ORECF, [2] RE, [2] IRLP, [2] MMRQ, [2] NE, [2] NCF, [1] UESM, [1] IREN, [1] SBKRQ, [1] FE, [1] FECF, [0] UE, [0] EIE, [3:0] DIV_FRACTION, [7:0] PSC, [23:0] RTO, [0] ABRRQ, [0] PE, [0] PECF, [8:0] RDR, [8:0] TDR
0x04 CR2
0x08 CR3
0x0C BRR
0x10 GTPR
0x14 RTOR
0x18 RQR
0x1C ISR
0x20 ICR
0x24 RDR
0x28 TDR

## I2C1
Base 0x40005400
Same registers: I2C2 0x40005800, I2C3 0x40005C00, I2C4 0x40006000
0x00 CR1
  [31] TEXTEN, [31:28] PRESC, [26] PECBYTE, [25] AUTOEND, [24] RELOAD, [23] PECEN, [22] ALERTEN, [21] SMBDEN, [20] SMBHEN, [23:20] SCLDEL, [19] GCEN, [17] NOSTRETCH, [23:17] ADDCODE, [16] SBC, [23:16] NBYTES, [19:16] SDADEL, [27:16] TIMEOUTB, [16] DIR, [15] RXDMAEN, [15] NACK, [15] OA1EN, [15] OA2EN, [15] TIMOUTEN, [15] BUSY, [14] TXDMAEN, [14] STOP, [13] START, [13] ALERT, [13] ALERTCF, [12] ANFOFF, [12] HEAD10R, [12] TIDLE, [12] TIMEOUT, [12] TIMOUTCF, [11] ADD10, [11] PECERR, [11] PECCF, [10] RD_WRN, [10] OA1MODE, [10] OA2MASK04, [10] OVR, [10] OVRCF, [10:9] OA2MASK06, [9] ARLO, [9] ARLOCF, [11:8] DNF, [10:8] OA2MSK, [15:8] SCLH, [8] BERR, [8] BERRCF, [7] ERRIE, [7] TCR, [6] TCIE, [6] TC, [5] STOPIE, [5] STOPF, [5] STOPCF, [4] NACKIE, [4] NACKF, [4] NACKCF, [3] ADDRIE, [3] ADDR, [3] ADDRCF, [2] RXIE, [2] RXNE, [1] TXIE, [7:1] OA2, [1] TXIS, [0] PE, [9:0] SADD, [9:0] OA1, [7:0] SCLL, [11:0] TIMEOUTA, [0] TXE, [7:0] PEC, [7:0] RXDATA, [7:0] TXDATA
0x04 CR2
0x08 OAR1
0x0C OAR2
0x10 TIMINGR
0x14 TIMEOUTR
0x18 ISR
0x1C ICR
0x20 PECR
0x24 RXDR
0x28 TXDR

## CEC
Base 0x40006C00
0x00 CR
  [31] LSTN, [30:16] OAR, [12] TXACKE, [12] TXACKEIE, [11] TXERR, [11] TXERRIE, [10] TXUDR, [10] TXUDRIE, [9] TXEND, [9] TXENDIE, [8] SFTOPT, [8] TXBR, [8] TXBRIE, [7] BRDNOGEN, [7] ARBLST, [7] ARBLSTIE, [6] LBPEGEN, [6] RXACKE, [6] RXACKEIE, [5] BREGEN, [5] LBPE, [5] LBPEIE, [4] BRESTP, [4] SBPE, [4] SBPEIE, [3] RXTOL, [3] BRE, [3] BREIE, [2] TXEOM, [2] RXOVR, [2] RXOVRIE, [1] TXSOM, [1] RXEND, [1] RXENDIE, [0] CECEN, [2:0] SFT, [7:0] TXD, [7:0] RXD, [0] RXBR, [0] RXBRIE
0x04 CFGR
0x08 TXDR
0x0C RXDR
0x10 ISR
0x14 IER

## PWR
Base 0x40007000
0x00 CR1
  [19:18] UDEN, [19:18] UDRDY, [17] ODSWEN, [17] ODSWRDY, [16] ODEN, [16] ODRDY, [15:14] VOS, [14] VOSRDY, [13] ADCDC1, [n+7] WUPP{n} (n=1..6), [n+7] EWUP{n} (n=1..6), [11] MRUDS, [10] LPUDS, [9] FPDS, [9] BRE, [8] DBP, [8] EIWUP, [7] PLS_LEV4, [7:6] PLS_LEV6, [7:5] PLS_LEV7, [n-1] CWUPF{n} (n=1..6), [n-1] WUPF{n} (n=1..6), [4] PVDE, [3] CSBF, [3] BRR, [2] PVDO, [1] PDDS, [1] SBF, [0] LPDS, [0] WUIF
0x04 CSR1
0x08 CR2
0x0C CSR2

## DAC1
Base 0x40007400
0x00 CR
  [29] DMAUDRIE2, [29] DMAUDR2, [28] DMAEN2, [27:24] MAMP2, [23:22] WAVE2, [31:20] DACC2DHR, [21:19] TSEL2, [18] TEN2, [17] BOFF2, [16] EN2, [27:16] DACC2DHR, [13] DMAUDRIE1, [13] DMAUDR1, [12] DMAEN1, [11:8] MAMP1, [15:8] DACC2DHR, [7:6] WAVE1, [15:4] DACC1DHR, [15:4] DACC2DHR, [15:4] DACC1DHR, [5:3] TSEL1, [2] TEN1, [1] BOFF1, [1] SWTRIG2, [0] EN1, [0] SWTRIG1, [11:0] DACC1DHR, [7:0] DACC1DHR, [11:0] DACC2DHR, [7:0] DACC2DHR, [11:0] DACC1DHR, [7:0] DACC1DHR, [11:0] DACC1DOR, [11:0] DACC2DOR
0x04 SWTRIGR
0x08 DHR12R1
0x0C DHR12L1
0x10 DHR8R1
0x14 DHR12R2
0x18 DHR12L2
0x1C DHR8R2
0x20 DHR12RD
0x24 DHR12LD
0x28 DHR8RD
0x2C DOR1
0x30 DOR2
0x34 SR
