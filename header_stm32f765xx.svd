# STM32F765xx register map
File version: 1.0
Registers are 32-bit, access not given, reset 0x0 unless marked. A register's access mark holds for its fields unless they carry their own. Offsets are from the block's base; [hi:lo] are bit positions; {n}, {i} and the like mark numbered series.

## SDMMC2
Base 0x40011C00
Same registers: SDMMC1 0x40012C00
0x00 POWER
  [22] SDIOIT, [22] SDIOITC, [22] SDIOITIE, [21] RXDAVL, [21] RXDAVLIE, [20] TXDAVL, [20] TXDAVLIE, [19] RXFIFOE, [19] RXFIFOEIE, [18] TXFIFOE, [18] TXFIFOEIE, [17] RXFIFOF, [17] RXFIFOFIE, [16] TXFIFOF, [16] TXFIFOFIE, [15] RXFIFOHF, [15] RXFIFOHFIE, [14] HWFC_EN, [14] TXFIFOHE, [14] TXFIFOHEIE, [13] NEGEDGE, [13] RXACT, [13] RXACTIE, [12] TXACT, [12] TXACTIE, [12:11] WIDBUS, [11] SDIOSUSPEND, [11] SDIOEN, [11] CMDACT, [11] CMDACTIE, [10] BYPASS, [10] CPSMEN, [10] RWMOD, [10] DBCKEND, [10] DBCKENDC, [10] DBCKENDIE, [9] PWRSAV, [9] WAITPEND, [9] RWSTOP, [8] CLKEN, [8] WAITINT, [8] RWSTART, [8] DATAEND, [8] DATAENDC, [8] DATAENDIE, [7] CMDSENT, [7] CMDSENTC, [7] CMDSENTIE, [7:6] WAITRESP, [6] CMDREND, [6] CMDRENDC, [6] CMDRENDIE, [5] RXOVERR, [5] RXOVERRC, [5] RXOVERRIE, [7:4] DBLOCKSIZE, [4] TXUNDERR, [4] TXUNDERRC, [4] TXUNDERRIE, [3] DMAEN, [3] DTIMEOUT, [3] DTIMEOUTC, [3] DTIMEOUTIE, [2] DTMODE, [2] CTIMEOUT, [2] CTIMEOUTC, [2] CTIMEOUTIE, [1] DTDIR, [1] DCRCFAIL, [1] DCRCFAILC, [1] DCRCFAILIE, [1:0] PWRCTRL, [7:0] CLKDIV, [31:0] CMDARG, [5:0] CMDINDEX, [5:0] RESPCMD, [31:0] CARDSTATUS{n} (n=1..4), [31:0] DATATIME, [24:0] DATALENGTH, [0] DTEN, [24:0] DATACOUNT, [0] CCRCFAIL, [0] CCRCFAILC, [0] CCRCFAILIE, [23:0] FIFOCOUNT, [31:0] FIFODATA
0x04 CLKCR
0x08 ARG
0x0C CMD
0x10 RESPCMD
{0x10+4i} RESP{i} (i=1..4)
0x24 DTIMER
0x28 DLEN
0x2C DCTRL
0x30 DCOUNT
0x34 STA
0x38 ICR
0x3C MASK
0x48 FIFOCNT
0x80 FIFO

## ADC1
Base 0x40012000
Same registers: ADC3 0x40012200
0x00 SR
  [30] SWSTART, [29:28] EXTEN, [3n+2:3n] SMP{n} (n=0..9), [26] OVRIE, [5n-31:5n-35] SQ{n} (n=7..12), [5n-1:5n-5] SQ{n} (n=1..6), [25:24] RES, [27:24] EXTSEL, [3n-28:3n-30] SMP{n} (n=10..18), [23] AWDEN, [22] JAWDEN, [22] JSWSTART, [21:20] JEXTEN, [23:20] L, [21:20] JL, [19:16] JEXTSEL, [31:16] ADC2DATA, [5n-61:5n-65] SQ{n} (n=13..16), [5n-1:5n-5] JSQ{n} (n=1..4), [15:13] DISCNUM, [12] JDISCEN, [11] DISCEN, [11] ALIGN, [10] JAUTO, [10] EOCS, [9] AWDSGL, [9] DDS, [8] SCAN, [8] DMA, [7] JEOCIE, [6] AWDIE, [5] OVR, [5] EOCIE, [4] STRT, [3] JSTRT, [2] JEOC, [1] EOC, [1] CONT, [0] AWD, [4:0] AWDCH, [0] ADON, [11:0] JOFFSET{n} (n=1..4), [11:0] HT, [11:0] LT, [15:0] DATA
0x04 CR1
0x08 CR2
0x0C SMPR1
0x10 SMPR2
{0x10+4i} JOFR{i} (i=1..4)
0x24 HTR
0x28 LTR
{0x28+4i} SQR{i} (i=1..3)
0x38 JSQR
{0x38+4i} JDR{i} (i=1..4)
0x4C DR

## ADC2
Base 0x40012100
0x00 SR
  [30] SWSTART, [29:28] EXTEN, [3n+2:3n] SMP{n} (n=0..9), [26] OVRIE, [5n-31:5n-35] SQ{n} (n=7..12), [5n-1:5n-5] SQ{n} (n=1..6), [25:24] RES, [27:24] EXTSEL, [3n-28:3n-30] SMP{n} (n=10..18), [23] AWDEN, [22] JAWDEN, [22] JSWSTART, [21:20] JEXTEN, [23:20] L, [21:20] JL, [19:16] JEXTSEL, [31:16] ADC2DATA, [5n-61:5n-65] SQ{n} (n=13..16), [5n-1:5n-5] JSQ{n} (n=1..4), [15:13] DISCNUM, [12] JDISCEN, [11] DISCEN, [11] ALIGN, [10] JAUTO, [10] EOCS, [9] AWDSGL, [9] DDS, [8] SCAN, [8] DMA, [7] JEOCIE, [6] AWDIE, [5] OVR, [5] EOCIE, [4] STRT, [3] JSTRT, [2] JEOC, [1] EOC, [1] CONT, [0] AWD, [4:0] AWDCH, [0] ADON, [11:0] JOFFSET{n} (n=1..4), [11:0] HT, [11:0] LT, [15:0] DATA
0x04 CR1
0x08 CR2
0x0C SMPR1
0x10 SMPR2
{0x10+4i} JOFR{i} (i=1..4)
0x24 HTR
0x28 LTR
{0x28+4i} SQR{i} (i=1..3)
0x38 JSQR
{0x38+4i} JDR{i} (i=1..4)
0x4C DR

## ADC
Base 0x40012300
0x00 CSR
  [23] TSVREFE, [22] VBATE, [21] OVR3, [20] STRT3, [19] JSTRT3, [18] JEOC3, [17] EOC3, [16] AWD3, [17:16] ADCPRE, [31:16] DATA2, [15:14] DMA, [13] OVR2, [13] DDS, [12] STRT2, [11] JSTRT2, [10] JEOC2, [9] EOC2, [8] AWD2, [11:8] DELAY, [5] OVR1, [4] STRT1, [3] JSTRT1, [2] JEOC1, [1] EOC1, [0] AWD1, [4:0] MULTI, [15:0] DATA1
0x04 CCR
0x08 CDR

## ADC123_COMMON
Base 0x40012300
0x00 CSR
  [23] TSVREFE, [22] VBATE, [21] OVR3, [20] STRT3, [19] JSTRT3, [18] JEOC3, [17] EOC3, [16] AWD3, [17:16] ADCPRE, [31:16] DATA2, [15:14] DMA, [13] OVR2, [13] DDS, [12] STRT2, [11] JSTRT2, [10] JEOC2, [9] EOC2, [8] AWD2, [11:8] DELAY, [5] OVR1, [4] STRT1, [3] JSTRT1, [2] JEOC1, [1] EOC1, [0] AWD1, [4:0] MULTI, [15:0] DATA1
0x04 CCR
0x08 CDR
