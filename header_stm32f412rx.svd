# STM32F412Rx register map
File version: 1.0
STM32F412RET6,STM32F412RET7,STM32F412REY6,STM32F412REY6P,STM32F412REY7,STM32F412REY7P,STM32F412RGT6,STM32F412RGY6,STM32F412RGY6P
Registers are 32-bit, access not given, reset 0x0 unless marked. A register's access mark holds for its fields unless they carry their own. Offsets are from the block's base; lines under a group give offsets from that group; [hi:lo] are bit positions; {n}, {i} and the like mark numbered series; 'fields as' and 'values as' point back to an identical list; <NAME> marks a mode.

## Memory map
0x40000000 TIM2
0x40000400 TIM3
0x40000800 TIM4
0x40000C00 TIM5
0x40001000 TIM6
0x40001400 TIM7
0x40001800 TIM12
0x40001C00 TIM13
0x40002000 TIM14
0x40002800 RTC
0x40002C00 WWDG
0x40003000 IWDG
0x40003400 I2S2ext
0x40003800 SPI2
0x40003C00 SPI3
0x40004000 I2S3ext
0x40004400 USART2
0x40004800 USART3
0x40005400 I2C1
0x40005800 I2C2
0x40005C00 I2C3
0x40006000 FMPI2C1
0x40006400 CAN1
0x40006800 CAN2
0x40007000 PWR
0x40010000 TIM1
0x40010400 TIM8
0x40011000 USART1
0x40011400 USART6
0x40012000 ADC1
0x40012C00 SDIO
0x40013000 SPI1
0x40013400 SPI4
0x40013800 SYSCFG
0x40013C00 EXTI
0x40014000 TIM9
0x40014400 TIM10
0x40014800 TIM11
0x40015000 SPI5
0x40016000 DFSDM1
0x40020000 GPIOA
0x40020400 GPIOB
0x40020800 GPIOC
0x40020C00 GPIOD
0x40021C00 GPIOH
0x40023000 CRC
0x40023800 RCC
0x40023C00 FLASH
0x40026000 DMA1
0x40026400 DMA2
0x50000000 USB_OTG_FS
0x50060800 RNG
0xA0000000 FSMC_Bank1
0xA0000104 FSMC_Bank1E
0xA0001000 QUADSPI
0xE0042000 DBGMCU

## TIM2
Base 0x40000000
Same registers: TIM3 0x40000400, TIM4 0x40000800, TIM5 0x40000C00, TIM6 0x40001000, TIM7 0x40001400, TIM12 0x40001800, TIM13 0x40001C00, TIM14 0x40002000, TIM1 0x40010000, TIM8 0x40010400, TIM9 0x40014000, TIM10 0x40014400, TIM11 0x40014800
0x00 CR1
  [15] ETP, [15] OC2CE, [15] OC4CE, [4n-1] CC{n}NP (n=1..4), [15] MOE, [2n+6] OIS{n} (n=1..4), [14] ECE, [14] TDE, [14] AOE, [13] OIS3N, [13] COMDE, [4n-3] CC{n}P (n=1..4), [13] BKP, [13:12] ETPS, [n+8] CC{n}DE (n=1..4), [n+8] CC{n}OF (n=1..4), [14:12] OC2M, [14:12] OC4M, [4n-4] CC{n}E (n=1..4), [12] BKE, [11] OIS2N, [11] OC2PE, [11] OC4PE, [11] OSSR, [10] OC2FE, [10] OC4FE, [10] CC3NE, [10] OSSI, [11:10] ITR1_RMP, [9] OIS1N, [9:8] CKD, [11:8] ETF, [8] UDE, [9:8] CC2S, [9:8] CC4S, [9:8] LOCK, [12:8] DBL, [7] ARPE, [7] TI1S, [7] MSM, [7] BIE, [7] BIF, [7] BG, [7] OC1CE, [7] OC3CE, [6] TIE, [6] TIF, [6] TG, [6] CC2NE, [7:6] TI4_RMP, [6:5] CMS, [5] COMIE, [5] COMIF, [5] COMG, [4] DIR, [6:4] MMS, [6:4] TS, [n] CC{n}IE (n=1..4), [n] CC{n}IF (n=1..4), [n] CC{n}G (n=1..4), [6:4] OC1M, [6:4] OC3M, [3] OPM, [3] CCDS, [3] OC1PE, [3] OC3PE, [2] URS, [2] CCUS, [2] OC1FE, [2] OC3FE, [2] CC1NE, [1] UDIS, [0] CEN, [0] CCPC, [2:0] SMS, [0] UIE, [0] UIF, [0] UG, [1:0] CC1S, [1:0] CC3S, [31:0] CNT, [15:0] PSC, [31:0] ARR, [7:0] REP, [15:0] CCR{n} (n=1..4), [7:0] DTG, [4:0] DBA, [15:0] DMAB, [1:0] TI1_RMP
0x04 CR2
0x08 SMCR
0x0C DIER
0x10 SR
0x14 EGR
0x18 CCMR1
0x1C CCMR2
0x20 CCER
0x24 CNT
0x28 PSC
0x2C ARR
0x30 RCR
{0x30+4i} CCR{i} (i=1..4)
0x44 BDTR
0x48 DCR
0x4C DMAR
0x50 OR

## RTC
Base 0x40002800
0x00 TR
  [31] MSK4, [31] MSK4, [31] ADD1S, [30] WDSEL, [30] WDSEL, [29:28] DT, [29:28] DT, [27:24] DU, [27:24] DU, [27:24] MASKSS, [27:24] MASKSS, [23] COE, [23] MSK3, [23] MSK3, [22] PM, [22] PM, [22] PM, [22] PM, [22:21] OSEL, [21:20] HT, [23:20] YT, [20] POL, [21:20] HT, [21:20] HT, [21:20] HT, [19] COSEL, [18] BKP, [18] ALARMOUTTYPE, [17] SUB1H, [17] TSINSEL, [19:16] HU, [19:16] YU, [16] ADD1H, [16] RECALPF, [22:16] PREDIV_A, [19:16] HU, [19:16] HU, [19:16] HU, [16] TAMP1INSEL, [15] TSIE, [15] MSK2, [15] MSK2, [15] CALP, [15] TAMPPUDIS, [14] WUTIE, [14] TAMP2F, [14] CALW8, [15:13] WDU, [13] ALRBIE, [13] TAMP1F, [15:13] WDU, [13] CALW16, [14:13] TAMPPRCH, [14:12] MNT, [12] MT, [12] ALRAIE, [12] TSOVF, [14:12] MNT, [14:12] MNT, [14:12] MNT, [12] MT, [11] TSE, [11] TSF, [12:11] TAMPFLT, [10] WUTE, [10] WUTF, [9] ALRBE, [9] ALRBF, [11:8] MNU, [11:8] MU, [8] ALRAE, [8] ALRAF, [11:8] MNU, [11:8] MNU, [11:8] MNU, [11:8] MU, [10:8] TAMPFREQ, [7] DCE, [7] INIT, [7] DCS, [7] MSK1, [7] MSK1, [7] TAMPTS, [6] FMT, [6] INITF, [5] BYPSHAD, [5] RSF, [6:4] ST, [5:4] DT, [4] REFCKON, [4] INITS, [6:4] ST, [6:4] ST, [6:4] ST, [5:4] DT, [4] TAMP2TRG, [3] TSEDGE, [3] SHPF, [3] TAMP2E, [2] WUTWF, [2] TAMPIE, [1] ALRBWF, [1] TAMP1TRG, [3:0] SU, [3:0] DU, [2:0] WUCKSEL, [0] ALRAWF, [14:0] PREDIV_S, [15:0] WUT, [4:0] DC, [3:0] SU, [3:0] SU, [7:0] KEY, [15:0] SS, [14:0] SUBFS, [3:0] SU, [3:0] DU, [15:0] SS, [8:0] CALM, [0] TAMP1E, [14:0] SS, [14:0] SS
0x04 DR
0x08 CR
0x0C ISR
0x10 PRER
0x14 WUTR
0x18 CALIBR
0x1C ALRMAR
0x20 ALRMBR
0x24 WPR
0x28 SSR
0x2C SHIFTR
0x30 TSTR
0x34 TSDR
0x38 TSSSR
0x3C CALR
0x40 TAFCR
0x44 ALRMASSR
0x48 ALRMBSSR
{0x50+4i} BKP{i}R (i=0..19)
