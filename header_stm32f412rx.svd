# STM32F412Rx register map
File version: 1.0
Registers are 32-bit, access not given, reset 0x0 unless marked. A register's access mark holds for its fields unless they carry their own. Offsets are from the block's base; [hi:lo] are bit positions; {n}, {i} and the like mark numbered series.

## DFSDM1
Base 0x40016000
0x00 CHCFGR10
  [31] DFSDMEN, [31] DFSDMEN, [31] DFSDMEN, [31] DFSDMEN, [31] DFSDMEN, [31] DFSDMEN, [30] CKOUTSRC, [30] CKOUTSRC, [30] CKOUTSRC, [30] CKOUTSRC, [30] CKOUTSRC, [30] CKOUTSRC, [23:22] AWFORD, [23:22] AWFORD, [23:22] AWFORD, [23:22] AWFORD, [23:22] AWFORD, [23:22] AWFORD, [23:16] CKOUTDIV, [20:16] AWFOSR, [23:16] CKOUTDIV, [31:16] INDAT1, [20:16] AWFOSR, [23:16] CKOUTDIV, [31:16] INDAT1, [20:16] AWFOSR, [23:16] CKOUTDIV, [31:16] INDAT1, [20:16] AWFOSR, [31:16] INDAT1, [23:16] CKOUTDIV, [20:16] AWFOSR, [31:16] INDAT1, [23:16] CKOUTDIV, [20:16] AWFOSR, [31:16] INDAT1, [15:14] DATPACK, [15:14] DATPACK, [15:14] DATPACK, [15:14] DATPACK, [15:14] DATPACK, [15:14] DATPACK, [13:12] DATMPX, [15:12] BKSCD, [13:12] DATMPX, [15:12] BKSCD, [13:12] DATMPX, [15:12] BKSCD, [13:12] DATMPX, [15:12] BKSCD, [13:12] DATMPX, [15:12] BKSCD, [13:12] DATMPX, [15:12] BKSCD, [8] CHINSEL, [31:8] OFFSET, [8] CHINSEL, [31:8] OFFSET, [8] CHINSEL, [31:8] OFFSET, [8] CHINSEL, [31:8] OFFSET, [8] CHINSEL, [31:8] OFFSET, [8] CHINSEL, [31:8] OFFSET, [7] CHEN, [7] CHEN, [7] CHEN, [7] CHEN, [7] CHEN, [7] CHEN, [6] CKABEN, [6] CKABEN, [6] CKABEN, [6] CKABEN, [6] CKABEN, [6] CKABEN, [5] SCDEN, [5] SCDEN, [5] SCDEN, [5] SCDEN, [5] SCDEN, [5] SCDEN, [7:3] DTRBS, [7:3] DTRBS, [7:3] DTRBS, [7:3] DTRBS, [7:3] DTRBS, [7:3] DTRBS, [3:2] SPICKSEL, [3:2] SPICKSEL, [3:2] SPICKSEL, [3:2] SPICKSEL, [3:2] SPICKSEL, [3:2] SPICKSEL, [1:0] SITP, [7:0] SCDT, [1:0] SITP, [15:0] INDAT0, [7:0] SCDT, [1:0] SITP, [15:0] INDAT0, [7:0] SCDT, [1:0] SITP, [15:0] INDAT0, [7:0] SCDT, [15:0] INDAT0, [1:0] SITP, [7:0] SCDT, [15:0] INDAT0, [1:0] SITP, [7:0] SCDT, [15:0] INDAT0
0x04 CHCFGR20
0x0C CHAWSCDR0
0x18 CHWDATAR0
0x20 CHCFGR11
0x24 CHCFGR21
0x28 CHDATINR0
0x2C CHAWSCDR1
0x38 CHWDATAR1
0x40 CHCFGR12
0x44 CHCFGR22
0x48 CHDATINR1
0x4C CHAWSCDR2
0x58 CHWDATAR2
0x60 CHCFGR13
0x64 CHCFGR23
0x68 CHDATINR2
0x6C CHAWSCDR3
0x78 CHWDATAR3
0x88 CHDATINR3
0x100 CHCFGR10
0x104 CHCFGR20
0x10C CHAWSCDR0
0x118 CHWDATAR0
0x128 CHDATINR0
0x180 CHCFGR11
0x184 CHCFGR21
0x18C CHAWSCDR1
0x198 CHWDATAR1
0x1A8 CHDATINR1

## GPIOA
Base 0x40020000
Same registers: GPIOB 0x40020400, GPIOC 0x40020800, GPIOD 0x40020C00, GPIOH 0x40021C00
0x00 MODER
  [n+16] BR{n} (n=0..15), [2n+1:2n] MODER{n} (n=0..15), [2n+1:2n] OSPEED{n} (n=0..15), [2n+1:2n] PUPD{n} (n=0..15), [4n-29:4n-32] AFSEL{n} (n=8..15), [n] OT{n} (n=0..15), [n] ID{n} (n=0..15), [n] OD{n} (n=0..15), [n] BS{n} (n=0..15)
0x04 OTYPER
0x08 OSPEEDR
0x0C PUPDR
0x10 IDR
0x14 ODR
0x18 BSRR
0x1C LCKR
0x20 AFR.0
0x24 AFR.1

## CRC
Base 0x40023000
0x00 DR
  [31:0] DR, [7:0] IDR, [0] RESET
0x04 IDR 8-bit
0x08 CR

## RCC
Base 0x40023800
0x00 CR
  [31] LPWRRSTF, [31] SSCGEN, [31] CKDFSDM1SEL, [31:30] MCO2, [30] WWDGRSTF, [30] SPREADSEL, [29] IWDGRSTF, [30:28] PLLR, [28] PWRRST, [28] PWREN, [28] PWRLPEN, [28] SFTRSTF, [30:28] PLLI2SR, [28] SDIOSEL, [27] PLLI2SRDY, [29:27] MCO2PRE, [27] PORRSTF, [28:27] I2S2SRC, [27] CK48MSEL, [26] PLLI2SON, [26] CAN2RST, [26] CAN2EN, [26] CAN2LPEN, [26] PINRSTF, [25] PLLRDY, [25] CAN1RST, [25] CAN1EN, [25] CAN1LPEN, [25] BORRSTF, [26:25] I2S1SRC, [24] PLLON, [27:24] PLLQ, [26:24] MCO1PRE, [24] FMPI2C1RST, [24] DFSDM1RST, [24] FMPI2C1EN, [24] DFSDM1EN, [24] FMPI2C1LPEN, [24] DFSDM1LPEN, [24] RMVF, [27:24] PLLI2SQ, [24] TIMPRE, [23] CSSC, [23] I2C3RST, [23] I2C3EN, [23] I2C3LPEN, [22] PLLSRC_HSE, [22] DMA2RST, [22] I2C2RST, [22] DMA2EN, [22] I2C2EN, [22] DMA2LPEN, [22] I2C2LPEN, [22] PLLI2SSRC, [23:22] FMPI2C1SEL, [22:21] MCO1, [21] PLLI2SRDYC, [21] DMA1RST, [21] I2C1RST, [21] DMA1EN, [21] I2C1EN, [21] DMA1LPEN, [21] I2C1LPEN, [20] PLLRDYC, [20] SPI5RST, [20] SPI5EN, [20] SPI5LPEN, [19] CSSON, [19] HSERDYC, [18] HSEBYP, [18] HSIRDYC, [18] USART3RST, [18] TIM11RST, [18] USART3EN, [18] TIM11EN, [18] USART3LPEN, [18] TIM11LPEN, [17] HSERDY, [17] LSERDYC, [17] USART2RST, [17] TIM10RST, [17] USART2EN, [17] TIM10EN, [17] USART2LPEN, [17] TIM10LPEN, [16] HSEON, [17:16] PLLP, [20:16] RTCPRE, [16] LSIRDYC, [16] TIM9RST, [16] TIM9EN, [16] SRAM1LPEN, [16] TIM9LPEN, [16] BDRST, [15] SPI3RST, [15] SPI3EN, [15] EXTITEN, [15] FLITFLPEN, [15] SPI3LPEN, [15] EXTITLPEN, [15] RTCEN, [15] CKDFSDM1ASEL, [14] SPI2RST, [14] SYSCFGRST, [14] SPI2EN, [14] SYSCFGEN, [14] SPI2LPEN, [14] SYSCFGLPEN, [15:13] PPRE2, [13] PLLI2SRDYIE, [13] SPI4RST, [13] SPI4EN, [13] SPI4LPEN, [27:13] INCSTEP, [12] PLLRDYIE, [12] CRCRST, [12] SPI1RST, [12] CRCEN, [12] SPI1EN, [12] CRCLPEN, [12] SPI1LPEN, [11] HSERDYIE, [11] WWDGRST, [11] SDIORST, [11] WWDGEN, [11] SDIOEN, [11] WWDGLPEN, [11] SDIOLPEN, [12:10] PPRE1, [10] HSIRDYIE, [10] RTCAPBEN, [10] RTCAPBLPEN, [9] LSERDYIE, [15:8] HSICAL, [8] LSIRDYIE, [8] TIM14RST, [8] ADCRST, [8] TIM14EN, [8] ADC1EN, [8] TIM14LPEN, [8] ADC1LPEN, [9:8] RTCSEL, [7] CSSF, [7] GPIOHRST, [7] OTGFSRST, [7] TIM13RST, [7] GPIOHEN, [7] OTGFSEN, [7] TIM13EN, [7] GPIOHLPEN, [7] OTGFSLPEN, [7] TIM13LPEN, [7] RCC_EVTCTL, [14:6] PLLN, [6] RNGRST, [6] TIM12RST, [6] RNGEN, [6] TIM12EN, [6] RNGLPEN, [6] TIM12LPEN, [14:6] PLLI2SN, [6] RCC_CKEN, [5] PLLI2SRDYF, [n-2] TIM{n}RST (n=2..7), [5] USART6RST, [n-2] TIM{n}EN (n=2..7), [5] USART6EN, [n-2] TIM{n}LPEN (n=2..7), [5] USART6LPEN, [5] FLITF_CKEN, [7:4] HPRE, [4] PLLRDYF, [4] USART1RST, [4] USART1EN, [4] USART1LPEN, [4] SRAM_CKEN, [7:3] HSITRIM, [3] HSERDYF, [3] GPIODRST, [3] GPIODEN, [3] GPIODLPEN, [3] LSEMOD, [3] SPARE_CKEN, [3:2] SWS, [2] HSIRDYF, [2] GPIOCRST, [2] GPIOCEN, [2] GPIOCLPEN, [2] LSEBYP, [2] CM4DBG_CKEN, [1] HSIRDY, [1] LSERDYF, [1] GPIOBRST, [1] QSPIRST, [1] TIM8RST, [1] GPIOBEN, [1] QSPIEN, [1] TIM8EN, [1] GPIOBLPEN, [1] QSPILPEN, [1] TIM8LPEN, [1] LSERDY, [1] LSIRDY, [1] AHB2APB2_CKEN, [0] HSION, [5:0] PLLM, [1:0] SW, [0] LSIRDYF, [0] GPIOARST, [0] FSMCRST, [0] TIM1RST, [0] GPIOAEN, [0] FSMCEN, [0] TIM1EN, [0] GPIOALPEN, [0] FSMCLPEN, [0] TIM1LPEN, [0] LSEON, [0] LSION, [12:0] MODPER, [5:0] PLLI2SM, [0] AHB2APB1_CKEN
0x04 PLLCFGR
0x08 CFGR
0x0C CIR
{0xC+4i} AHB{i}RSTR (i=1..3)
0x20 APB1RSTR
0x24 APB2RSTR
{0x2C+4i} AHB{i}ENR (i=1..3)
0x40 APB1ENR
0x44 APB2ENR
{0x4C+4i} AHB{i}LPENR (i=1..3)
0x60 APB1LPENR
0x64 APB2LPENR
0x70 BDCR
0x74 CSR
0x80 SSCGR
0x84 PLLI2SCFGR
0x8C DCKCFGR
0x90 CKGATENR
0x94 DCKCFGR2
