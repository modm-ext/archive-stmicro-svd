# STM32F412Rx register map
File version: 1.0
Registers are 32-bit, access not given, reset 0x0 unless marked. A register's access mark holds for its fields unless they carry their own. Offsets are from the block's base; [hi:lo] are bit positions; {n}, {i} and the like mark numbered series.

## FLASH
Base 0x40023C00
0x00 ACR
  [31] LOCK, [25] ERRIE, [24] EOPIE, [16] BSY, [16] STRT, [27:16] nWRP, [27:16] nWRP, [12] DCRST, [11] ICRST, [10] DCEN, [9] ICEN, [8] PRFTEN, [8] RDERR, [9:8] PSIZE, [15:8] RDP, [7] PGSERR, [7] nRST_STDBY, [6] PGPERR, [6] nRST_STOP, [5] PGAERR, [5] WDG_SW, [4] WRPERR, [7:3] SNB, [2] MER, [3:2] BOR_LEV, [1] SOP, [1] SER, [1] OPTSTRT, [2:0] LATENCY, [0] EOP, [0] PG, [0] OPTLOCK
0x04 KEYR
0x08 OPTKEYR
0x0C SR
0x10 CR
0x14 OPTCR
0x18 OPTCR1

## DMA1
Base 0x40026000
Same registers: DMA2 0x40026400
0x00 LISR
  [27] TCIF3, [27] TCIF7, [27] CTCIF3, [27] CTCIF7, [26] HTIF3, [26] HTIF7, [26] CHTIF3, [26] CHTIF7, [25] TEIF3, [25] TEIF7, [25] CTEIF3, [25] CTEIF7, [24] DMEIF3, [24] DMEIF7, [24] CDMEIF3, [24] CDMEIF7, [22] FEIF3, [22] FEIF7, [22] CFEIF3, [22] CFEIF7, [21] TCIF2, [21] TCIF6, [21] CTCIF2, [21] CTCIF6, [20] HTIF2, [20] HTIF6, [20] CHTIF2, [20] CHTIF6, [19] TEIF2, [19] TEIF6, [19] CTEIF2, [19] CTEIF6, [18] DMEIF2, [18] DMEIF6, [18] CDMEIF2, [18] CDMEIF6, [16] FEIF2, [16] FEIF6, [16] CFEIF2, [16] CFEIF6, [11] TCIF1, [11] TCIF5, [11] CTCIF1, [11] CTCIF5, [10] HTIF1, [10] HTIF5, [10] CHTIF1, [10] CHTIF5, [9] TEIF1, [9] TEIF5, [9] CTEIF1, [9] CTEIF5, [8] DMEIF1, [8] DMEIF5, [8] CDMEIF1, [8] CDMEIF5, [6] FEIF1, [6] FEIF5, [6] CFEIF1, [6] CFEIF5, [5] TCIF0, [5] TCIF4, [5] CTCIF0, [5] CTCIF4, [4] HTIF0, [4] HTIF4, [4] CHTIF0, [4] CHTIF4, [3] TEIF0, [3] TEIF4, [3] CTEIF0, [3] CTEIF4, [2] DMEIF0, [2] DMEIF4, [2] CDMEIF0, [2] CDMEIF4, [0] FEIF0, [0] FEIF4, [0] CFEIF0, [0] CFEIF4
0x04 HISR
0x08 LIFCR
0x0C HIFCR
{0x10+0x18*i} CR{i} (i=0..7)
{0x14+0x18*i} NDTR{i} (i=0..7)
{0x1C+0x18*i} PAR{i} (i=0..7)
{0x28+0x18*i} M0AR{i} (i=0..7)
{0x38+0x18*i} M1AR{i} (i=0..7)
{0x4C+0x18*i} FCR{i} (i=0..7)

## USB_OTG_FS
Base 0x50000000
0x00 GOTGCTL
  [31] CTXPKT, [31] AHBIDL, [31] WKUINT, [31] WUIM, [30] FDMOD, [30] DMAREQ, [30] SRQINT, [30] SRQIM, [29] FHMOD, [29] DISCINT, [29] DISCINT, [28] CIDSCHG, [28] CIDSCHGM, [28] ENBESL, [27] LPMINT, [27] LPMINTM, [26] PTXFE, [26] PTXFEM, [25] ULPIIPD, [25] HCINT, [25] HCIM, [27:25] LPMRCNTSTS, [24] PTCI, [24] HPRTINT, [24] PRTIM, [24] SNDLPM, [23] PCCI, [23] RSTDET, [23] RSTDETM, [22] TSDPS, [22] DATAFSUSP, [22] FSUSPM, [21] ULPIEVBUSI, [21] PXFR_INCOMPISOOUT, [21] PXFRM_IISOOXFRM, [21] VBDEN, [23:21] LPMRCNT, [20] OTGVER, [20] IDCHNG, [20] ULPIEVBUSD, [20] IISOIXFR, [20] IISOIXFRM, [20] SDEN, [19] BSESVLD, [19] DBCDNE, [19] ULPICSM, [19] OEPINT, [19] OEPINT, [19] PDEN, [18] ASVLD, [18] ADTOCHG, [18] ULPIAR, [18] IEPINT, [18] IEPINT, [18] DCDEN, [17] DBCT, [17] HNGDET, [17] ULPIFSLS, [17] EPMISM, [20:17] PKTSTS, [17] BCDEN, [20:17] LPMCHIDX, [16] CIDSTS, [16] PWRDWN, [16] L1RSMOK, [31:16] PTXFD, [31:16] INEPTXFD, [31:16] INEPTXFD, [31:16] INEPTXFD, [31:16] INEPTXFD, [31:16] INEPTXFD, [31:16] INEPTXFD, [31:16] INEPTXFD, [31:16] INEPTXFD, [31:16] INEPTXFD, [31:16] INEPTXFD, [31:16] INEPTXFD, [31:16] INEPTXFD, [31:16] INEPTXFD, [31:16] INEPTXFD, [31:16] INEPTXFD, [15] PHYLPCS, [15] EOPF, [15] EOPFM, [16:15] DPID, [15] SLPSTS, [14] ISOODRP, [14] ISOODRPM, [13] ENUMDNE, [13] ENUMDNEM, [14:13] LPMRSP, [12] EHEN, [12] USBRST, [12] USBRST, [12] L1DSEN, [11] DHNPEN, [11] USBSUSP, [11] USBSUSPM, [10] HSHNPEN, [13:10] TRDT, [10] ESUSP, [10] ESUSPM, [9] HNPRQ, [9] HNSSCHG, [9] HNPCAP, [8] HNGSCS, [8] SRSSCHG, [8] PTXFELVL, [8] SRPCAP, [11:8] BESLTHRS, [7] BVALOVAL, [7] TXFELVL, [7] BOUTNAKEFF, [7] GONAKEFFM, [7] L1SSEN, [6] BVALOEN, [6] PHYSEL, [10:6] TXFNUM, [6] GINAKEFF, [6] GINAKEFFM, [6] REMWAKE, [5] AVALOVAL, [5] DMAEN, [5] TXFFLSH, [5] NPTXFE, [5] NPTXFEM, [4] AVALOEN, [4] RXFFLSH, [4] RXFLVL, [4] RXFLVLM, [14:4] BCNT, [3] VBVALOVAL, [3] SOF, [3] SOFM, [3] PS2DET, [2] VBVALOEN, [2] SEDET, [2] FCRST, [2] OTGINT, [2] OTGINT, [2] SDET, [5:2] BESL, [1] SRQ, [4:1] HBSTLEN, [1] HSRST, [1] MMIS, [1] MMISM, [1] PDET, [1] LPMACK, [0] SRQSCS, [0] GINT, [2:0] TOCAL, [0] CSRST, [0] CMOD, [3:0] EPNUM, [15:0] RXFD, [0] DCDET, [31:0] PRODUCT_ID, [0] LPMEN, [15:0] PTXSA, [15:0] INEPTXSA, [15:0] INEPTXSA, [15:0] INEPTXSA, [15:0] INEPTXSA, [15:0] INEPTXSA, [15:0] INEPTXSA, [15:0] INEPTXSA, [15:0] INEPTXSA, [15:0] INEPTXSA, [15:0] INEPTXSA, [15:0] INEPTXSA, [15:0] INEPTXSA, [15:0] INEPTXSA, [15:0] INEPTXSA, [15:0] INEPTXSA
0x04 GOTGINT
0x08 GAHBCFG
0x0C GUSBCFG
0x10 GRSTCTL
0x14 GINTSTS
0x18 GINTMSK
0x1C GRXSTSR
0x20 GRXSTSP
0x24 GRXFSIZ
0x28 DIEPTXF0_HNPTXFSIZ
0x2C HNPTXSTS
0x38 GCCFG
0x3C CID
0x4C GHWCFG3
0x54 GLPMCFG
0x5C GDFIFOCFG
0x100 HPTXFSIZ
0x104 DIEPTXF.0
0x108 DIEPTXF.1
0x10C DIEPTXF.2
0x110 DIEPTXF.3
0x114 DIEPTXF.4
0x118 DIEPTXF.5
0x11C DIEPTXF.6
0x120 DIEPTXF.7
0x124 DIEPTXF.8
0x128 DIEPTXF.9
0x12C DIEPTXF.10
0x130 DIEPTXF.11
0x134 DIEPTXF.12
0x138 DIEPTXF.13
0x13C DIEPTXF.14

## RNG
Base 0x50060800
0x00 CR
  [6] SEIS, [5] CEIS, [3] IE, [2] RNGEN, [2] SECS, [1] CECS, [0] DRDY
0x04 SR
0x08 DR

## FSMC_Bank1
Base 0xA0000000
0x00 BTCR.0
0x04 BTCR.1
0x08 BTCR.2
0x0C BTCR.3
0x10 BTCR.4
0x14 BTCR.5
0x18 BTCR.6
0x1C BTCR.7

## FSMC_Bank1E
Base 0xA0000104
0x00 BWTR.0
  [29:28] ACCMOD, [29:28] ACCMOD, [29:28] ACCMOD, [29:28] ACCMOD, [19:16] BUSTURN, [19:16] BUSTURN, [19:16] BUSTURN, [19:16] BUSTURN, [15:8] DATAST, [15:8] DATAST, [15:8] DATAST, [15:8] DATAST, [7:4] ADDHLD, [7:4] ADDHLD, [7:4] ADDHLD, [7:4] ADDHLD, [3:0] ADDSET, [3:0] ADDSET, [3:0] ADDSET, [3:0] ADDSET
0x04 BWTR.1
0x08 BWTR.2
0x0C BWTR.3
0x10 BWTR.4
0x14 BWTR.5
0x18 BWTR.6

## QUADSPI
Base 0xA0001000
0x00 CR
  [31] DDRM, [30] DHHC, [28] SIOO, [27:26] FMODE, [31:24] PRESCALER, [25:24] DMODE, [23] PMM, [22] APMS, [20] TOIE, [19] SMIE, [18] FTIE, [22:18] DCYC, [17] TCIE, [16] TEIE, [20:16] FSIZE, [17:16] ABSIZE, [15:14] ABMODE, [13:12] ADSIZE, [11:10] ADMODE, [12:8] FTHRES, [10:8] CSHT, [13:8] FLEVEL, [9:8] IMODE, [7] FSEL, [6] DFM, [5] BUSY, [4] SSHIFT, [4] TOF, [4] CTOF, [3] TCEN, [3] SMF, [3] CSMF, [2] DMAEN, [2] FTF, [1] ABORT, [1] TCF, [1] CTCF, [0] EN, [0] CKMODE, [0] TEF, [0] CTEF, [31:0] DL, [7:0] INSTRUCTION, [31:0] ADDRESS, [31:0] ALTERNATE, [31:0] DATA, [31:0] MASK, [31:0] MATCH, [15:0] INTERVAL, [15:0] TIMEOUT
0x04 DCR
0x08 SR
0x0C FCR
0x10 DLR
0x14 CCR
0x18 AR
0x1C ABR
0x20 DR
0x24 PSMKR
0x28 PSMAR
0x2C PIR
0x30 LPTR

## DBGMCU
Base 0xE0042000
0x00 IDCODE
  [26] DBG_CAN2_STOP, [25] DBG_CAN1_STOP, [n+20] DBG_I2C{n}_SMBUS_TIMEOUT (n=1..4), [18] DBG_TIM11_STOP, [17] DBG_TIM10_STOP, [31:16] REV_ID, [16] DBG_TIM9_STOP, [12] DBG_IWDG_STOP, [11] DBG_WWDG_STOP, [10] DBG_RTC_STOP, [8] DBG_TIM14_STOP, [7] DBG_TIM13_STOP, [7:6] TRACE_MODE, [6] DBG_TIM12_STOP, [5] TRACE_IOEN, [n-2] DBG_TIM{n}_STOP (n=2..7), [2] DBG_STANDBY, [1] DBG_STOP, [1] DBG_TIM8_STOP, [11:0] DEV_ID, [0] DBG_SLEEP, [0] DBG_TIM1_STOP
0x04 CR
0x08 APB1FZ
0x0C APB2FZ
