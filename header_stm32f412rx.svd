# STM32F412Rx register map
File version: 1.0
Registers are 32-bit, access not given, reset 0x0 unless marked. A register's access mark holds for its fields unless they carry their own. Offsets are from the block's base; [hi:lo] are bit positions; {n}, {i} and the like mark numbered series.

## WWDG
Base 0x40002C00
0x00 CR
  [9] EWI, [7] WDGA, [8:7] WDGTB, [6:0] T, [6:0] W, [0] EWIF
0x04 CFR
0x08 SR

## IWDG
Base 0x40003000
0x00 KR
  [1] RVU, [15:0] KEY, [2:0] PR, [11:0] RL, [0] PVU
0x04 PR
0x08 RLR
0x0C SR

## I2S2ext
Base 0x40003400
Same registers: SPI2 0x40003800, SPI3 0x40003C00, I2S3ext 0x40004000, SPI1 0x40013000, SPI4 0x40013400, SPI5 0x40015000
0x00 CR1
  [15] BIDIMODE, [14] BIDIOE, [13] CRCEN, [12] CRCNEXT, [12] ASTRTEN, [11] DFF, [11] I2SMOD, [10] RXONLY, [10] I2SE, [9] SSM, [9] MCKOE, [8] SSI, [8] FRE, [9:8] I2SCFG, [8] ODD, [7] LSBFIRST, [7] TXEIE, [7] BSY, [7] PCMSYNC, [6] SPE, [6] RXNEIE, [6] OVR, [5] ERRIE, [5] MODF, [4] FRF, [4] CRCERR, [5:4] I2SSTD, [5:3] BR, [3] UDR, [3] CKPOL, [2] MSTR, [2] SSOE, [2] CHSIDE, [1] CPOL, [1] TXDMAEN, [1] TXE, [2:1] DATLEN, [0] CPHA, [0] RXDMAEN, [0] RXNE, [15:0] DR, [15:0] CRCPOLY, [15:0] RXCRC, [15:0] TXCRC, [0] CHLEN, [7:0] I2SDIV
0x04 CR2
0x08 SR
0x0C DR
0x10 CRCPR
0x14 RXCRCR
0x18 TXCRCR
0x1C I2SCFGR
0x20 I2SPR

## USART2
Base 0x40004400
Same registers: USART3 0x40004800, USART1 0x40011000, USART6 0x40011400
0x00 SR
  [15] OVER8, [14] LINEN, [13] UE, [12] M, [13:12] STOP, [11] WAKE, [11] CLKEN, [11] ONEBIT, [10] PCE, [10] CPOL, [10] CTSIE, [9] CTS, [9] PS, [9] CPHA, [9] CTSE, [8] LBD, [8] PEIE, [8] LBCL, [8] RTSE, [15:8] GT, [7] TXE, [7] TXEIE, [7] DMAT, [6] TC, [6] TCIE, [6] LBDIE, [6] DMAR, [5] RXNE, [5] RXNEIE, [5] LBDL, [5] SCEN, [4] IDLE, [15:4] DIV_Mantissa, [4] IDLEIE, [4] NACK, [3] ORE, [3] TE, [3] HDSEL, [2] NE, [2] RE, [2] IRLP, [1] FE, [1] RWU, [1] IREN, [0] PE, [8:0] DR, [3:0] DIV_Fraction, [0] SBK, [3:0] ADD, [0] EIE, [7:0] PSC
0x04 DR
0x08 BRR
{0x8+4i} CR{i} (i=1..3)
0x18 GTPR

## I2C1
Base 0x40005400
Same registers: I2C2 0x40005800, I2C3 0x40005C00
0x00 CR1
  [15] SWRST, [15] ADDMODE, [15] SMBALERT, [15] FS, [14] TIMEOUT, [14] DUTY, [13] ALERT, [12] PEC, [12] LAST, [12] PECERR, [11] POS, [11] DMAEN, [11] OVR, [10] ACK, [10] ITBUFEN, [10] AF, [9] STOP, [9] ITEVTEN, [n] ADD{n} (n=0..9), [9] ARLO, [8] START, [8] ITERREN, [8] BERR, [15:8] PEC, [7] NOSTRETCH, [7] TXE, [7] DUALF, [6] ENGC, [6] RXNE, [6] SMBHOST, [5] ENPEC, [5] SMBDEFAULT, [4] ENARP, [4] STOPF, [4] GENCALL, [4] ANOFF, [3] SMBTYPE, [3] ADD10, [2] BTF, [2] TRA, [1] SMBUS, [7:1] ADD2, [1] ADDR, [1] BUSY, [0] PE, [5:0] FREQ, [0] ENDUAL, [7:0] DR, [0] SB, [0] MSL, [11:0] CCR, [5:0] TRISE, [3:0] DNF
0x04 CR2
0x08 OAR1
0x0C OAR2
0x10 DR
0x14 SR1
0x18 SR2
0x1C CCR
0x20 TRISE
0x24 FLTR

## FMPI2C1
Base 0x40006000
0x00 CR1
  [31] TEXTEN, [31:28] PRESC, [26] PECBYTE, [25] AUTOEND, [24] RELOAD, [23] PECEN, [22] ALERTEN, [21] SMBDEN, [20] SMBHEN, [23:20] SCLDEL, [19] GCEN, [17] NOSTRETCH, [23:17] ADDCODE, [16] SBC, [23:16] NBYTES, [19:16] SDADEL, [27:16] TIMEOUTB, [16] DIR, [15] RXDMAEN, [15] NACK, [15] OA1EN, [15] OA2EN, [15] TIMOUTEN, [15] BUSY, [14] TXDMAEN, [14] STOP, [13] START, [13] ALERT, [13] ALERTCF, [12] ANFOFF, [12] HEAD10R, [12] TIDLE, [12] TIMEOUT, [12] TIMOUTCF, [11] ADD10, [11] PECERR, [11] PECCF, [10] RD_WRN, [10] OA1MODE, [10] OVR, [10] OVRCF, [9] ARLO, [9] ARLOCF, [11:8] DNF, [10:8] OA2MSK, [15:8] SCLH, [8] BERR, [8] BERRCF, [7] ERRIE, [7] TCR, [6] TCIE, [6] TC, [5] STOPIE, [5] STOPF, [5] STOPCF, [4] NACKIE, [4] NACKF, [4] NACKCF, [3] ADDRIE, [3] ADDR, [3] ADDRCF, [2] RXIE, [2] RXNE, [1] TXIE, [7:1] OA2, [1] TXIS, [0] PE, [9:0] SADD, [9:0] OA1, [7:0] SCLL, [11:0] TIMEOUTA, [0] TXE, [7:0] PEC, [7:0] RXDATA, [7:0] TXDATA
0x04 CR2
0x08 OAR1
0x0C OAR2
0x10 TIMINGR
0x14 TIMEOUTR
0x18 ISR
0x1C ICR
0x20 PECR
0x24 RXDR
0x28 TXDR

## PWR
Base 0x40007000
0x00 CR
  [21] FISSR, [20] FMSSR, [15:14] VOS, [14] VOSRDY, [13] ADCDC1, [11] MRLVDS, [10] LPLVDS, [9] FPDS, [9] BRE, [8] DBP, [8] EWUP1, [7] EWUP2, [8:6] EWUP3, [7:5] PLS, [4] PVDE, [3] CSBF, [3] BRR, [2] CWUF, [2] PVDO, [1] PDDS, [1] SBF, [0] LPDS, [0] WUF
0x04 CSR
