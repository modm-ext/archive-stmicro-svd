# STM32H755xx register map
File version: 1.0
Registers are 32-bit, access not given, reset 0x0 unless marked. A register's access mark holds for its fields unless they carry their own. Offsets are from the block's base; [hi:lo] are bit positions; {n}, {i} and the like mark numbered series.

## DMA1
Base 0x40020000
Same registers: DMA2 0x40020400
0x00 LISR
  [27] TCIF3, [27] TCIF7, [27] CTCIF3, [27] CTCIF7, [26] HTIF3, [26] HTIF7, [26] CHTIF3, [26] CHTIF7, [25] TEIF3, [25] TEIF7, [25] CTEIF3, [25] CTEIF7, [24] DMEIF3, [24] DMEIF7, [24] CDMEIF3, [24] CDMEIF7, [22] FEIF3, [22] FEIF7, [22] CFEIF3, [22] CFEIF7, [21] TCIF2, [21] TCIF6, [21] CTCIF2, [21] CTCIF6, [20] HTIF2, [20] HTIF6, [20] CHTIF2, [20] CHTIF6, [19] TEIF2, [19] TEIF6, [19] CTEIF2, [19] CTEIF6, [18] DMEIF2, [18] DMEIF6, [18] CDMEIF2, [18] CDMEIF6, [16] FEIF2, [16] FEIF6, [16] CFEIF2, [16] CFEIF6, [11] TCIF1, [11] TCIF5, [11] CTCIF1, [11] CTCIF5, [10] HTIF1, [10] HTIF5, [10] CHTIF1, [10] CHTIF5, [9] TEIF1, [9] TEIF5, [9] CTEIF1, [9] CTEIF5, [8] DMEIF1, [8] DMEIF5, [8] CDMEIF1, [8] CDMEIF5, [6] FEIF1, [6] FEIF5, [6] CFEIF1, [6] CFEIF5, [5] TCIF0, [5] TCIF4, [5] CTCIF0, [5] CTCIF4, [4] HTIF0, [4] HTIF4, [4] CHTIF0, [4] CHTIF4, [3] TEIF0, [3] TEIF4, [3] CTEIF0, [3] CTEIF4, [2] DMEIF0, [2] DMEIF4, [2] CDMEIF0, [2] CDMEIF4, [0] FEIF0, [0] FEIF4, [0] CFEIF0, [0] CFEIF4
0x04 HISR
0x08 LIFCR
0x0C HIFCR
{0x10+0x18*i} CR{i} (i=0..7)
{0x14+0x18*i} NDTR{i} (i=0..7)
{0x1C+0x18*i} PAR{i} (i=0..7)
{0x28+0x18*i} M0AR{i} (i=0..7)
{0x38+0x18*i} M1AR{i} (i=0..7)
{0x4C+0x18*i} FCR{i} (i=0..7)

## DMAMUX1
Base 0x40020800
Same registers: DMAMUX2 0x58025800
0x00 CCR0
0x04 CCR1
0x08 CCR2
0x0C CCR3
0x10 CCR4
0x14 CCR5
0x18 CCR6
0x1C CCR7
0x20 CCR8
0x24 CCR9
0x28 CCR0
0x2C CCR1
0x30 CCR2
0x34 CCR3
0x38 CCR4
0x3C CCR5
0x80 CCRs
0x100 CCR0
0x104 CCR1
0x108 CCR2
0x10C CCR3
0x110 CCR4
0x114 CCR5
0x118 CCR6
0x11C CCR7
0x140 CCRs
0x18005000 CCR0

## ADC1
Base 0x40022000
Same registers: ADC2 0x40022100, ADC3 0x58026000
0x00 ISR
  [31] ADCAL, [31] JQDIS, [31] SSATE, [31] SSATE, [31] SSATE, [31] SSATE, [30] ADCALDIF, [29] DEEPPWD, [28] ADVREGEN, [31:28] LSHIFT, [n+21] LINCALRDYW{n} (n=1..6), [3n+2:3n] SMP{n} (n=0..9), [3n-28:3n-30] SMP{n} (n=10..19), [6n+7:6n+3] JSQ{n} (n=1..4), [30:26] AWD1CH, [30:26] OFFSET{n}_CH (n=1..4), [25] JAUTO, [24] JAWD1EN, [6n+4:6n] SQ{n} (n=1..4), [6n-26:6n-30] SQ{n} (n=5..9), [6n-56:6n-60] SQ{n} (n=10..14), [23] AWD1EN, [22] AWD1SGL, [21] JQM, [20] JDISCEN, [19:17] DISCNUM, [16] ADCALLIN, [16] DISCEN, [25:16] OVSR, [26:16] CALFACT_D, [14] AUTDLY, [n+10] RSHIFT{n} (n=1..4), [13] CONT, [12] LDORDY, [12] OVRMOD, [10] JQOVF, [10] JQOVFIE, [11:10] EXTEN, [10] ROVSM, [9] AWD3, [9] AWD3IE, [9] TROVS, [8] AWD2, [8] AWD2IE, [9:8] BOOST, [7] AWD1, [7] AWD1IE, [8:7] JEXTEN, [6] JEOS, [6] JEOSIE, [10:6] SQ16, [5] JEOC, [5] JEOCIE, [5] JADSTP, [9:5] EXTSEL, [8:5] OVSS, [4] OVR, [4] OVRIE, [4] ADSTP, [3] EOS, [3] EOSIE, [3] JADSTART, [2] EOC, [2] EOCIE, [2] ADSTART, [4:2] RES, [6:2] JEXTSEL, [1] EOSMP, [1] EOSMPIE, [1] ADDIS, [1] JOVSE, [0] ADRDY, [0] ADRDYIE, [0] ADEN, [1:0] DMNGT, [0] ROVSE, [19:0] PCSEL, [3:0] L, [4:0] SQ15, [31:0] RDATA, [1:0] JL, [25:0] OFFSET{n} (n=1..4), [31:0] JDATA, [31:0] JDATA, [31:0] JDATA, [31:0] JDATA, [19:0] AWD2CH, [19:0] AWD3CH, [19:0] DIFSEL, [10:0] CALFACT_S, [29:0] LINCALFACT
0x04 IER
0x08 CR
0x0C CFGR
0x10 CFGR2
0x14 SMPR1
0x18 SMPR2
0x1C PCSEL
0x20 LTR1
0x24 HTR1
{0x2C+4i} SQR{i} (i=1..4)
0x40 DR
0x4C JSQR
{0x5C+4i} OFR{i} (i=1..4)
{0x7C+4i} JDR{i} (i=1..4)
0xA0 AWD2CR
0xA4 AWD3CR
0xB0 LTR2
0xB4 HTR2
0xB8 LTR3
0xBC HTR3
0xC0 DIFSEL
0xC4 CALFACT
0xC8 CALFACT2

## ADC12_COMMON
Base 0x40022300
Same registers: ADC3_COMMON 0x58026300
0x00 CSR
  [26] JQOVF_SLV, [25] AWD3_SLV, [24] AWD2_SLV, [24] VBATEN, [23] AWD1_SLV, [23] TSEN, [22] JEOS_SLV, [22] VREFEN, [21] JEOC_SLV, [20] OVR_SLV, [19] EOS_SLV, [18] EOC_SLV, [21:18] PRESC, [17] EOSMP_SLV, [16] ADRDY_SLV, [17:16] CKMODE, [31:16] RDATA_SLV, [15:14] DAMDF, [10] JQOVF_MST, [9] AWD3_MST, [8] AWD2_MST, [11:8] DELAY, [7] AWD1_MST, [6] JEOS_MST, [5] JEOC_MST, [4] OVR_MST, [3] EOS_MST, [2] EOC_MST, [1] EOSMP_MST, [0] ADRDY_MST, [4:0] DUAL, [15:0] RDATA_MST, [31:0] RDATA_ALT
0x08 CCR
0x0C CDR
0x10 CDR2
