# STM32H755xx register map
File version: 1.0
Registers are 32-bit, access not given, reset 0x0 unless marked. A register's access mark holds for its fields unless they carry their own. Offsets are from the block's base; [hi:lo] are bit positions; {n}, {i} and the like mark numbered series.

## EXTI_D1
Base 0x58000080
Same registers: EXTI_D2 0x580000C0
0x00 IMR1
  [n] IM{n} (n=0..31), [n] EM{n} (n=20..31), [n-32] IM{n} (n=46..63), [n-32] EM{n} (n=46..63), [n-64] IM{n} (n=84..87), [n-64] EM{n} (n=84..87), [22] PR86, [n] PR{n} (n=0..21), [21] PR85, [20] PR84, [19] PR51, [n] EM{n} (n=0..18), [18] IM82, [n-64] EM{n} (n=64..82), [18] PR82, [17] PR49, [n-64] IM{n} (n=64..80), [n-32] IM{n} (n=32..44), [n-32] EM{n} (n=32..44)
0x04 EMR1
0x08 PR1
0x10 IMR2
0x14 EMR2
0x18 PR2
0x20 IMR3
0x24 EMR3
0x28 PR3

## SYSCFG
Base 0x58000400
0x04 PMCR
  [27] PC3SO, [26] PC2SO, [25] PA1SO, [24] PA0SO, [23:21] EPIS_SEL, [16] HSLV, [23:16] RDP, [16] BCM7, [31:16] BCM7_ADD0, [31:16] BCM4_ADD0, [16] MEPAD_BANK1, [23:16] WRPN_BANK1, [27:16] PAEND_BANK1, [27:16] SAEND_BANK1, [16] MESAD_BANK2, [27:16] PABEG_BANK2, [27:16] SABEG_BANK2, [16] IWDG1M, [16] SECURE, [16] D1SBRST, [16] D2SBRST, [16] FZIWDGSTB, [16] PKP, [15] AXISRAML, [14] ITCML, [13] DTCML, [4n+3:4n] EXTI{n} (n=0..3), [4n-13:4n-16] EXTI{n} (n=4..7), [4n-29:4n-32] EXTI{n} (n=8..11), [4n-45:4n-48] EXTI{n} (n=12..15), [13-n] SRAM{n}L (n=1..4), [9] BOOSTVDDSEL, [8] BOOSTEN, [8] READY, [n-2] I2C_PB{n}_FMP (n=6..9), [7] BKRAML, [6] CM7L, [7:4] PCV, [7:4] PCC, [n-1] I2C{n}_FMP (n=1..4), [3] FLASHL, [2] PVDL, [1] CS, [0] CM4L, [0] EN, [3:0] NCV, [3:0] NCC, [0] ODEN, [3:0] PKG, [0] BKS, [0] BCM4, [1:0] BORH, [15:0] BCM7_ADD1, [15:0] BCM4_ADD1, [0] MESAD_BANK1, [11:0] PABEG_BANK1, [11:0] SABEG_BANK1, [0] MEPAD_BANK2, [7:0] WRPN_BANK2, [11:0] PAEND_BANK2, [11:0] SAEND_BANK2, [0] IWDG2M, [1:0] SDRS, [0] D1STPRST, [0] D2STPRST, [0] FZIWDGSTP, [0] IOHSLV
0x08 EXTICR.0
0x0C EXTICR.1
0x10 EXTICR.2
0x14 EXTICR.3
0x18 CFGR
0x20 CCCSR
0x24 CCVR
0x28 CCCR
0x2C PWRCR
0x124 PKGR
{0x300+4i} UR{i} (i=0..17)

## COMP12
Base 0x58003800
0x00 SR
0x04 ICFR
0x08 OR

## COMP1
Base 0x5800380C
Same registers: COMP2 0x58003810, COMP12_COMMON 0x58003810
0x00 CFGR

## VREFBUF
Base 0x58003C00
0x00 CSR
  [5] VRS_OUT3, [5:4] VRS_OUT4, [3] VRR, [1] HIZ, [0] ENVR, [5:0] TRIM
0x04 CCR

## RTC
Base 0x58004000
0x00 TR
  [31] MSK4, [31] MSK4, [31] ADD1S, [30] WDSEL, [30] WDSEL, [29:28] DT, [29:28] DT, [24] ITSE, [27:24] DU, [27:24] DU, [24] TAMP3MF, [27:24] MASKSS, [27:24] MASKSS, [23] COE, [23] MSK3, [23] MSK3, [23] TAMP3NOERASE, [22] PM, [22] PM, [22] PM, [22] PM, [22] TAMP3IE, [22:21] OSEL, [21] TAMP2MF, [21:20] HT, [23:20] YT, [20] POL, [21:20] HT, [21:20] HT, [21:20] HT, [20] TAMP2NOERASE, [19] COSEL, [19] TAMP2IE, [18] BKP, [18] TAMP1MF, [17] SUB1H, [17] ITSF, [17] TAMP1NOERASE, [19:16] HU, [19:16] YU, [16] ADD1H, [16] RECALPF, [22:16] PREDIV_A, [19:16] HU, [19:16] HU, [19:16] HU, [16] TAMP1IE, [15] TSIE, [15] TAMP3F, [15] MSK2, [15] MSK2, [15] CALP, [15] TAMPPUDIS, [14] WUTIE, [14] TAMP2F, [14] CALW8, [15:13] WDU, [13] ALRBIE, [13] TAMP1F, [15:13] WDU, [13] CALW16, [14:13] TAMPPRCH, [14:12] MNT, [12] MT, [12] ALRAIE, [12] TSOVF, [14:12] MNT, [14:12] MNT, [14:12] MNT, [12] MT, [11] TSE, [11] TSF, [12:11] TAMPFLT, [10] WUTE, [10] WUTF, [9] ALRBE, [9] ALRBF, [11:8] MNU, [11:8] MU, [8] ALRAE, [8] ALRAF, [11:8] MNU, [11:8] MNU, [11:8] MNU, [11:8] MU, [10:8] TAMPFREQ, [7] INIT, [7] MSK1, [7] MSK1, [7] TAMPTS, [6] FMT, [6] INITF, [6] TAMP3TRG, [5] BYPSHAD, [5] RSF, [5] TAMP3E, [6:4] ST, [5:4] DT, [4] REFCKON, [4] INITS, [6:4] ST, [6:4] ST, [6:4] ST, [5:4] DT, [4] TAMP2TRG, [3] TSEDGE, [3] SHPF, [3] TAMP2E, [2] WUTWF, [2] TAMPIE, [1] ALRBWF, [1] TAMP1TRG, [1] OUT_RMP, [3:0] SU, [3:0] DU, [2:0] WUCKSEL, [0] ALRAWF, [14:0] PREDIV_S, [15:0] WUT, [3:0] SU, [3:0] SU, [7:0] KEY, [15:0] SS, [14:0] SUBFS, [3:0] SU, [3:0] DU, [15:0] SS, [8:0] CALM, [0] TAMP1E, [14:0] SS, [14:0] SS, [0] ALARMOUTTYPE
0x04 DR
0x08 CR
0x0C ISR
0x10 PRER
0x14 WUTR
0x1C ALRMAR
0x20 ALRMBR
0x24 WPR
0x28 SSR
0x2C SHIFTR
0x30 TSTR
0x34 TSDR
0x38 TSSSR
0x3C CALR
0x40 TAMPCR
0x44 ALRMASSR
0x48 ALRMBSSR
0x4C OR
{0x50+4i} BKP{i}R (i=0..31)
