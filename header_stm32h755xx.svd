# STM32H755xx register map
File version: 1.0
Registers are 32-bit, access not given, reset 0x0 unless marked. A register's access mark holds for its fields unless they carry their own. Offsets are from the block's base; [hi:lo] are bit positions; {n}, {i} and the like mark numbered series.

## IWDG1
Base 0x58004800
Same registers: IWDG2 0x58004C00
0x00 KR
  [2] WVU, [1] RVU, [15:0] KEY, [2:0] PR, [11:0] RL, [0] PVU, [11:0] WIN
0x04 PR
0x08 RLR
0x0C SR
0x10 WINR

## GPIOA
Base 0x58020000
Same registers: GPIOB 0x58020400, GPIOC 0x58020800, GPIOD 0x58020C00, GPIOE 0x58021000, GPIOF 0x58021400, GPIOG 0x58021800, GPIOH 0x58021C00, GPIOI 0x58022000, GPIOJ 0x58022400, GPIOK 0x58022800
0x00 MODER
  [n+16] BR{n} (n=0..15), [2n+1:2n] MODE{n} (n=0..15), [2n+1:2n] OSPEED{n} (n=0..15), [2n+1:2n] PUPD{n} (n=0..15), [4n+3:4n] AFSEL{n} (n=0..7), [4n-29:4n-32] AFSEL{n} (n=8..15), [16] LCKK, [n] OT{n} (n=0..15), [n] ID{n} (n=0..15), [n] OD{n} (n=0..15), [n] BS{n} (n=0..15), [n] LCK{n} (n=0..15)
0x04 OTYPER
0x08 OSPEEDR
0x0C PUPDR
0x10 IDR
0x14 ODR
0x18 BSRR
0x1C LCKR
0x20 AFR.0
0x24 AFR.1

## RCC_C1
Base 0x58024530
Same registers: RCC_C2 0x58024590
0x00 RSR
  [31] LPWR2RSTF, [31] D1SRAM1EN, [31] SRAM3EN, [31] UART8EN, [31] AXISRAMLPEN, [31] SRAM3LPEN, [31] UART8LPEN, [30] LPWR1RSTF, [30] ITCMEN, [30] SRAM2EN, [30] UART7EN, [30] ITCMLPEN, [30] SRAM2LPEN, [30] UART7LPEN, [29] WWDG2RSTF, [29] DTCM2EN, [29] SRAM1EN, [29] DAC12EN, [29] HRTIMEN, [29] DTCM2LPEN, [29] SRAM1LPEN, [29] SRAM4LPEN, [29] DAC12LPEN, [29] HRTIMLPEN, [28] WWDG1RSTF, [28] DTCM1EN, [28] USB2OTGHSULPIEN, [28] BKPRAMEN, [28] DFSDM1EN, [28] DTCM1LPEN, [28] USB2OTGHSULPILPEN, [28] BKPRAMLPEN, [28] DFSDM1LPEN, [27] IWDG2RSTF, [27] USB2OTGHSEN, [27] HDMICECEN, [27] USB2OTGHSLPEN, [27] HDMICECEN, [26] IWDG1RSTF, [26] USB1OTGHSULPIEN, [26] USB1OTGHSULPILPEN, [25] SFT2RSTF, [25] USB1OTGHSEN, [25] HSEMEN, [25] USB1OTGHSLPEN, [24] SFT1RSTF, [24] ADC3EN, [24] SAI3EN, [24] ADC3LPEN, [24] SAI3LPEN, [23] PORRSTF, [23] I2C3EN, [23] SAI2EN, [23] I2C3LPEN, [23] SAI2LPEN, [22] PINRSTF, [22] I2C2EN, [22] SAI1EN, [22] I2C2LPEN, [22] SAI1LPEN, [21] BORRSTF, [21] BDMAEN, [21] I2C1EN, [21] SAI4EN, [21] BDMALPEN, [21] I2C1LPEN, [21] SAI4LPEN, [20] D2RSTF, [20] UART5EN, [20] SPI5EN, [20] UART5LPEN, [20] SPI5LPEN, [19] D1RSTF, [19] CRCEN, [19] UART4EN, [19] CRCLPEN, [19] UART4LPEN, [18] C2RSTF, [18] USART3EN, [18] TIM17EN, [18] USART3LPEN, [18] TIM17LPEN, [17] C1RSTF, [17] ETH1RXEN, [17] USART2EN, [17] TIM16EN, [17] ETH1RXLPEN, [17] USART2LPEN, [17] TIM16LPEN, [16] RMVF, [16] SDMMC1EN, [16] ETH1TXEN, [16] SPDIFRXEN, [16] TIM15EN, [16] RTCAPBEN, [16] SDMMC1LPEN, [16] ETH1TXLPEN, [16] SPDIFRXLPEN, [16] TIM15LPEN, [16] RTCAPBLPEN, [15] ETH1MACEN, [15] SPI3EN, [15] VREFEN, [15] ETH1MACLPEN, [15] SPI3LPEN, [15] VREFLPEN, [14] QSPIEN, [14] ARTEN, [14] SPI2EN, [14] COMP12EN, [14] QSPILPEN, [14] ARTLPEN, [14] SPI2LPEN, [14] COMP12LPEN, [13] SPI4EN, [13] SPI4LPEN, [12] FMCEN, [12] SPI1EN, [n+7] LPTIM{n}EN (n=2..5), [12] FMCLPEN, [12] SPI1LPEN, [n+7] LPTIM{n}LPEN (n=2..5), [11] WWDG2EN, [11] WWDG2LPEN, [10] GPIOKEN, [10] GPIOKLPEN, [9] SDMMC2EN, [9] GPIOJEN, [9] LPTIM1EN, [9] SDMMC2LPEN, [9] GPIOJLPEN, [9] LPTIM1LPEN, [8] FLASHEN, [8] GPIOIEN, [8] TIM14EN, [8] FDCANEN, [8] FLASHLPEN, [8] GPIOILPEN, [8] TIM14LPEN, [8] FDCANLPEN, [7] GPIOHEN, [7] TIM13EN, [7] I2C4EN, [7] GPIOHLPEN, [7] TIM13LPEN, [7] I2C4LPEN, [6] RNGEN, [6] GPIOGEN, [6] WWDG1EN, [6] TIM12EN, [6] RNGLPEN, [6] GPIOGLPEN, [6] WWDG1LPEN, [6] TIM12LPEN, [5] JPGDECEN, [5] ADC12EN, [5] HASHEN, [5] GPIOFEN, [n-2] TIM{n}EN (n=2..7), [5] MDIOSEN, [5] USART6EN, [5] SPI6EN, [5] JPGDECLPEN, [5] ADC12LPEN, [5] HASHLPEN, [5] GPIOFLPEN, [n-2] TIM{n}LPEN (n=2..7), [5] MDIOSLPEN, [5] USART6LPEN, [5] SPI6LPEN, [4] DMA2DEN, [4] CRYPEN, [4] GPIOEEN, [4] OPAMPEN, [4] USART1EN, [4] DMA2DLPEN, [4] CRYPLPEN, [4] GPIOELPEN, [4] OPAMPLPEN, [4] USART1LPEN, [3] GPIODEN, [3] LTDCEN, [3] LPUART1EN, [3] GPIODLPEN, [3] LTDCLPEN, [3] LPUART1LPEN, [2] GPIOCEN, [2] SWPMIEN, [2] GPIOCLPEN, [2] SWPMILPEN, [1] DMA2EN, [1] GPIOBEN, [1] CRSEN, [1] TIM8EN, [1] SYSCFGEN, [1] DMA2LPEN, [1] GPIOBLPEN, [1] CRSLPEN, [1] TIM8LPEN, [1] SYSCFGLPEN, [0] MDMAEN, [0] DMA1EN, [0] DCMIEN, [0] GPIOAEN, [0] TIM1EN, [0] MDMALPEN, [0] DMA1LPEN, [0] DCMILPEN, [0] GPIOALPEN, [0] TIM1LPEN
0x04 AHB3ENR
0x08 AHB1ENR
0x0C AHB2ENR
0x10 AHB4ENR
0x14 APB3ENR
0x18 APB1LENR
0x1C APB1HENR
0x20 APB2ENR
0x24 APB4ENR
0x2C AHB3LPENR
0x30 AHB1LPENR
0x34 AHB2LPENR
0x38 AHB4LPENR
0x3C APB3LPENR
0x40 APB1LLPENR
0x44 APB1HLPENR
0x48 APB2LPENR
0x4C APB4LPENR
