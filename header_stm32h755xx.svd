# STM32H755xx register map
File version: 1.0
Registers are 32-bit, access not given, reset 0x0 unless marked. A register's access mark holds for its fields unless they carry their own. Offsets are from the block's base; [hi:lo] are bit positions; {n}, {i} and the like mark numbered series.

## RCC
Base 0x58024400
0x00 CR
  [31] SWPSEL, [31] UART8RST, [31] LPWR2RSTF, [31] D1SRAM1EN, [31] SRAM3EN, [31] UART8EN, [31] AXISRAMLPEN, [31] SRAM3LPEN, [31] UART8LPEN, [30] UART7RST, [30] LPWR1RSTF, [30] ITCMEN, [30] SRAM2EN, [30] UART7EN, [30] ITCMLPEN, [30] SRAM2LPEN, [30] UART7LPEN, [29] PLL3RDY, [31:29] MCO2, [29] DAC12RST, [29] HRTIMRST, [29] SRAM4AMEN, [29] WWDG2RSTF, [29] DTCM2EN, [29] SRAM1EN, [29] DAC12EN, [29] HRTIMEN, [29] DTCM2LPEN, [29] SRAM1LPEN, [29] SRAM4LPEN, [29] DAC12LPEN, [29] HRTIMLPEN, [28] PLL3ON, [29:28] CKPERSEL, [29:28] FDCANSEL, [30:28] LPTIM1SEL, [30:28] SPI6SEL, [28] DFSDM1RST, [28] BKPRAMAMEN, [28] WWDG1RSTF, [28] DTCM1EN, [28] USB2OTGHSULPIEN, [28] BKPRAMEN, [28] DFSDM1EN, [28] DTCM1LPEN, [28] USB2OTGHSULPILPEN, [28] BKPRAMLPEN, [28] DFSDM1LPEN, [27] PLL2RDY, [27] USB2OTGHSRST, [27] HDMICECRST, [27] IWDG2RSTF, [27] USB2OTGHSEN, [27] HDMICECEN, [27] USB2OTGHSLPEN, [27] HDMICECEN, [26] PLL2ON, [26] IWDG1RSTF, [26] USB1OTGHSULPIEN, [26] USB1OTGHSULPILPEN, [25] PLLRDY, [28:25] MCO2PRE, [25] USB1OTGHSRST, [25] HSEMRST, [25] SFT2RSTF, [25] USB1OTGHSEN, [25] HSEMEN, [25] USB1OTGHSLPEN, [24] PLLON, [30:24] HSITRIM, [29:24] CSITRIM, [24] DIVR3EN, [30:24] R1, [30:24] R2, [30:24] R3, [24] DFSDM1SEL, [26:24] SAI4BSEL, [24] ADC3RST, [24] SAI3RST, [24] ADC3AMEN, [24] SFT1RSTF, [24] ADC3EN, [24] SAI3EN, [24] ADC3LPEN, [24] SAI3LPEN, [23] DIVQ3EN, [23] I2C3RST, [23] SAI2RST, [23] PORRSTF, [23] I2C3EN, [23] SAI2EN, [23] I2C3LPEN, [23] SAI2LPEN, [24:22] MCO1, [22] DIVP3EN, [23:22] CECSEL, [22] I2C2RST, [22] SAI1RST, [22] PINRSTF, [22] I2C2EN, [22] SAI1EN, [22] I2C2LPEN, [22] SAI1LPEN, [21] DIVR2EN, [23:21] SAI4ASEL, [21] BDMARST, [21] I2C1RST, [21] SAI4RST, [21] SAI4AMEN, [21] BORRSTF, [21] BDMAEN, [21] I2C1EN, [21] SAI4EN, [21] BDMALPEN, [21] I2C1LPEN, [21] SAI4LPEN, [25:20] DIVM3, [20] DIVQ2EN, [21:20] SPDIFSEL, [21:20] USBSEL, [20] UART5RST, [20] SPI5RST, [20] D2RSTF, [20] UART5EN, [20] SPI5EN, [20] UART5LPEN, [20] SPI5LPEN, [19] CSSHSEON, [19] DIVP2EN, [19] CRCRST, [19] UART4RST, [19] CRCAMEN, [19] D1RSTF, [19] CRCEN, [19] UART4EN, [19] CRCLPEN, [19] UART4LPEN, [18] HSEBYP, [21:18] MCO1PRE, [18] DIVR1EN, [18] USART3RST, [18] TIM17RST, [18] C2RSTF, [18] USART3EN, [18] TIM17EN, [18] USART3LPEN, [18] TIM17LPEN, [17] HSERDY, [17] DIVQ1EN, [17] USART2RST, [17] TIM16RST, [17] C1RSTF, [17] ETH1RXEN, [17] USART2EN, [17] TIM16EN, [17] ETH1RXLPEN, [17] USART2LPEN, [17] TIM16LPEN, [16] HSEON, [16] DIVP1EN, [22:16] Q1, [22:16] Q2, [22:16] Q3, [16] SDMMCSEL, [18:16] SPI45SEL, [17:16] ADCSEL, [16] BDRST, [16] SDMMC1RST, [16] SPDIFRXRST, [16] TIM15RST, [16] RTCAMEN, [16] RMVF, [16] SDMMC1EN, [16] ETH1TXEN, [16] SPDIFRXEN, [16] TIM15EN, [16] RTCAPBEN, [16] SDMMC1LPEN, [16] ETH1TXLPEN, [16] SPDIFRXLPEN, [16] TIM15LPEN, [16] RTCAPBLPEN, [15] D2CKRDY, [15] TIMPRE, [15] RTCEN, [15] ETH1MACRST, [15] SPI3RST, [15] VREFRST, [15] VREFAMEN, [15] ETH1MACEN, [15] SPI3EN, [15] VREFEN, [15] ETH1MACLPEN, [15] SPI3LPEN, [15] VREFLPEN, [14] D1CKRDY, [14] HRTIMSEL, [14] QSPIRST, [14] ARTRST, [14] SPI2RST, [14] COMP12RST, [14] COMP12AMEN, [14] QSPIEN, [14] ARTEN, [14] SPI2EN, [14] COMP12EN, [14] QSPILPEN, [14] ARTLPEN, [14] SPI2LPEN, [14] COMP12LPEN, [13] HSI48RDY, [15:13] LPTIM345SEL, [13] SPI4RST, [13] SPI4EN, [13] SPI4LPEN, [12] HSI48ON, [17:12] DIVM2, [14:12] SPI123SEL, [13:12] I2C123SEL, [12] FMCRST, [12] SPI1RST, [n+7] LPTIM{n}RST (n=2..5), [n+7] LPTIM{n}AMEN (n=2..5), [12] FMCEN, [12] SPI1EN, [n+7] LPTIM{n}EN (n=2..5), [12] FMCLPEN, [12] SPI1LPEN, [n+7] LPTIM{n}LPEN (n=2..5), [11] D1CPRE_DIV2, [11] WWDG2EN, [11] WWDG2LPEN, [11:10] D1CPRE_DIV64, [10] D2PPRE2_DIV2, [11:10] PLL3RGE, [12:10] LPTIM2SEL, [10] HSECSSF, [10] HSECSSC, [10] GPIOKRST, [10] GPIOKEN, [10] GPIOKLPEN, [9] CSIKERON, [11:9] D1CPRE_DIV8, [10:9] D2PPRE2_DIV8, [9] PLL3VCOSEL, [15:9] P1, [15:9] P2, [15:9] P3, [9] LSECSSIE, [9] LSECSSF, [9] LSECSSC, [9] SDMMC2RST, [9] GPIOJRST, [9] LPTIM1RST, [9] SDMMC2EN, [9] GPIOJEN, [9] LPTIM1EN, [9] SDMMC2LPEN, [9] GPIOJLPEN, [9] LPTIM1LPEN, [8] CSIRDY, [13:8] RTCPRE, [11:8] D1CPRE_DIV512, [10:8] D2PPRE2_DIV4, [8] PLL3FRACEN, [9:8] RNGSEL, [9:8] I2C4SEL, [8] PLL3RDYIE, [8] PLL3RDYF, [8] PLL3RDYC, [9:8] RTCSEL, [8] GPIOIRST, [8] TIM14RST, [8] FDCANRST, [8] FLASHEN, [8] GPIOIEN, [8] TIM14EN, [8] FDCANEN, [8] FLASHLPEN, [8] GPIOILPEN, [8] TIM14LPEN, [8] FDCANLPEN, [7] CSION, [7] STOPKERWUCK, [7] PLL2RDYIE, [7] PLL2RDYF, [7] PLL2RDYC, [7] GPIOHRST, [7] TIM13RST, [7] I2C4RST, [7] I2C4AMEN, [7] GPIOHEN, [7] TIM13EN, [7] I2C4EN, [7] GPIOHLPEN, [7] TIM13LPEN, [7] I2C4LPEN, [6] STOPWUCK, [6] D1PPRE_DIV2, [6] D2PPRE1_DIV2, [6] D3PPRE_DIV2, [7:6] PLL2RGE, [8:6] SAI23SEL, [6] PLL1RDYIE, [6] PLLRDYF, [6] PLLRDYC, [6] LSECSSD, [6] RNGRST, [6] GPIOGRST, [6] TIM12RST, [6] RNGEN, [6] GPIOGEN, [6] WWDG1EN, [6] TIM12EN, [6] RNGLPEN, [6] GPIOGLPEN, [6] WWDG1LPEN, [6] TIM12LPEN, [5] HSIDIVF, [6:5] D1PPRE_DIV8, [6:5] D2PPRE1_DIV8, [6:5] D3PPRE_DIV8, [5] PLL2VCOSEL, [5] HSI48RDYIE, [5] HSI48RDYF, [5] HSI48RDYC, [5] LSECSSON, [5] JPGDECRST, [5] ADC12RST, [5] HASHRST, [5] GPIOFRST, [n-2] TIM{n}RST (n=2..7), [5] MDIOSRST, [5] USART6RST, [5] SPI6RST, [5] SPI6AMEN, [5] JPGDECEN, [5] ADC12EN, [5] HASHEN, [5] GPIOFEN, [n-2] TIM{n}EN (n=2..7), [5] MDIOSEN, [5] USART6EN, [5] SPI6EN, [5] JPGDECLPEN, [5] ADC12LPEN, [5] HASHLPEN, [5] GPIOFLPEN, [n-2] TIM{n}LPEN (n=2..7), [5] MDIOSLPEN, [5] USART6LPEN, [5] SPI6LPEN, [6:4] D1PPRE_DIV4, [6:4] D2PPRE1_DIV4, [6:4] D3PPRE_DIV4, [9:4] DIVM1, [4] PLL2FRACEN, [5:4] QSPISEL, [4] CSIRDYIE, [4] CSIRDYF, [4] CSIRDYC, [4] DMA2DRST, [4] CRYPRST, [4] GPIOERST, [4] OPAMPRST, [4] USART1RST, [4] DMA2DEN, [4] CRYPEN, [4] GPIOEEN, [4] OPAMPEN, [4] USART1EN, [4] DMA2DLPEN, [4] CRYPLPEN, [4] GPIOELPEN, [4] OPAMPLPEN, [4] USART1LPEN, [4:3] HSIDIV, [5:3] SWS, [3] HPRE_DIV2, [15:3] FRACN1, [15:3] FRACN2, [15:3] FRACN3, [5:3] USART16SEL, [3] HSERDYIE, [3] HSERDYF, [3] HSERDYC, [4:3] LSEDRV, [3] GPIODRST, [3] LTDCRST, [3] LPUART1RST, [3] BOOT_C2, [3] LPUART1AMEN, [3] GPIODEN, [3] LTDCEN, [3] LPUART1EN, [3] GPIODLPEN, [3] LTDCLPEN, [3] LPUART1LPEN, [2] HSIRDY, [3:2] HPRE_DIV64, [3:2] PLL1RGE, [2] HSIRDYIE, [2] HSIRDYF, [2] HSIRDYC, [2] LSEBYP, [2] GPIOCRST, [2] SWPMIRST, [2] BOOT_C1, [2] GPIOCEN, [2] SWPMIEN, [2] GPIOCLPEN, [2] SWPMILPEN, [1] HSIKERON, [3:1] HPRE_DIV8, [1] PLLSRC_HSE, [1] PLL1VCOSEL, [1] LSERDYIE, [1] LSERDYF, [1] LSERDYC, [1] LSERDY, [1] LSIRDY, [1] DMA2RST, [1] GPIOBRST, [1] CRSRST, [1] TIM8RST, [1] SYSCFGRST, [1] WW2RSC, [1] DMA2EN, [1] GPIOBEN, [1] CRSEN, [1] TIM8EN, [1] SYSCFGEN, [1] DMA2LPEN, [1] GPIOBLPEN, [1] CRSLPEN, [1] TIM8LPEN, [1] SYSCFGLPEN, [0] HSION, [11:0] HSICAL, [9:0] HSI48CAL, [7:0] CSICAL, [2:0] SW, [3:0] HPRE_DIV512, [1:0] PLLSRC_NONE, [0] PLL1FRACEN, [8:0] N1, [8:0] N2, [8:0] N3, [1:0] FMCSEL, [2:0] SAI1SEL, [2:0] USART28SEL, [2:0] LPUART1SEL, [0] LSIRDYIE, [0] LSIRDYF, [0] LSIRDYC, [0] LSEON, [0] LSION, [0] MDMARST, [0] DMA1RST, [0] DCMIRST, [0] GPIOARST, [0] TIM1RST, [0] WW1RSC, [0] BDMAAMEN, [0] MDMAEN, [0] DMA1EN, [0] DCMIEN, [0] GPIOAEN, [0] TIM1EN, [0] MDMALPEN, [0] DMA1LPEN, [0] DCMILPEN, [0] GPIOALPEN, [0] TIM1LPEN
0x04 HSICFGR
0x08 CRRCR
0x0C CSICFGR
0x10 CFGR
{0x14+4i} D{i}CFGR (i=1..3)
0x28 PLLCKSELR
0x2C PLLCFGR
{0x28+8i} PLL{i}DIVR (i=1..3)
{0x2C+8i} PLL{i}FRACR (i=1..3)
0x4C D1CCIPR
0x50 D2CCIP1R
0x54 D2CCIP2R
0x58 D3CCIPR
0x60 CIER
0x64 CIFR
0x68 CICR
0x70 BDCR
0x74 CSR
0x7C AHB3RSTR
0x80 AHB1RSTR
0x84 AHB2RSTR
0x88 AHB4RSTR
0x8C APB3RSTR
0x90 APB1LRSTR
0x94 APB1HRSTR
0x98 APB2RSTR
0x9C APB4RSTR
0xA0 GCR
0xA8 D3AMR
0xD0 RSR
0xD4 AHB3ENR
0xD8 AHB1ENR
0xDC AHB2ENR
0xE0 AHB4ENR
0xE4 APB3ENR
0xE8 APB1LENR
0xEC APB1HENR
0xF0 APB2ENR
0xF4 APB4ENR
0xFC AHB3LPENR
0x100 AHB1LPENR
0x104 AHB2LPENR
0x108 AHB4LPENR
0x10C APB3LPENR
0x110 APB1LLPENR
0x114 APB1HLPENR
0x118 APB2LPENR
0x11C APB4LPENR
