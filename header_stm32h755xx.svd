# STM32H755xx register map
File version: 1.0
Registers are 32-bit, access not given, reset 0x0 unless marked. A register's access mark holds for its fields unless they carry their own. Offsets are from the block's base; [hi:lo] are bit positions; {n}, {i} and the like mark numbered series.

## DLYB_SDMMC2
Base 0x48022800
Same registers: DLYB_QUADSPI 0x52006000, DLYB_SDMMC1 0x52008000
0x00 CR
  [31] LNGF, [27:16] LNG, [14:8] UNIT, [1] SEN, [0] DEN, [3:0] SEL
0x04 CFGR

## RAMECC2
Base 0x48023000
Same registers: RAMECC1 0x52009000, RAMECC3 0x58027000
0x00 IER
  [5] ECCELEN, [5] ECCELEN, [5] ECCELEN, [5] ECCELEN, [5] ECCELEN, [5] ECCELEN, [5] ECCELEN, [5] ECCELEN, [5] ECCELEN, [5] ECCELEN, [5] ECCELEN, [5] ECCELEN, [4] ECCDEBWIE, [4] ECCDEBWIE, [4] ECCDEBWIE, [4] ECCDEBWIE, [4] ECCDEBWIE, [4] ECCDEBWIE, [4] ECCDEBWIE, [4] ECCDEBWIE, [4] ECCDEBWIE, [4] ECCDEBWIE, [4] ECCDEBWIE, [4] ECCDEBWIE, [3] GECCDEBWIE, [3] ECCDEIE, [3] ECCDEIE, [3] ECCDEIE, [3] ECCDEIE, [3] ECCDEIE, [3] ECCDEIE, [3] ECCDEIE, [3] ECCDEIE, [3] ECCDEIE, [3] ECCDEIE, [3] ECCDEIE, [3] ECCDEIE, [2] GECCDEIE, [2] ECCSEIE, [2] ECCSEIE, [2] ECCSEIE, [2] DEBWDF, [2] DEBWDF, [2] DEBWDF, [2] ECCSEIE, [2] ECCSEIE, [2] ECCSEIE, [2] DEBWDF, [2] DEBWDF, [2] DEBWDF, [2] ECCSEIE, [2] ECCSEIE, [2] DEBWDF, [2] DEBWDF, [2] ECCSEIE, [2] ECCSEIE, [2] DEBWDF, [2] DEBWDF, [2] ECCSEIE, [2] ECCSEIE, [2] DEBWDF, [2] DEBWDF, [1] GECCSEIE, [1] DEDF, [1] DEDF, [1] DEDF, [1] DEDF, [1] DEDF, [1] DEDF, [1] DEDF, [1] DEDF, [1] DEDF, [1] DEDF, [1] DEDF, [1] DEDF, [0] GIE, [0] SEDCF, [0] SEDCF, [0] SEDCF, [31:0] FDATAL, [31:0] FDATAL, [31:0] FDATAL, [0] SEDCF, [0] SEDCF, [0] SEDCF, [31:0] FDATAL, [31:0] FDATAL, [31:0] FDATAL, [31:0] FEC, [31:0] FEC, [31:0] FEC, [0] SEDCF, [0] SEDCF, [31:0] FDATAL, [31:0] FDATAL, [31:0] FEC, [31:0] FEC, [31:0] FEC, [0] SEDCF, [0] SEDCF, [31:0] FDATAL, [31:0] FDATAL, [31:0] FEC, [31:0] FEC, [0] SEDCF, [0] SEDCF, [31:0] FDATAL, [31:0] FDATAL, [31:0] FEC, [31:0] FEC, [31:0] FEC, [31:0] FEC
{0x0+0x20*i} CR{i} (i=1..5)
{0x4+0x20*i} SR{i} (i=1..5)
{0xC+0x20*i} FAR{i} (i=1..5)
{0x18+0x20*i} FDRL{i} (i=1..5)
{0x28+0x20*i} FDRH{i} (i=1..5)
{0x3C+0x20*i} FECR{i} (i=1..5)

## LTDC
Base 0x50001000
0x08 SSCR
  [31] HSPOL, [30] VSPOL, [29] DEPOL, [28] PCPOL, [27:16] HSW, [27:16] AHBP, [27:16] AAW, [27:16] TOTALW, [16] DEN, [23:16] BCRED, [31:16] CXPOS, [14:12] DRW, [10:8] DGW, [15:8] BCGREEN, [6:4] DBW, [3] RRIE, [3] RRIF, [3] CRRIF, [3] HSYNCS, [2] TERRIE, [2] TERRIF, [2] CTERRIF, [2] VSYNCS, [1] VBR, [1] FUIE, [1] FUIF, [1] CFUIF, [1] HDES, [10:0] VSH, [10:0] AVBP, [10:0] AAH, [10:0] TOTALH, [0] LTDCEN, [0] IMR, [7:0] BCBLUE, [0] LIE, [0] LIF, [0] CLIF, [10:0] LIPOS, [15:0] CYPOS, [0] VDES
0x0C BPCR
0x10 AWCR
0x14 TWCR
0x18 GCR
0x24 SRCR
0x2C BCCR
0x34 IER
0x38 ISR
0x3C ICR
0x40 LIPCR
0x44 CPSR
0x48 CDSR
0x84 CR1
0x88 WHPCR1
0x90 WVPCR1
0x9C CKCR1
0xAC PFCR1
0xC0 CACR1
0xD8 DCCR1
0xF4 BFCR1
0x104 CR2
0x108 WHPCR2
0x110 WVPCR2
0x11C CFBAR1
0x11C CKCR2
0x12C PFCR2
0x140 CACR2
0x148 CFBLR1
0x158 DCCR2
0x174 BFCR2
0x178 CFBLNR1
0x19C CFBAR2
0x1B8 CLUTWR1
0x1C8 CFBLR2
0x1F8 CFBLNR2
0x238 CLUTWR2

## GPV
Base 0x51000000
{0x1FC0+4i} AXI_PERIPH_ID_{i} (i=4..7)
{0x1FE0+4i} AXI_PERIPH_ID_{i} (i=0..3)
{0x1FF0+4i} AXI_COMP_ID_{i} (i=0..3)
{0x1008+0x1000*i} AXI_TARG{i}_FN_MOD_ISS_BM (i=1..7)
0x2024 AXI_TARG1_FN_MOD2
0x202C AXI_TARG1_FN_MOD_LB
0x2108 AXI_TARG1_FN_MOD
0x3024 AXI_TARG2_FN_MOD2
0x302C AXI_TARG2_FN_MOD_LB
0x3108 AXI_TARG2_FN_MOD
0x8024 AXI_TARG7_FN_MOD2
0x802C AXI_TARG7_FN_MOD_LB
0x8108 AXI_TARG7_FN_MOD
0x42024 AXI_INI1_FN_MOD2
0x42028 AXI_INI1_FN_MOD_AHB
{0x41100+0x1000*i} AXI_INI{i}_READ_QOS (i=1..7)
{0x41104+0x1000*i} AXI_INI{i}_WRITE_QOS (i=1..7)
{0x41108+0x1000*i} AXI_INI{i}_FN_MOD (i=1..7)
0x44024 AXI_INI3_FN_MOD2
0x44028 AXI_INI3_FN_MOD_AHB

## FLASH
Base 0x52002000
0x00 ACR
  [31] SWAP_BANK, [30] OPTCHANGEERRIE, [30] CLR_OPTCHANGEERR, [5:4] WRHIGHFREQ, [4] MER, [1] OPTSTART, [3:0] LATENCY, [0] OPTLOCK, [31:0] CRC_DATA
0x04 KEYR1
0x08 OPTKEYR
0x0C CR1
0x10 SR1
0x14 CCR1
0x18 OPTCR
0x1C OPTSR_CUR
0x20 OPTSR_PRG
0x24 OPTCCR
0x28 PRAR_CUR1
0x2C PRAR_PRG1
0x30 SCAR_CUR1
0x34 SCAR_PRG1
0x38 WPSN_CUR1
0x3C WPSN_PRG1
0x40 BOOT7_CUR
0x44 BOOT7_PRG
0x48 BOOT4_CUR
0x4C BOOT4_PRG
0x50 CRCCR1
0x54 CRCSADD1
0x58 CRCEADD1
0x5C CRCDATA
0x60 ECC_FA1
0x104 KEYR2
0x10C CR2
0x110 SR2
0x114 CCR2
0x128 PRAR_CUR2
0x12C PRAR_PRG2
0x130 SCAR_CUR2
0x134 SCAR_PRG2
0x138 WPSN_CUR2
0x13C WPSN_PRG2
0x150 CRCCR2
0x154 CRCSADD2
0x158 CRCEADD2
0x15C CRCDATA2
0x160 ECC_FA2
