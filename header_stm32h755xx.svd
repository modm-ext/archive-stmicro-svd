# STM32H755xx register map
File version: 1.0
Registers are 32-bit, access not given, reset 0x0 unless marked. A register's access mark holds for its fields unless they carry their own. Offsets are from the block's base; [hi:lo] are bit positions; {n}, {i} and the like mark numbered series.

## FMC_Bank1_R
Base 0x52004000
0x00 BTCR.0
0x04 BTCR.1
0x08 BTCR.2
0x0C BTCR.3
0x10 BTCR.4
0x14 BTCR.5
0x18 BTCR.6
0x1C BTCR.7

## FMC_Bank2_R
Base 0x52004060
0x00 PCR2
0x04 SR2
0x08 PMEM2
0x0C PATT2
0x14 ECCR2

## FMC_Bank3_R
Base 0x52004080
0x00 PCR
  [31:24] MEMHIZ, [31:24] ATTHIZ, [19:17] ECCPS, [23:16] MEMHOLD, [23:16] ATTHOLD, [16:13] TAR, [12:9] TCLR, [15:8] MEMWAIT, [15:8] ATTWAIT, [6] ECCEN, [6] FEMPT, [5] IFEN, [5:4] PWID, [4] ILEN, [3] IREN, [2] PBKEN, [2] IFS, [1] PWAITEN, [1] ILS, [0] IRS, [7:0] MEMSET, [7:0] ATTSET
0x04 SR
0x08 PMEM
0x0C PATT
0x14 ECCR

## FMC_Bank1E_R
Base 0x52004104
0x00 BWTR.0
  [29:28] ACCMOD, [29:28] ACCMOD, [29:28] ACCMOD, [29:28] ACCMOD, [29:28] ACCMOD, [29:28] ACCMOD, [29:28] ACCMOD, [19:16] BUSTURN, [19:16] BUSTURN, [19:16] BUSTURN, [19:16] BUSTURN, [19:16] BUSTURN, [19:16] BUSTURN, [19:16] BUSTURN, [15:8] DATAST, [15:8] DATAST, [15:8] DATAST, [15:8] DATAST, [15:8] DATAST, [15:8] DATAST, [15:8] DATAST, [7:4] ADDHLD, [7:4] ADDHLD, [7:4] ADDHLD, [7:4] ADDHLD, [7:4] ADDHLD, [7:4] ADDHLD, [7:4] ADDHLD, [3:0] ADDSET, [3:0] ADDSET, [3:0] ADDSET, [3:0] ADDSET, [3:0] ADDSET, [3:0] ADDSET, [3:0] ADDSET
0x04 BWTR.1
0x08 BWTR.2
0x0C BWTR.3
0x10 BWTR.4
0x14 BWTR.5
0x18 BWTR.6

## FMC_Bank5_6_R
Base 0x52004140
0x00 SDCR.0
  [27:24] TRCD, [27:24] TRCD, [23:20] TRP, [23:20] TRP, [19:16] TWR, [19:16] TWR, [14] REIE, [14:13] RPIPE, [14:13] RPIPE, [12] RBURST, [12] RBURST, [15:12] TRC, [15:12] TRC, [11:10] SDCLK, [11:10] SDCLK, [9] WP, [9] WP, [21:9] MRD, [11:8] TRAS, [11:8] TRAS, [8:7] CAS, [8:7] CAS, [6] NB, [6] NB, [8:5] NRFS, [5:4] MWID, [5:4] MWID, [7:4] TXSR, [7:4] TXSR, [4] CTB1, [3] CTB2, [4:3] MODES2, [3:2] NR, [3:2] NR, [13:1] COUNT, [2:1] MODES1, [1:0] NC, [1:0] NC, [3:0] TMRD, [3:0] TMRD, [2:0] MODE, [0] CRE, [0] RE
0x04 SDCR.1
0x08 SDTR.0
0x0C SDTR.1
0x10 SDCMR
0x14 SDRTR
0x18 SDSR

## QUADSPI
Base 0x52005000
0x00 CR
  [31] DDRM, [30] DHHC, [28] SIOO, [27:26] FMODE, [31:24] PRESCALER, [25:24] DMODE, [23] PMM, [22] APMS, [20] TOIE, [19] SMIE, [18] FTIE, [22:18] DCYC, [17] TCIE, [16] TEIE, [20:16] FSIZE, [17:16] ABSIZE, [15:14] ABMODE, [13:12] ADSIZE, [11:10] ADMODE, [11:8] FTHRES, [10:8] CSHT, [13:8] FLEVEL, [9:8] IMODE, [7] FSEL, [6] DFM, [5] BUSY, [4] SSHIFT, [4] TOF, [4] CTOF, [3] TCEN, [3] SMF, [3] CSMF, [2] DMAEN, [2] FTF, [1] ABORT, [1] TCF, [1] CTCF, [0] EN, [0] CKMODE, [0] TEF, [0] CTEF, [31:0] DL, [7:0] INSTRUCTION, [31:0] ADDRESS, [31:0] ALTERNATE, [31:0] DATA, [31:0] MASK, [31:0] MATCH, [15:0] INTERVAL, [15:0] TIMEOUT
0x04 DCR
0x08 SR
0x0C FCR
0x10 DLR
0x14 CCR
0x18 AR
0x1C ABR
0x20 DR
0x24 PSMKR
0x28 PSMAR
0x2C PIR
0x30 LPTR

## EXTI
Base 0x58000000
0x00 RTSR1
  [n] IM{n} (n=0..31), [n] EM{n} (n=20..31), [n-32] IM{n} (n=46..63), [n-32] EM{n} (n=46..63), [2n+1:2n] PCS{n} (n=0..15), [24] MR25, [n-64] IM{n} (n=84..87), [n-64] EM{n} (n=84..87), [22] TR86, [22] TR86, [22] SWIER86, [22] PR86, [21] TR21, [21] TR21, [n] SWIER{n} (n=0..21), [21] MR21, [n-32] MR{n} (n=48..53), [21] TR85, [21] TR85, [21] SWIER85, [n] PR{n} (n=0..21), [21] PR85, [20] TR20, [20] TR20, [20] MR20, [20] TR84, [20] TR84, [20] SWIER84, [20] PR84, [19] TR19, [19] TR19, [19] MR19, [19] TR51, [19] TR51, [19] SWIER51, [19] PR51, [18] TR18, [18] TR18, [19:18] PCS25, [19:18] PCS41, [18] TR82, [18] TR82, [18] SWIER82, [n] EM{n} (n=0..18), [18] IM82, [n-64] EM{n} (n=64..82), [18] PR82, [17] TR17, [17] TR17, [17] TR49, [17] TR49, [17] SWIER49, [17] PR49, [16] TR16, [16] TR16, [n-64] IM{n} (n=64..80), [15] TR15, [15] TR15, [n] MR{n} (n=0..15), [14] TR14, [14] TR14, [13] TR13, [13] TR13, [12] TR12, [12] TR12, [n-32] IM{n} (n=32..44), [n-32] EM{n} (n=32..44), [11] TR11, [11] TR11, [10] TR10, [10] TR10, [11:10] PCS21, [2n-95:2n-96] PCS{n} (n=48..53), [9] TR9, [9] TR9, [9] MR41, [8] TR8, [8] TR8, [9:8] PCS20, [7] TR7, [7] TR7, [6] TR6, [6] TR6, [7:6] PCS19, [7:6] PCS35, [5] TR5, [5] TR5, [4] TR4, [4] TR4, [5:4] PCS34, [3] TR3, [3] TR3, [3] MR35, [2] TR2, [2] TR2, [2] MR34, [1] TR1, [1] TR1, [0] TR0, [0] TR0
0x04 FTSR1
0x08 SWIER1
0x0C D3PMR1
0x10 D3PCR1L
0x14 D3PCR1H
0x20 RTSR2
0x24 FTSR2
0x28 SWIER2
0x2C D3PMR2
0x30 D3PCR2L
0x34 D3PCR2H
0x40 RTSR3
0x44 FTSR3
0x48 SWIER3
0x4C D3PMR3
0x50 D3PCR3L
0x54 D3PCR3H
{0x70+0x10*i} IMR{i} (i=1..3)
{0x74+0x10*i} EMR{i} (i=1..3)
{0x78+0x10*i} PR{i} (i=1..3)
{0xB0+0x10*i} C2IMR{i} (i=1..3)
{0xB4+0x10*i} C2EMR{i} (i=1..3)
{0xB8+0x10*i} C2PR{i} (i=1..3)
