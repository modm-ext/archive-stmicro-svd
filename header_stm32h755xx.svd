# STM32H755xx register map
File version: 1.0
Registers are 32-bit, access not given, reset 0x0 unless marked. A register's access mark holds for its fields unless they carry their own. Offsets are from the block's base; [hi:lo] are bit positions.

## LPTIM1
Base 0x40002400
Same registers: LPTIM2 0x58002400, LPTIM3 0x58002800, LPTIM4 0x58002C00, LPTIM5 0x58003000
0x00 ISR
  [24] ENC, [23] COUNTMODE, [22] PRELOAD, [21] WAVPOL, [20] WAVE, [19] TIMOUT, [18:17] TRIGEN, [15:13] TRIGSEL, [11:9] PRESC, [6] DOWN, [6] DOWNCF, [6] DOWNIE, [7:6] TRGFLT, [5] UP, [5] UPCF, [5] UPIE, [4] ARROK, [4] ARROKCF, [4] ARROKIE, [4] RSTARE, [5:4] IN2SEL, [3] CMPOK, [3] CMPOKCF, [3] CMPOKIE, [4:3] CKFLT, [3] COUNTRST, [2] EXTTRIG, [2] EXTTRIGCF, [2] EXTTRIGIE, [2] CNTSTRT, [1] ARRM, [1] ARRMCF, [1] ARRMIE, [2:1] CKPOL, [19:1] SNGSTRT, [0] CMPM, [0] CMPMCF, [0] CMPMIE, [0] CKSEL, [0] ENABLE, [15:0] CMP, [15:0] ARR, [15:0] CNT, [1:0] IN1SEL
0x04 ICR
0x08 IER
0x0C CFGR
0x10 CR
0x14 CMP
0x18 ARR
0x1C CNT
0x24 CFGR2

## WWDG2
Base 0x40002C00
Same registers: WWDG1 0x50003000
0x00 CR
  [13:11] WDGTB, [9] EWI, [7] WDGA, [6:0] T, [6:0] W, [0] EWIF
0x04 CFR
0x08 SR

## SPI2
Base 0x40003800
Same registers: SPI3 0x40003C00, SPI1 0x40013000, SPI4 0x40013400, SPI5 0x40015000, SPI6 0x58001400
0x00 CR1
  [31] AFCNTR, [30] SSOM, [29] SSOE, [30:28] MBR, [28] SSIOP, [26] SSM, [25] CPOL, [25] MCKOE, [24] CPHA, [24] ODD, [23] LSBFRST, [22] CRCEN, [22] MASTER, [21:19] SP, [18:17] COMM, [16] IOLOCK, [31:16] TSER, [20:16] CRCSIZE, [31:16] CTSIZE, [23:16] I2SDIV, [15] TCRCINI, [15] TXDMAEN, [15] IOSWP, [15] RXWNE, [14] RCRCINI, [14] RXDMAEN, [14] DATFMT, [13] CRC33_17, [14:13] RXPLVL, [13] WSINV, [12] SSI, [12] TXC, [12] FIXCH, [11] HDDIR, [12:11] UDRDET, [11] SUSP, [11] SUSPC, [11] CKPOL, [10] CSUSP, [10] TSERFIE, [10] TSERF, [10] TSERFC, [10] CHLEN, [9] CSTART, [10:9] UDRCFG, [9] MODFIE, [9] MODF, [9] MODFC, [8] MASRX, [8] TIFREIE, [8] TIFRE, [8] TIFREC, [9:8] DATLEN, [7] CRCEIE, [7] CRCE, [7] CRCEC, [7] PCMSYNC, [6] OVRIE, [6] OVR, [6] OVRC, [8:5] FTHLV, [5] UDRIE, [5] UDR, [5] UDRC, [7:4] MIDI, [4] TXTFIE, [4] TXTF, [4] TXTFC, [5:4] I2SSTD, [3] EOTIE, [3] EOT, [3] EOTC, [2] DXPIE, [2] DXP, [1] TXPIE, [1] TXP, [3:1] I2SCFG, [0] SPE, [15:0] TSIZE, [4:0] DSIZE, [3:0] MSSI, [0] RXPIE, [0] RXP, [31:0] TXDR, [31:0] RXDR, [31:0] CRCPOLY, [31:0] TXCRC, [31:0] RXCRC, [31:0] UDRDR, [0] I2SMOD
0x04 CR2
0x08 CFG1
0x0C CFG2
0x10 IER
0x14 SR
0x18 IFCR
0x20 TXDR
0x30 RXDR
0x40 CRCPOLY
0x44 TXCRC
0x48 RXCRC
0x4C UDRDR
0x50 I2SCFGR

## SPDIFRX
Base 0x40004000
0x00 CR
  [24] SOB, [21] CKSBKPEN, [20] CKSEN, [18:16] INSEL, [30:16] WIDTH5, [23:16] CS, [28:16] TLO, [14] WFA, [13:12] NBTR, [11] CHSEL, [10] CBDMAEN, [9] PTMSK, [8] CUMSK, [8] TERR, [7] VMSK, [7] SERR, [6] PMSK, [6] IFEIE, [6] FERR, [5] SYNCDIE, [5] SYNCD, [5] SYNCDCF, [5:4] DRFMT, [4] SBLKIE, [4] SBD, [4] SBDCF, [3] RXSTEO, [3] OVRIE, [3] OVR, [3] OVRCF, [2] RXDMAEN, [2] PERRIE, [2] PERR, [2] PERRCF, [1] CSRNEIE, [1] CSRNE, [1:0] SPDIFEN, [0] RXNEIE, [0] RXNE, [15:0] USR, [12:0] THI
0x04 IMR
0x08 SR
0x0C IFCR
0x10 DR
0x14 CSR
0x18 DIR

## USART2
Base 0x40004400
Same registers: USART3 0x40004800, UART4 0x40004C00, UART5 0x40005000, UART7 0x40007800, UART8 0x40007C00, USART1 0x40011000, USART6 0x40011400, LPUART1 0x58000C00
0x00 CR1
  [31] RXFFIE, [30] TXFEIE, [29] FIFOEN, [31:29] TXFTCFG, [28] M1, [28] RXFTIE, [27] EOBIE, [27] TXFT, [26] RTOIE, [26] RXFT, [27:25] RXFTCFG, [25] TCBGT, [31:24] ADD, [24] TCBGTIE, [31:24] BLEN, [24] RXFF, [23] RTOEN, [23] TXFTIE, [23] TXFE, [22] WUFIE, [22] REACK, [25:21] DEAT, [22:21] ABRMODE, [21] TEACK, [20] ABREN, [21:20] WUS, [20] WUF, [20] WUCF, [19] MSBFIRST, [19] RWU, [18] DATAINV, [18] SBKF, [17] TXINV, [19:17] SCARCNT, [17] CMF, [17] CMCF, [20:16] DEDT, [16] RXINV, [16] BUSY, [15] OVER8, [15] SWAP, [15] DEP, [15] ABRF, [14] CMIE, [14] LINEN, [14] DEM, [14] ABRE, [13] MME, [13] DDRE, [13] UDR, [13] UDRCF, [12] M0, [13:12] STOP, [12] OVRDIS, [12] EOBF, [12] EOBCF, [11] WAKE, [11] CLKEN, [11] ONEBIT, [11] RTOF, [11] RTOCF, [10] PCE, [10] CPOL, [10] CTSIE, [10] CTS, [9] PS, [9] CPHA, [9] CTSE, [9] CTSIF, [9] CTSCF, [8] PEIE, [8] LBCL, [8] RTSE, [15:8] GT, [8] LBDF, [8] LBDCF, [7] TXEIE_TXFNFIE, [7] DMAT, [7] TXE_TXFNF, [7] TCBGTCF, [6] TCIE, [6] LBDIE, [6] DMAR, [6] TC, [6] TCCF, [5] RXNEIE_RXFNEIE, [5] LBDL, [5] SCEN, [5] RXNE_RXFNE, [5] TXFECF, [4] IDLEIE, [4] ADDM7, [4] NACK, [15:4] DIV_MANTISSA, [4] TXFRQ, [4] IDLE, [4] IDLECF, [3] TE, [3] DIS_NSS, [3] HDSEL, [3] RXFRQ, [3] ORE, [3] ORECF, [2] RE, [2] IRLP, [2] MMRQ, [2] NE, [2] NECF, [1] UESM, [1] IREN, [1] SBKRQ, [1] FE, [1] FECF, [0] UE, [0] SLVEN, [0] EIE, [3:0] DIV_FRACTION, [7:0] PSC, [23:0] RTO, [0] ABRRQ, [0] PE, [0] PECF, [8:0] RDR, [8:0] TDR, [3:0] PRESCALER
0x04 CR2
0x08 CR3
0x0C BRR
0x10 GTPR
0x14 RTOR
0x18 RQR
0x1C ISR
0x20 ICR
0x24 RDR
0x28 TDR
0x2C PRESC
