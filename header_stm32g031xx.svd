# STM32G031xx register map
File version: 1.0
STM32G031C4T6,STM32G031C4U6,STM32G031C6T6,STM32G031C6U6,STM32G031C8T6,STM32G031C8T7,STM32G031C8U6,STM32G031C8U7,STM32G031F4P3,STM32G031F4P6,STM32G031F4P7,STM32G031F6P6,STM32G031F6P7,STM32G031F8P6,STM32G031G4U6,STM32G031G6U3,STM32G031G6U6,STM32G031G6U7,STM32G031G8U3,STM32G031G8U6,STM32G031G8U7,STM32G031J4M6,STM32G031J6M3,STM32G031J6M6,STM32G031J6M7,STM32G031K4T3,STM32G031K4T6,STM32G031K4T7,STM32G031K4U3,STM32G031K4U6,STM32G031K4U7,STM32G031K6T6,STM32G031K6U6,STM32G031K8T3,STM32G031K8T6,STM32G031K8T7,STM32G031K8U3,STM32G031K8U6,STM32G031K8U7,STM32G031Y8Y6
Registers are 32-bit, access not given, reset 0x0 unless marked. A register's access mark holds for its fields unless they carry their own. Offsets are from the block's base; lines under a group give offsets from that group; [hi:lo] are bit positions; {n}, {i} and the like mark numbered series; 'fields as' and 'values as' point back to an identical list; <NAME> marks a mode.

## Memory map
0x40000000 TIM2
0x40000400 TIM3
0x40002000 TIM14
0x40002800 RTC
0x40002C00 WWDG
0x40003000 IWDG
0x40003800 SPI2
0x40004400 USART2
0x40005400 I2C1
0x40005800 I2C2
0x40007000 PWR
0x40007C00 LPTIM1
0x40008000 LPUART1
0x40009400 LPTIM2
0x4000B000 TAMP
0x40010000 SYSCFG
0x40010030 VREFBUF
0x40012400 ADC1
0x40012C00 TIM1
0x40013000 SPI1
0x40013800 USART1
0x40014400 TIM16
0x40014800 TIM17
0x40015800 DBG
0x40020000 DMA1
0x40020800 DMAMUX1
0x40021000 RCC
0x40021800 EXTI
0x40022000 FLASH
0x40023000 CRC
0x50000000 GPIOA
0x50000400 GPIOB
0x50000800 GPIOC
0x50000C00 GPIOD
0x50001400 GPIOF

## TIM2
Base 0x40000000
Same registers: TIM3 0x40000400, TIM14 0x40002000, TIM1 0x40012C00, TIM16 0x40014400, TIM17 0x40014800
0x00 CR1
  [31] UIFCPY, [31] GC5C3, [30] GC5C2, [29] BK2BID, [29] GC5C1, [28] BKBID, [27] BK2DSRM, [26] BKDSRM, [25] BK2P, [24] BK2E, [8n-5:8n-8] TI{n}SEL (n=1..4), [4n-3] CC{n}P (n=1..6), [23:20] MMS2, [4n-4] CC{n}E (n=1..6), [23:20] BK2F, [2n+6] OIS{n} (n=1..6), [17] CC6IF, [16] CC5IF, [19:16] BKF, [15] ETP, [15] OC2CE, [15] OC4CE, [4n-1] CC{n}NP (n=1..4), [15] MOE, [15] OC6CE, [14] ECE, [14] TDE, [14] AOE, [13] OIS3N, [13] COMDE, [13] SBIF, [13] BKP, [13:12] ETPS, [n+8] CC{n}DE (n=1..4), [n+8] CC{n}OF (n=1..4), [24:12] OC2M, [24:12] OC4M, [12] BKE, [24:12] OC6M, [11] UIFREMAP, [11] OIS2N, [11] OC2PE, [11] OC4PE, [11] OSSR, [11] OC6PE, [10] OC2FE, [10] OC4FE, [10] CC3NE, [10] OSSI, [10] OC6FE, [9] OIS1N, [9:8] CKD, [11:8] ETF, [8] UDE, [8] B2IF, [8] B2G, [9:8] CC2S, [9:8] CC4S, [9:8] LOCK, [12:8] DBL, [7] ARPE, [7] TI1S, [7] MSM, [7] BIE, [7] BIF, [7] BG, [7] OC1CE, [7] OC3CE, [7] OC5CE, [6] TIE, [6] TIF, [6] TG, [6] CC2NE, [6:5] CMS, [5] COMIE, [5] COMIF, [5] COMG, [4] DIR, [6:4] MMS, [21:4] TS, [n] CC{n}IE (n=1..4), [n] CC{n}IF (n=1..4), [n] CC{n}G (n=1..4), [16:4] OC1M, [16:4] OC3M, [16:4] OC5M, [3] OPM, [3] CCDS, [3] OCCS, [3] OC1PE, [3] OC3PE, [3] OC5PE, [2] URS, [2] CCUS, [2] OC1FE, [2] OC3FE, [2] CC1NE, [2] OC5FE, [1] UDIS, [0] CEN, [0] CCPC, [16:0] SMS, [0] UIE, [0] UIF, [0] UG, [1:0] CC1S, [1:0] CC3S, [31:0] CNT, [15:0] PSC, [31:0] ARR, [15:0] REP, [15:0] CCR{n} (n=1..4), [7:0] DTG, [4:0] DBA, [15:0] DMAB, [31:0] CCR5, [15:0] CCR6
0x04 CR2
0x08 SMCR
0x0C DIER
0x10 SR
0x14 EGR
0x18 CCMR1
0x1C CCMR2
0x20 CCER
0x24 CNT
0x28 PSC
0x2C ARR
0x30 RCR
{0x30+4i} CCR{i} (i=1..4)
0x44 BDTR
0x48 DCR
0x4C DMAR
0x50 OR1
0x54 CCMR3
0x58 CCR5
0x5C CCR6
0x60 AF1
0x64 AF2
0x68 TISEL

## RTC
Base 0x40002800
0x00 TR
  [31] OUT2EN, [31] ADD1S, [31] MSK4, [31] MSK4, [30] TAMPALRM_TYPE, [30] WDSEL, [30] WDSEL, [29] TAMPALRM_PU, [29:28] DT, [29:28] DT, [26] TAMPOE, [25] TAMPTS, [24] ITSE, [27:24] DU, [27:24] MASKSS, [27:24] DU, [27:24] MASKSS, [23] COE, [23] MSK3, [23] MSK3, [22] PM, [22] PM, [22] PM, [22] PM, [22:21] OSEL, [21:20] HT, [23:20] YT, [20] POL, [21:20] HT, [21:20] HT, [21:20] HT, [19] COSEL, [18] BKP, [17] SUB1H, [19:16] HU, [19:16] YU, [16] RECALPF, [22:16] PREDIV_A, [16] ADD1H, [19:16] HU, [19:16] HU, [19:16] HU, [15] TSIE, [15] CALP, [15] MSK2, [15] MSK2, [14] WUTIE, [14] CALW8, [15:13] WDU, [13] ALRBIE, [13] CALW16, [15:13] WDU, [14:12] MNT, [12] MT, [12] ALRAIE, [14:12] MNT, [12] MT, [14:12] MNT, [14:12] MNT, [11] TSE, [10] WUTE, [9] ALRBE, [11:8] MNU, [11:8] MU, [8] ALRAE, [11:8] MNU, [11:8] MU, [11:8] MNU, [11:8] MNU, [7] INIT, [7] MSK1, [7] MSK1, [6] INITF, [6] FMT, [5] RSF, [5] BYPSHAD, [5] ITSF, [5] ITSMF, [5] CITSF, [6:4] ST, [5:4] DT, [4] INITS, [4] REFCKON, [6:4] ST, [5:4] DT, [6:4] ST, [6:4] ST, [4] TSOVF, [4] TSOVMF, [4] CTSOVF, [3] SHPF, [3] TSEDGE, [3] TSF, [3] TSMF, [3] CTSF, [2] WUTWF, [2] WUTF, [2] WUTMF, [2] CWUTF, [1] ALRBWF, [1] ALRBF, [1] ALRBMF, [1] CALRBF, [3:0] SU, [3:0] DU, [15:0] SS, [0] ALRAWF, [14:0] PREDIV_S, [15:0] WUT, [2:0] WUCKSEL, [7:0] KEY, [8:0] CALM, [14:0] SUBFS, [3:0] SU, [3:0] DU, [15:0] SS, [3:0] SU, [14:0] SS, [3:0] SU, [14:0] SS, [0] ALRAF, [0] ALRAMF, [0] CALRAF
0x04 DR
0x08 SSR
0x0C ICSR
0x10 PRER
0x14 WUTR
0x18 CR
0x24 WPR
0x28 CALR
0x2C SHIFTR
0x30 TSTR
0x34 TSDR
0x38 TSSSR
0x40 ALRMAR
0x44 ALRMASSR
0x48 ALRMBR
0x4C ALRMBSSR
0x50 SR
0x54 MISR
0x5C SCR
0x60 OR
