# STM32G031xx register map
File version: 1.0
Registers are 32-bit, access not given, reset 0x0 unless marked. A register's access mark holds for its fields unless they carry their own. Offsets are from the block's base; [hi:lo] are bit positions; {n}, {i} and the like mark numbered series.

## VREFBUF
Base 0x40010030
0x00 CSR
  [3] VRR, [2] VRS, [1] HIZ, [0] ENVR, [5:0] TRIM
0x04 CCR

## ADC1
Base 0x40012400
0x00 ISR
  [31] ADCAL, [31:30] CKMODE, [29] LFTRIG, [28] ADVREGEN, [4n-1:4n-4] SQ{n} (n=2..8), [30:26] AWD1CH, [n+8] SMPSEL{n} (n=0..18), [25] LFMEN, [24] VBATEN, [23] AWD1EN, [23] TSEN, [22] AWD1SGL, [22] VREFEN, [21] CHSELRMOD, [18] CHSEL18, [21:18] PRESC, [17] CHSEL17, [16] DISCEN, [27:16] HT1, [27:16] HT2, [27:16] HT3, [15] AUTOFF, [15] CHSEL15, [14] WAIT, [14] CHSEL14, [13] CCRDY, [13] CCRDYIE, [13] CONT, [13] CHSEL13, [12] OVRMOD, [11] EOCAL, [11] EOCALIE, [11] CHSEL11, [11:10] EXTEN, [10] CHSEL10, [9] AWD3, [9] AWD3IE, [9] TOVS, [9] CHSEL9, [8] AWD2, [8] AWD2IE, [7] AWD1, [7] AWD1IE, [7] CHSEL7, [8:6] EXTSEL, [6] CHSEL6, [5] ALIGN, [8:5] OVSS, [5] CHSEL5, [4] OVR, [4] OVRIE, [4] ADSTP, [6:4] SMP2, [3] EOS, [3] EOSIE, [4:3] RES, [3] CHSEL3, [2] EOC, [2] EOCIE, [2] ADSTART, [2] SCANDIR, [4:2] OVSR, [2] CHSEL2, [1] EOSMP, [1] EOSMPIE, [1] ADDIS, [1] DMACFG, [1] CHSEL1, [0] ADRDY, [0] ADRDYIE, [0] ADEN, [0] DMAEN, [0] OVSE, [2:0] SMP1, [11:0] LT1, [11:0] LT2, [31:0] SQ_ALL, [11:0] LT3, [15:0] DATA, [18:0] AWD2CH, [18:0] AWD3CH, [6:0] CALFACT
0x04 IER
0x08 CR
0x0C CFGR1
0x10 CFGR2
0x14 SMPR
0x20 AWD1TR
0x24 AWD2TR
0x28 CHSELR
0x2C AWD3TR
0x40 DR
0xA0 AWD2CR
0xA4 AWD3CR
0xB4 CALFACT
0x308 CCR

## DBG
Base 0x40015800
0x00 IDCODE
  [31:16] REV_ID, [2] DBG_STANDBY, [1] DBG_STOP, [11:0] DEV_ID
0x04 CR
0x08 APBFZ1
0x0C APBFZ2

## DMA1
Base 0x40020000
0x00 ISR
  [4n-1] TEIF{n} (n=1..7), [4n-1] CTEIF{n} (n=1..7), [4n-2] HTIF{n} (n=1..7), [4n-2] CHTIF{n} (n=1..7), [4n-3] TCIF{n} (n=1..7), [4n-3] CTCIF{n} (n=1..7), [4n-4] GIF{n} (n=1..7), [4n-4] CGIF{n} (n=1..7), [14] MEM2MEM, [14] MEM2MEM, [14] MEM2MEM, [14] MEM2MEM, [14] MEM2MEM, [13:12] PL, [13:12] PL, [13:12] PL, [13:12] PL, [13:12] PL, [11:10] MSIZE, [11:10] MSIZE, [11:10] MSIZE, [11:10] MSIZE, [11:10] MSIZE, [9:8] PSIZE, [9:8] PSIZE, [9:8] PSIZE, [9:8] PSIZE, [9:8] PSIZE, [7] MINC, [7] MINC, [7] MINC, [7] MINC, [7] MINC, [6] PINC, [6] PINC, [6] PINC, [6] PINC, [6] PINC, [5] CIRC, [5] CIRC, [5] CIRC, [5] CIRC, [5] CIRC, [4] DIR, [4] DIR, [4] DIR, [4] DIR, [4] DIR, [3] TEIE, [3] TEIE, [3] TEIE, [3] TEIE, [3] TEIE, [2] HTIE, [2] HTIE, [2] HTIE, [2] HTIE, [2] HTIE, [1] TCIE, [1] TCIE, [1] TCIE, [1] TCIE, [1] TCIE, [0] EN, [15:0] NDT, [31:0] PA, [0] EN, [31:0] MA, [15:0] NDT, [31:0] PA, [0] EN, [31:0] MA, [15:0] NDT, [31:0] PA, [0] EN, [31:0] MA, [15:0] NDT, [31:0] PA, [0] EN, [31:0] MA, [15:0] NDT, [31:0] PA, [31:0] MA
0x04 IFCR
0x08 CCR1
0x0C CNDTR1
{0x0+0x14*i} CPAR{i} (i=1..5)
0x1C CCR2
{0xC+0x14*i} CMAR{i} (i=1..5)
0x20 CNDTR2
0x30 CCR3
0x34 CNDTR3
0x44 CCR4
0x48 CNDTR4
0x58 CCR5
0x5C CNDTR5

## DMAMUX1
Base 0x40020800
0x00 CCR0
0x04 CCR1
0x08 CCR2
0x0C CCR3
0x10 CCR4
0x80 CCRs
0x100 CCR0
0x104 CCR1
0x108 CCR2
0x10C CCR3
0x140 CCRs

## RCC
Base 0x40021000
0x00 CR
  [31] LPTIM1RST, [31] LPTIM1EN, [31] LPTIM1SMEN, [31] LPWRRSTF, [30] LPTIM2RST, [30] LPTIM2EN, [30] LPTIM2SMEN, [31:30] ADCSEL, [30] WWDGRSTF, [31:29] PLLR, [29] IWDGRSTF, [30:28] MCOPRE, [28] PLLREN, [28] PWRRST, [28] PWREN, [28] PWRSMEN, [28] SFTRSTF, [27] DBGRST, [27] DBGEN, [27] DBGSMEN, [27] PWRRSTF, [26] PINRSTF, [25] PLLRDY, [27:25] PLLQ, [25] LSCOSEL, [25] OBLRSTF, [24] PLLON, [26:24] MCOSEL, [24] PLLQEN, [24] LSCOEN, [23] RMVF, [22] I2C2RST, [22] I2C2EN, [22] I2C2SMEN, [22] TIM1SEL, [21] I2C1RST, [21] I2C1EN, [21] I2C1SMEN, [20] LPUART1RST, [20] ADCRST, [20] LPUART1EN, [20] ADCEN, [20] LPUART1SMEN, [20] ADCSMEN, [21:20] LPTIM2SEL, [19] CSSON, [18] HSEBYP, [18] TIM17RST, [18] TIM17EN, [18] TIM17SMEN, [19:18] LPTIM1SEL, [17] HSERDY, [21:17] PLLP, [17] USART2RST, [17] TIM16RST, [17] USART2EN, [17] TIM16EN, [17] USART2SMEN, [17] TIM16SMEN, [16] HSEON, [16] PLLPEN, [16] BDRST, [15] TIM14RST, [15] TIM14EN, [15] TIM14SMEN, [15] RTCEN, [14] SPI2RST, [14] USART1RST, [14] SPI2EN, [14] USART1EN, [14] SPI2SMEN, [14] USART1SMEN, [15:14] I2S1SEL, [14:12] PPRE, [12] CRCRST, [12] SPI1RST, [12] CRCEN, [12] SPI1EN, [12] CRCSMEN, [12] SPI1SMEN, [13:12] I2C1SEL, [13:11] HSIDIV, [11] TIM1RST, [11] WWDGEN, [11] TIM1EN, [11] WWDGSMEN, [11] TIM1SMEN, [10] HSIRDY, [10] RTCAPBEN, [10] RTCAPBSMEN, [11:10] LPUART1SEL, [9] HSIKERON, [9] LSECSSF, [9] LSECSSC, [9] SRAMSMEN, [8] HSION, [14:8] HSITRIM, [11:8] HPRE, [14:8] PLLN, [8] CSSF, [8] CSSC, [8] FLASHRST, [8] FLASHEN, [8] FLASHSMEN, [9:8] RTCSEL, [6] LSECSSD, [5] PLLRDYIE, [5] PLLRDYF, [5] PLLRDYC, [5] GPIOFRST, [5] GPIOFEN, [5] GPIOFSMEN, [5] LSECSSON, [6:4] PLLM, [4] HSERDYIE, [4] HSERDYF, [4] HSERDYC, [5:3] SWS, [3] HSIRDYIE, [3] HSIRDYF, [3] HSIRDYC, [3] GPIODRST, [3] GPIODEN, [3] GPIODSMEN, [4:3] LSEDRV, [2] GPIOCRST, [2] GPIOCEN, [2] GPIOCSMEN, [2] LSEBYP, [1] PLLSRC_HSI, [1] LSERDYIE, [1] LSERDYF, [1] LSERDYC, [1] GPIOBRST, [1] TIM3RST, [1] GPIOBEN, [1] TIM3EN, [1] GPIOBSMEN, [1] TIM3SMEN, [1] LSERDY, [1] LSIRDY, [7:0] HSICAL, [2:0] SW, [1:0] PLLSRC_HSE, [0] LSIRDYIE, [0] LSIRDYF, [0] LSIRDYC, [0] GPIOARST, [0] DMA1RST, [0] TIM2RST, [0] SYSCFGRST, [0] GPIOAEN, [0] DMA1EN, [0] TIM2EN, [0] SYSCFGEN, [0] GPIOASMEN, [0] DMA1SMEN, [0] TIM2SMEN, [0] SYSCFGSMEN, [1:0] USART1SEL, [0] LSEON, [0] LSION
0x04 ICSCR
0x08 CFGR
0x0C PLLCFGR
0x18 CIER
0x1C CIFR
0x20 CICR
0x24 IOPRSTR
0x28 AHBRSTR
0x2C APBRSTR1
0x30 APBRSTR2
0x34 IOPENR
0x38 AHBENR
0x3C APBENR1
0x40 APBENR2
0x44 IOPSMENR
0x48 AHBSMENR
0x4C APBSMENR1
0x50 APBSMENR2
0x54 CCIPR
0x5C BDCR
0x60 CSR

## EXTI
Base 0x40021800
0x00 RTSR1
  [n] IM{n} (n=28..31), [n] EM{n} (n=28..31), [25] IM25, [25] EM25, [8n+2:8n] EXTI{n} (n=0..3), [8n-30:8n-32] EXTI{n} (n=4..7), [8n-62:8n-64] EXTI{n} (n=8..11), [8n-94:8n-96] EXTI{n} (n=12..15), [23] IM23, [23] EM23, [21] IM21, [21] EM21, [19] IM19, [19] EM19, [n] RT{n} (n=0..16), [n] FT{n} (n=0..16), [n] SWI{n} (n=0..16), [n] RPIF{n} (n=0..16), [n] FPIF{n} (n=0..16), [n] IM{n} (n=0..16), [n] EM{n} (n=0..16)
0x04 FTSR1
0x08 SWIER1
0x0C RPR1
0x10 FPR1
0x60 EXTICR.0
0x64 EXTICR.1
0x68 EXTICR.2
0x6C EXTICR.3
0x80 IMR1
0x84 EMR1

## FLASH
Base 0x40022000
0x00 ACR
  [31] LOCK, [31] ECCD, [31] PCROP_RDP, [30] OPTLOCK, [30] ECCC, [29] IRHEN, [28] SEC_PROT, [27] OBL_LAUNCH, [28:27] NRST_MODE, [26] RDERRIE, [26] nBOOT0, [25] ERRIE, [25] nBOOT1, [24] EOPIE, [24] ECCCIE, [24] nBOOT_SEL, [22] RAM_PARITY_CHECK, [20] SYSF_ECC, [19] WWDG_SW, [18] DBG_SWEN, [18] CFGBSY, [18] FSTPG, [18] IWDG_STDBY, [17] OPTSTRT, [17] IWDG_STOP, [16] PROGEMPTY, [16] BSY1, [16] STRT, [16] IWDG_SW, [20:16] WRP1A_END, [20:16] WRP1B_END, [16] BOOT_LOCK, [15] OPTVERR, [15] nRST_SHDW, [14] RDERR, [14] nRST_STDBY, [13] nRST_STOP, [11] ICRST, [12:11] BORF_LEV, [9] ICEN, [9] FASTERR, [10:9] BORR_LEV, [8] PRFTEN, [8] MISERR, [8] BOR_EN, [7] PGSERR, [6] SIZERR, [5] PGAERR, [4] WRPERR, [3] PROGERR, [12:3] PNB, [2] MER1, [1] OPERR, [1] PER, [2:0] LATENCY, [0] EOP, [0] PG, [13:0] ADDR_ECC, [7:0] RDP, [6:0] PCROP1A_STRT, [6:0] PCROP1A_END, [4:0] WRP1A_STRT, [4:0] WRP1B_STRT, [6:0] PCROP1B_STRT, [6:0] PCROP1B_END, [5:0] SEC_SIZE
0x08 KEYR
0x0C OPTKEYR
0x10 SR
0x14 CR
0x18 ECCR
0x20 OPTR
0x24 PCROP1ASR
0x28 PCROP1AER
0x2C WRP1AR
0x30 WRP1BR
0x34 PCROP1BSR
0x38 PCROP1BER
0x80 SECR

## CRC
Base 0x40023000
0x00 DR
  [7] REV_OUT, [6:5] REV_IN, [4:3] POLYSIZE, [31:0] DR, [31:0] IDR, [0] RESET, [31:0] INIT, [31:0] POL
0x04 IDR
0x08 CR
0x10 INIT
0x14 POL

## GPIOA
Base 0x50000000
Same registers: GPIOB 0x50000400, GPIOC 0x50000800, GPIOD 0x50000C00, GPIOF 0x50001400
0x00 MODER
  [31] BR15, [2n+1:2n] MODE{n} (n=0..15), [2n+1:2n] OSPEED{n} (n=0..15), [2n+1:2n] PUPD{n} (n=0..15), [30] BR14, [29] BR13, [28] BR12, [4n+3:4n] AFSEL{n} (n=0..7), [4n-29:4n-32] AFSEL{n} (n=8..15), [27] BR11, [26] BR10, [25] BR9, [24] BR8, [23] BR7, [22] BR6, [21] BR5, [20] BR4, [19] BR3, [18] BR2, [17] BR1, [16] BR0, [16] LCKK, [n] OT{n} (n=0..15), [n] ID{n} (n=0..15), [n] OD{n} (n=0..15), [n] BS{n} (n=0..15), [n] LCK{n} (n=0..15), [15] BR15, [14] BR14, [13] BR13, [12] BR12, [11] BR11, [10] BR10, [9] BR9, [8] BR8, [7] BR7, [6] BR6, [5] BR5, [4] BR4, [3] BR3, [2] BR2, [1] BR1, [0] BR0
0x04 OTYPER
0x08 OSPEEDR
0x0C PUPDR
0x10 IDR
0x14 ODR
0x18 BSRR
0x1C LCKR
0x20 AFR.0
0x24 AFR.1
0x28 BRR
