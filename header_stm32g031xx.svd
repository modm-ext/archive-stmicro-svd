# STM32G031xx register map
File version: 1.0
Registers are 32-bit, access not given, reset 0x0 unless marked. A register's access mark holds for its fields unless they carry their own. Offsets are from the block's base; [hi:lo] are bit positions; {n}, {i} and the like mark numbered series.

## PWR
Base 0x40007000
0x00 CR1
  [15] EIWUL, [15] WUFI, [15] PU15, [15] PD15, [15] PU15, [15] PD15, [15] PU15, [15] PD15, [14] LPR, [14] PU14, [14] PD14, [14] PU14, [14] PD14, [14] PU14, [14] PD14, [13] PU13, [13] PD13, [13] PU13, [13] PD13, [13] PU13, [13] PD13, [12] PU12, [12] PD12, [12] PU12, [12] PD12, [11] PVDO, [11] PU11, [11] PD11, [11] PU11, [11] PD11, [10] APC, [10] VOSF, [10] PU10, [10] PD10, [10] PU10, [10] PD10, [10:9] VOS, [9] ENB_ULP, [9] VBRS, [9] REGLPF, [9] PU9, [9] PD9, [9] PU9, [9] PD9, [8] DBP, [8] RRS, [8] VBE, [8] SBF, [8] REGLPS, [8] CSBF, [8] PU8, [8] PD8, [8] PU8, [8] PD8, [7] FLASH_RDY, [7] PU7, [7] PD7, [7] PU7, [7] PD7, [7] PU7, [7] PD7, [6] PU6, [6] PD6, [6] PU6, [6] PD6, [6] PU6, [6] PD6, [5] FPD_LPSLP, [5] EWUP6, [5] WP6, [5] WUF6, [5] CWUF6, [5] PU5, [5] PD5, [5] PU5, [5] PD5, [4] FPD_LPRUN, [6:4] PVDRT, [4] PU4, [4] PD4, [4] PU4, [4] PD4, [3] FPD_STOP, [3] EWUP4, [3] WP4, [3] WUF4, [3] CWUF4, [3] PU3, [3] PD3, [3] PU3, [3] PD3, [3] PU3, [3] PD3, [2] PU2, [2] PD2, [2] PU2, [2] PD2, [2] PU2, [2] PD2, [2] PU2, [2] PD2, [3:1] PVDFT, [1] EWUP2, [1] WP2, [1] WUF2, [1] CWUF2, [1] PU1, [1] PD1, [1] PU1, [1] PD1, [1] PU1, [1] PD1, [1] PU1, [1] PD1, [2:0] LPMS, [0] PVDE, [0] EWUP1, [0] WP1, [0] WUF1, [0] CWUF1, [0] PU0, [0] PD0, [0] PU0, [0] PD0, [0] PU0, [0] PD0, [0] PU0, [0] PD0
0x04 CR2
0x08 CR3
0x0C CR4
0x10 SR1
0x14 SR2
0x18 SCR
0x20 PUCRA
0x24 PDCRA
0x28 PUCRB
0x2C PDCRB
0x30 PUCRC
0x34 PDCRC
0x38 PUCRD
0x3C PDCRD
0x48 PUCRF
0x4C PDCRF

## LPTIM1
Base 0x40007C00
Same registers: LPTIM2 0x40009400
0x00 ISR
  [24] ENC, [23] COUNTMODE, [22] PRELOAD, [21] WAVPOL, [20] WAVE, [19] TIMOUT, [18:17] TRIGEN, [15:13] TRIGSEL, [11:9] PRESC, [6] DOWN, [6] DOWNCF, [6] DOWNIE, [7:6] TRGFLT, [5] UP, [5] UPCF, [5] UPIE, [4] ARROK, [4] ARROKCF, [4] ARROKIE, [4] RSTARE, [7:4] IN2SEL, [3] CMPOK, [3] CMPOKCF, [3] CMPOKIE, [4:3] CKFLT, [3] COUNTRST, [2] EXTTRIG, [2] EXTTRIGCF, [2] EXTTRIGIE, [2] CNTSTRT, [1] ARRM, [1] ARRMCF, [1] ARRMIE, [2:1] CKPOL, [1] SNGSTRT, [0] CMPM, [0] CMPMCF, [0] CMPMIE, [0] CKSEL, [0] ENABLE, [15:0] CMP, [15:0] ARR, [15:0] CNT, [3:0] IN1SEL
0x04 ICR
0x08 IER
0x0C CFGR
0x10 CR
0x14 CMP
0x18 ARR
0x1C CNT
0x24 CFGR2

## TAMP
Base 0x4000B000
0x00 CR1
  [25] TAMP2TRG, [24] TAMP1TRG, [n+15] ITAMP{n}E (n=3..6), [n+15] ITAMP{n}IE (n=3..6), [n+15] ITAMP{n}F (n=3..6), [n+15] ITAMP{n}MF (n=3..6), [n+15] CITAMP{n}F (n=3..6), [17] TAMP2MSK, [16] TAMP1MSK, [7] TAMPPUDIS, [6:5] TAMPPRCH, [4:3] TAMPFLT, [1] TAMP2E, [1] TAMP2NOERASE, [1] TAMP2IE, [1] TAMP2F, [1] TAMP2MF, [1] CTAMP2F, [0] TAMP1E, [0] TAMP1NOERASE, [2:0] TAMPFREQ, [0] TAMP1IE, [0] TAMP1F, [0] TAMP1MF, [0] CTAMP1F
0x04 CR2
0x0C FLTCR
0x2C IER
0x30 SR
0x34 MISR
0x3C SCR
{0x100+4i} BKP{i}R (i=0..4)

## SYSCFG
Base 0x40010000
0x00 CFGR1
  [23] I2C_PA10_FMP, [23] PB2_CDEN, [22] I2C_PA9_FMP, [22] PB1_CDEN, [21] I2C2_FMP, [21] PB0_CDEN, [20] I2C1_FMP, [20] PA13_CDEN, [n+10] I2C_PB{n}_FMP (n=6..9), [19] PA6_CDEN, [18] PA5_CDEN, [17] PA3_CDEN, [16] PA1_CDEN, [8] BOOSTEN, [8] SPF, [7:6] IR_MOD, [5] IR_POL, [4] PA12_RMP, [3] PA11_RMP, [3] ECCL, [2] PVDL, [1] SPL, [1:0] MEM_MODE, [0] CLL
0x18 CFGR2
0x80 IT_LINE_SR.0
0x84 IT_LINE_SR.1
0x88 IT_LINE_SR.2
0x8C IT_LINE_SR.3
0x90 IT_LINE_SR.4
0x94 IT_LINE_SR.5
0x98 IT_LINE_SR.6
0x9C IT_LINE_SR.7
0xA0 IT_LINE_SR.8
0xA4 IT_LINE_SR.9
0xA8 IT_LINE_SR.10
0xAC IT_LINE_SR.11
0xB0 IT_LINE_SR.12
0xB4 IT_LINE_SR.13
0xB8 IT_LINE_SR.14
0xBC IT_LINE_SR.15
0xC0 IT_LINE_SR.16
0xC4 IT_LINE_SR.17
0xC8 IT_LINE_SR.18
0xCC IT_LINE_SR.19
0xD0 IT_LINE_SR.20
0xD4 IT_LINE_SR.21
0xD8 IT_LINE_SR.22
0xDC IT_LINE_SR.23
0xE0 IT_LINE_SR.24
0xE4 IT_LINE_SR.25
0xE8 IT_LINE_SR.26
0xEC IT_LINE_SR.27
0xF0 IT_LINE_SR.28
0xF4 IT_LINE_SR.29
0xF8 IT_LINE_SR.30
0xFC IT_LINE_SR.31
