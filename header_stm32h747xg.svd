# STM32H747xG register map
File version: 1.0
Registers are 32-bit, access not given, reset 0x0 unless marked. A register's access mark holds for its fields unless they carry their own. Offsets are from the block's base; [hi:lo] are bit positions.

## HSEM
Base 0x58026400
0x00 R.0
  [31] LOCK, [31] LOCK, [31] LOCK, [31] LOCK, [31] LOCK, [31] LOCK, [31] LOCK, [31] LOCK, [31] LOCK, [31] LOCK, [31] LOCK, [31] LOCK, [31] LOCK, [31] LOCK, [31] LOCK, [31] LOCK, [31] LOCK, [31] LOCK, [31] LOCK, [31] LOCK, [31] LOCK, [31] LOCK, [31] LOCK, [31] LOCK, [31] LOCK, [31] LOCK, [31] LOCK, [31] LOCK, [31] LOCK, [31] LOCK, [31] LOCK, [31] LOCK, [31] LOCK, [31] LOCK, [31] LOCK, [31] LOCK, [31] LOCK, [31] LOCK, [31] LOCK, [31] LOCK, [31] LOCK, [31] LOCK, [31] LOCK, [31] LOCK, [31] LOCK, [31] LOCK, [31] LOCK, [31] LOCK, [31] LOCK, [31] LOCK, [31] LOCK, [31] LOCK, [31] LOCK, [31] LOCK, [31] LOCK, [31] LOCK, [31] LOCK, [31] LOCK, [31] LOCK, [31] LOCK, [31] LOCK, [31] LOCK, [31] LOCK, [31] LOCK, [31] ISE31, [31] ISC31, [31] ISF31, [31] MISF31, [31] ISE31, [31] ISC31, [31] ISF31, [31] MISF31, [30] ISE30, [30] ISC30, [30] ISF30, [30] MISF30, [30] ISE30, [30] ISC30, [30] ISF30, [30] MISF30, [29] ISE29, [29] ISC29, [29] ISF29, [29] MISF29, [29] ISE29, [29] ISC29, [29] ISF29, [29] MISF29, [28] ISE28, [28] ISC28, [28] ISF28, [28] MISF28, [28] ISE28, [28] ISC28, [28] ISF28, [28] MISF28, [27] ISE27, [27] ISC27, [27] ISF27, [27] MISF27, [27] ISE27, [27] ISC27, [27] ISF27, [27] MISF27, [26] ISE26, [26] ISC26, [26] ISF26, [26] MISF26, [26] ISE26, [26] ISC26, [26] ISF26, [26] MISF26, [25] ISE25, [25] ISC25, [25] ISF25, [25] MISF25, [25] ISE25, [25] ISC25, [25] ISF25, [25] MISF25, [24] ISE24, [24] ISC24, [24] ISF24, [24] MISF24, [24] ISE24, [24] ISC24, [24] ISF24, [24] MISF24, [23] ISE23, [23] ISC23, [23] ISF23, [23] MISF23, [23] ISE23, [23] ISC23, [23] ISF23, [23] MISF23, [22] ISE22, [22] ISC22, [22] ISF22, [22] MISF22, [22] ISE22, [22] ISC22, [22] ISF22, [22] MISF22, [21] ISE21, [21] ISC21, [21] ISF21, [21] MISF21, [21] ISE21, [21] ISC21, [21] ISF21, [21] MISF21, [20] ISE20, [20] ISC20, [20] ISF20, [20] MISF20, [20] ISE20, [20] ISC20, [20] ISF20, [20] MISF20, [19] ISE19, [19] ISC19, [19] ISF19, [19] MISF19, [19] ISE19, [19] ISC19, [19] ISF19, [19] MISF19, [18] ISE18, [18] ISC18, [18] ISF18, [18] MISF18, [18] ISE18, [18] ISC18, [18] ISF18, [18] MISF18, [17] ISE17, [17] ISC17, [17] ISF17, [17] MISF17, [17] ISE17, [17] ISC17, [17] ISF17, [17] MISF17, [16] ISE16, [16] ISC16, [16] ISF16, [16] MISF16, [16] ISE16, [16] ISC16, [16] ISF16, [16] MISF16, [31:16] KEY, [31:16] KEY, [15] ISE15, [15] ISC15, [15] ISF15, [15] MISF15, [15] ISE15, [15] ISC15, [15] ISF15, [15] MISF15, [14] ISE14, [14] ISC14, [14] ISF14, [14] MISF14, [14] ISE14, [14] ISC14, [14] ISF14, [14] MISF14, [13] ISE13, [13] ISC13, [13] ISF13, [13] MISF13, [13] ISE13, [13] ISC13, [13] ISF13, [13] MISF13, [12] ISE12, [12] ISC12, [12] ISF12, [12] MISF12, [12] ISE12, [12] ISC12, [12] ISF12, [12] MISF12, [11] ISE11, [11] ISC11, [11] ISF11, [11] MISF11, [11] ISE11, [11] ISC11, [11] ISF11, [11] MISF11, [10] ISE10, [10] ISC10, [10] ISF10, [10] MISF10, [10] ISE10, [10] ISC10, [10] ISF10, [10] MISF10, [9] ISE9, [9] ISC9, [9] ISF9, [9] MISF9, [9] ISE9, [9] ISC9, [9] ISF9, [9] MISF9, [15:8] COREID, [15:8] COREID, [15:8] COREID, [15:8] COREID, [15:8] COREID, [15:8] COREID, [15:8] COREID, [15:8] COREID, [15:8] COREID, [15:8] COREID, [15:8] COREID, [15:8] COREID, [15:8] COREID, [15:8] COREID, [15:8] COREID, [15:8] COREID, [15:8] COREID, [15:8] COREID, [15:8] COREID, [15:8] COREID, [15:8] COREID, [15:8] COREID, [15:8] COREID, [15:8] COREID, [15:8] COREID, [15:8] COREID, [15:8] COREID, [15:8] COREID, [15:8] COREID, [15:8] COREID, [15:8] COREID, [15:8] COREID, [15:8] COREID, [15:8] COREID, [15:8] COREID, [15:8] COREID, [15:8] COREID, [15:8] COREID, [15:8] COREID, [15:8] COREID, [15:8] COREID, [15:8] COREID, [15:8] COREID, [15:8] COREID, [15:8] COREID, [15:8] COREID, [15:8] COREID, [15:8] COREID, [15:8] COREID, [15:8] COREID, [15:8] COREID, [15:8] COREID, [15:8] COREID, [15:8] COREID, [15:8] COREID, [15:8] COREID, [15:8] COREID, [15:8] COREID, [15:8] COREID, [15:8] COREID, [15:8] COREID, [15:8] COREID, [15:8] COREID, [15:8] COREID, [8] ISE8, [8] ISC8, [8] ISF8, [8] MISF8, [8] ISE8, [8] ISC8, [8] ISF8, [8] MISF8, [15:8] COREID, [7] ISE7, [7] ISC7, [7] ISF7, [7] MISF7, [7] ISE7, [7] ISC7, [7] ISF7, [7] MISF7, [6] ISE6, [6] ISC6, [6] ISF6, [6] MISF6, [6] ISE6, [6] ISC6, [6] ISF6, [6] MISF6, [5] ISE5, [5] ISC5, [5] ISF5, [5] MISF5, [5] ISE5, [5] ISC5, [5] ISF5, [5] MISF5, [4] ISE4, [4] ISC4, [4] ISF4, [4] MISF4, [4] ISE4, [4] ISC4, [4] ISF4, [4] MISF4, [3] ISE3, [3] ISC3, [3] ISF3, [3] MISF3, [3] ISE3, [3] ISC3, [3] ISF3, [3] MISF3, [2] ISE2, [2] ISC2, [2] ISF2, [2] MISF2, [2] ISE2, [2] ISC2, [2] ISF2, [2] MISF2, [1] ISE1, [1] ISC1, [1] ISF1, [1] MISF1, [1] ISE1, [1] ISC1, [1] ISF1, [1] MISF1, [7:0] PROCID, [7:0] PROCID, [7:0] PROCID, [7:0] PROCID, [7:0] PROCID, [7:0] PROCID, [7:0] PROCID, [7:0] PROCID, [7:0] PROCID, [7:0] PROCID, [7:0] PROCID, [7:0] PROCID, [7:0] PROCID, [7:0] PROCID, [7:0] PROCID, [7:0] PROCID, [7:0] PROCID, [7:0] PROCID, [7:0] PROCID, [7:0] PROCID, [7:0] PROCID, [7:0] PROCID, [7:0] PROCID, [7:0] PROCID, [7:0] PROCID, [7:0] PROCID, [7:0] PROCID, [7:0] PROCID, [7:0] PROCID, [7:0] PROCID, [7:0] PROCID, [7:0] PROCID, [7:0] PROCID, [7:0] PROCID, [7:0] PROCID, [7:0] PROCID, [7:0] PROCID, [7:0] PROCID, [7:0] PROCID, [7:0] PROCID, [7:0] PROCID, [7:0] PROCID, [7:0] PROCID, [7:0] PROCID, [7:0] PROCID, [7:0] PROCID, [7:0] PROCID, [7:0] PROCID, [7:0] PROCID, [7:0] PROCID, [7:0] PROCID, [7:0] PROCID, [7:0] PROCID, [7:0] PROCID, [7:0] PROCID, [7:0] PROCID, [7:0] PROCID, [7:0] PROCID, [7:0] PROCID, [7:0] PROCID, [7:0] PROCID, [7:0] PROCID, [7:0] PROCID, [7:0] PROCID, [0] ISE0, [0] ISC0, [0] ISF0, [0] MISF0, [0] ISE0, [0] ISC0, [0] ISF0, [0] MISF0
0x04 R.1
0x08 R.2
0x0C R.3
0x10 R.4
0x14 R.5
0x18 R.6
0x1C R.7
0x20 R.8
0x24 R.9
0x28 R.10
0x2C R.11
0x30 R.12
0x34 R.13
0x38 R.14
0x3C R.15
0x40 R.16
0x44 R.17
0x48 R.18
0x4C R.19
0x50 R.20
0x54 R.21
0x58 R.22
0x5C R.23
0x60 R.24
0x64 R.25
0x68 R.26
0x6C R.27
0x70 R.28
0x74 R.29
0x78 R.30
0x7C R.31
0x80 RLR.0
0x84 RLR.1
0x88 RLR.2
0x8C RLR.3
0x90 RLR.4
0x94 RLR.5
0x98 RLR.6
0x9C RLR.7
0xA0 RLR.8
0xA4 RLR.9
0xA8 RLR.10
0xAC RLR.11
0xB0 RLR.12
0xB4 RLR.13
0xB8 RLR.14
0xBC RLR.15
0xC0 RLR.16
0xC4 RLR.17
0xC8 RLR.18
0xCC RLR.19
0xD0 RLR.20
0xD4 RLR.21
0xD8 RLR.22
0xDC RLR.23
0xE0 RLR.24
0xE4 RLR.25
0xE8 RLR.26
0xEC RLR.27
0xF0 RLR.28
0xF4 RLR.29
0xF8 RLR.30
0xFC RLR.31
0x100 C1IER
0x104 C1ICR
0x108 C1ISR
0x10C C1MISR
0x110 C2IER
0x114 C2ICR
0x118 C2ISR
0x11C C2MISR
0x140 CR
0x144 KEYR
