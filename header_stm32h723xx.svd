# STM32H723xx register map
File version: 1.0
Registers are 32-bit, access not given, reset 0x0 unless marked. A register's access mark holds for its fields unless they carry their own. Offsets are from the block's base; [hi:lo] are bit positions; {n}, {i} and the like mark numbered series.

## HSEM
Base 0x58026400
0x00 R.0
  [31] LOCK, [31] LOCK, [31] LOCK, [31] LOCK, [31] LOCK, [31] LOCK, [31] LOCK, [31] LOCK, [31] LOCK, [31] LOCK, [31] LOCK, [31] LOCK, [31] LOCK, [31] LOCK, [31] LOCK, [31] LOCK, [31] LOCK, [31] LOCK, [31] LOCK, [31] LOCK, [31] LOCK, [31] LOCK, [31] LOCK, [31] LOCK, [31] LOCK, [31] LOCK, [31] LOCK, [31] LOCK, [31] LOCK, [31] LOCK, [31] LOCK, [31] LOCK, [31] LOCK, [31] LOCK, [31] LOCK, [31] LOCK, [31] LOCK, [31] LOCK, [31] LOCK, [31] LOCK, [31] LOCK, [31] LOCK, [31] LOCK, [31] LOCK, [31] LOCK, [31] LOCK, [31] LOCK, [31] LOCK, [31] LOCK, [31] LOCK, [31] LOCK, [31] LOCK, [31] LOCK, [31] LOCK, [31] LOCK, [31] LOCK, [31] LOCK, [31] LOCK, [31] LOCK, [31] LOCK, [31] LOCK, [31] LOCK, [31] LOCK, [31] LOCK, [n] ISE{n} (n=0..31), [n] ISC{n} (n=0..31), [n] ISF{n} (n=0..31), [n] MISF{n} (n=0..31), [31:16] KEY, [31:16] KEY, [15:8] COREID, [15:8] COREID, [15:8] COREID, [15:8] COREID, [15:8] COREID, [15:8] COREID, [15:8] COREID, [15:8] COREID, [15:8] COREID, [15:8] COREID, [15:8] COREID, [15:8] COREID, [15:8] COREID, [15:8] COREID, [15:8] COREID, [15:8] COREID, [15:8] COREID, [15:8] COREID, [15:8] COREID, [15:8] COREID, [15:8] COREID, [15:8] COREID, [15:8] COREID, [15:8] COREID, [15:8] COREID, [15:8] COREID, [15:8] COREID, [15:8] COREID, [15:8] COREID, [15:8] COREID, [15:8] COREID, [15:8] COREID, [15:8] COREID, [15:8] COREID, [15:8] COREID, [15:8] COREID, [15:8] COREID, [15:8] COREID, [15:8] COREID, [15:8] COREID, [15:8] COREID, [15:8] COREID, [15:8] COREID, [15:8] COREID, [15:8] COREID, [15:8] COREID, [15:8] COREID, [15:8] COREID, [15:8] COREID, [15:8] COREID, [15:8] COREID, [15:8] COREID, [15:8] COREID, [15:8] COREID, [15:8] COREID, [15:8] COREID, [15:8] COREID, [15:8] COREID, [15:8] COREID, [15:8] COREID, [15:8] COREID, [15:8] COREID, [15:8] COREID, [15:8] COREID, [15:8] COREID, [7:0] PROCID, [7:0] PROCID, [7:0] PROCID, [7:0] PROCID, [7:0] PROCID, [7:0] PROCID, [7:0] PROCID, [7:0] PROCID, [7:0] PROCID, [7:0] PROCID, [7:0] PROCID, [7:0] PROCID, [7:0] PROCID, [7:0] PROCID, [7:0] PROCID, [7:0] PROCID, [7:0] PROCID, [7:0] PROCID, [7:0] PROCID, [7:0] PROCID, [7:0] PROCID, [7:0] PROCID, [7:0] PROCID, [7:0] PROCID, [7:0] PROCID, [7:0] PROCID, [7:0] PROCID, [7:0] PROCID, [7:0] PROCID, [7:0] PROCID, [7:0] PROCID, [7:0] PROCID, [7:0] PROCID, [7:0] PROCID, [7:0] PROCID, [7:0] PROCID, [7:0] PROCID, [7:0] PROCID, [7:0] PROCID, [7:0] PROCID, [7:0] PROCID, [7:0] PROCID, [7:0] PROCID, [7:0] PROCID, [7:0] PROCID, [7:0] PROCID, [7:0] PROCID, [7:0] PROCID, [7:0] PROCID, [7:0] PROCID, [7:0] PROCID, [7:0] PROCID, [7:0] PROCID, [7:0] PROCID, [7:0] PROCID, [7:0] PROCID, [7:0] PROCID, [7:0] PROCID, [7:0] PROCID, [7:0] PROCID, [7:0] PROCID, [7:0] PROCID, [7:0] PROCID, [7:0] PROCID
0x04 R.1
0x08 R.2
0x0C R.3
0x10 R.4
0x14 R.5
0x18 R.6
0x1C R.7
0x20 R.8
0x24 R.9
0x28 R.10
0x2C R.11
0x30 R.12
0x34 R.13
0x38 R.14
0x3C R.15
0x40 R.16
0x44 R.17
0x48 R.18
0x4C R.19
0x50 R.20
0x54 R.21
0x58 R.22
0x5C R.23
0x60 R.24
0x64 R.25
0x68 R.26
0x6C R.27
0x70 R.28
0x74 R.29
0x78 R.30
0x7C R.31
0x80 RLR.0
0x84 RLR.1
0x88 RLR.2
0x8C RLR.3
0x90 RLR.4
0x94 RLR.5
0x98 RLR.6
0x9C RLR.7
0xA0 RLR.8
0xA4 RLR.9
0xA8 RLR.10
0xAC RLR.11
0xB0 RLR.12
0xB4 RLR.13
0xB8 RLR.14
0xBC RLR.15
0xC0 RLR.16
0xC4 RLR.17
0xC8 RLR.18
0xCC RLR.19
0xD0 RLR.20
0xD4 RLR.21
0xD8 RLR.22
0xDC RLR.23
0xE0 RLR.24
0xE4 RLR.25
0xE8 RLR.26
0xEC RLR.27
0xF0 RLR.28
0xF4 RLR.29
0xF8 RLR.30
0xFC RLR.31
0x100 C1IER
0x104 C1ICR
0x108 C1ISR
0x10C C1MISR
0x140 CR
0x144 KEYR

## HSEM_COMMON
Base 0x58026500
0x00 IER
0x04 ICR
0x08 ISR
0x0C MISR

## DBGMCU
Base 0x5C001000
0x00 IDCODE
  [28] DBG_TRGOEN, [25] DBG_I2C5, [24] DBG_TIM24, [23] DBG_I2C3, [22] DBG_CKD3EN, [22] DBG_I2C2, [21] DBG_CKD1EN, [21] DBG_I2C1, [20] DBG_TRACECKEN, [18] DBG_TIM17, [18] DBG_IWDG1, [17] DBG_TIM16, [31:16] REV_ID, [16] DBG_TIM15, [16] DBG_RTC, [n+7] DBG_LPTIM{n} (n=2..5), [9] DBG_LPTIM1, [8] DBG_STANDBYD3, [8] DBG_TIM14, [7] DBG_STOPD3, [7] DBG_TIM13, [7] DBG_I2C4, [6] DBG_WWDG1, [6] DBG_TIM12, [n-2] DBG_TIM{n} (n=2..7), [7:4] 4KCOUNT, [7:4] JEP106ID, [7:4] REVISION, [7:4] REVAND, [3] JEDEC, [2] DBG_STANDBYD1, [1] DBG_STOPD1, [1] DBG_TIM8, [11:0] DEV_ID, [0] DBG_SLEEPD1, [0] DBG_TIM1, [3:0] JEP106CON, [7:0] PARTNUM, [3:0] PARTNUM, [2:0] JEP106ID, [3:0] CMOD
0x04 CR
0x34 APB3FZ1
0x3C APB1LFZ1
0x44 APB1HFZ1
0x4C APB2FZ1
0x54 APB4FZ1
0xFD0 PIDR4
{0xFE0+4i} PIDR{i} (i=0..3)
{0xFF0+4i} CIDR{i} (i=0..3)
