# STM32H723xx register map
File version: 1.0
Registers are 32-bit, access not given, reset 0x0 unless marked. A register's access mark holds for its fields unless they carry their own. Offsets are from the block's base; [hi:lo] are bit positions; {n}, {i} and the like mark numbered series.

## OPAMP
Base 0x40009000
0x00 CSR
  [30] CALOUT, [29] TSTREF, [18] USERTRIM, [17:14] PGGAIN, [13:12] CALSEL, [11] CALON, [8] OPAHSM, [12:8] TRIMOFFSETP, [12:8] TRIMHSOFFSETP, [6:5] VMSEL, [3:2] VPSEL, [1] FORCEVP, [0] OPAMPxEN, [4:0] TRIMOFFSETN, [4:0] TRIMHSOFFSETN
0x04 OTR
0x08 HSOTR

## OPAMP1
Base 0x40009000
Same registers: OPAMP2 0x40009010
0x00 CSR
  [30] CALOUT, [29] TSTREF, [18] USERTRIM, [17:14] PGGAIN, [13:12] CALSEL, [11] CALON, [8] OPAHSM, [12:8] TRIMOFFSETP, [12:8] TRIMHSOFFSETP, [6:5] VMSEL, [3:2] VPSEL, [1] FORCEVP, [0] OPAMPxEN, [4:0] TRIMOFFSETN, [4:0] TRIMHSOFFSETN
0x04 OTR
0x08 HSOTR

## MDIOS
Base 0x40009400
0x00 CR
  [12:8] PORT_ADDRESS, [7] DPC, [3] EIE, [2] RDIE, [2] TERF, [1] WRIE, [1] SERF, [0] EN, [0] PERF
0x04 WRFR
0x08 CWRFR
0x0C RDFR
0x10 CRDFR
0x14 SR
0x18 CLRFR
{0x100+4i} DINR{i} (i=0..31)
{0x180+4i} DOUTR{i} (i=0..31)

## FDCAN1
Base 0x4000A000
Same registers: FDCAN2 0x4000A400, FDCAN3 0x4000D400
0x00 CREL
  [n] ND{n} (n=0..31), [n-32] ND{n} (n=32..63), [31] F0OM, [31] F1OM, [30] TFQM, [29] ARA, [29] ARAE, [29] ARAE, [31:28] REL, [28] PED, [28] PEDE, [28] PEDE, [27] PEA, [27] PEAE, [27] PEAE, [26] WDI, [26] WDIE, [26] WDIE, [31:25] NSJW, [25] BO, [25] BOE, [25] BOE, [25] RF0L, [25] RF1L, [25] TEFL, [27:24] STEP, [24] EW, [24] EWE, [24] EWE, [30:24] F0WM, [24] F0F, [30:24] F1WM, [24] F1F, [29:24] TFQS, [29:24] EFWM, [24] EFF, [23] TDC, [23] EP, [23] EPE, [23] EPE, [22] ELO, [22] ELOE, [22] ELOE, [21] BEUE, [21] BEUE, [21] TFQF, [23:20] SUBSTEP, [20] BECE, [20] BECE, [19] DRX, [19] DRXE, [19] DRXE, [18] TOO, [18] TOOE, [18] TOOE, [17] MRAF, [17] MRAFE, [17] MRAFE, [19:16] YEAR, [20:16] DBRP, [24:16] NBRP, [19:16] TCP, [31:16] TOP, [23:16] CEL, [22:16] TDCV, [16] TSW, [16] TSWE, [16] TSWL, [23:16] LSS, [22:16] LSE, [22:16] F0S, [21:16] F0PI, [22:16] F1S, [21:16] F1PI, [21:16] NDTB, [20:16] TFQPI, [21:16] EFS, [20:16] EFPI, [15] NISO, [15] RP, [15] TEFL, [15] TEFLE, [15] TEFLL, [15] FLST, [14] TXP, [14] PXE, [14] TEFF, [14] TEFFE, [14] TEFFL, [13] EFBI, [13] REDL, [13] TEFW, [13] TEFWE, [13] TEFWL, [12] PXHD, [12] RBRS, [12] TEFN, [12] TEFNE, [12] TEFNL, [11] RESI, [11] TFE, [11] TFEE, [11] TFEL, [10] TCF, [10] TCFE, [10] TCFL, [9] BRSE, [9] TC, [9] TCE, [9] TCL, [15:8] MON, [12:8] DTSEG1, [15:8] WDV, [8] FDOE, [15:8] NTSEG1, [14:8] REC, [10:8] DLEC, [14:8] TDCO, [8] HPM, [8] HPME, [8] HPML, [14:8] FIDX, [13:8] F0GI, [13:8] F1GI, [10:8] RBDS, [12:8] TFGI, [12:8] EFGI, [7] RX, [7] TEST, [7] BO, [7] RF1L, [7] RF1LE, [7] RF1LL, [6] DAR, [6] EW, [6] RF1F, [6] RF1FE, [6] RF1FL, [7:6] MSI, [6:5] TX, [5] MON, [5] EP, [5] RF1W, [5] RF1WE, [5] RF1WL, [7:4] DTSEG2, [4] LBCK, [4] CSR, [4] RF1N, [4] RF1NE, [4] RF1NL, [5:4] ANFS, [6:4] F1DS, [3] CSA, [4:3] ACT, [3] RF0L, [3] RF0LE, [3] RF0LL, [2] ASM, [2] RF0F, [2] RF0FE, [2] RF0FL, [3:2] ANFE, [15:2] FLSSA, [15:2] FLESA, [15:2] F0SA, [15:2] RBSA, [15:2] F1SA, [15:2] TBSA, [15:2] EFSA, [1] CCE, [2:1] TOS, [1] RF0W, [1] RF0WE, [1] RF0WL, [1] EINT1, [1] RRFS, [7:0] DAY, [31:0] ETV, [3:0] DSJW, [7:0] WDC, [0] INIT, [6:0] NTSEG2, [1:0] TSS, [15:0] TSC, [0] ETOC, [15:0] TOC, [7:0] TEC, [2:0] LEC, [6:0] TDCF, [0] RF0N, [0] RF0NE, [0] RF0NL, [0] EINT0, [0] RRFE, [28:0] EIDM, [5:0] BIDX, [6:0] F0FL, [5:0] F0AI, [6:0] F1FL, [5:0] F1AI, [2:0] F0DS, [5:0] TFFL, [2:0] TBDS, [31:0] TRP, [31:0] AR, [31:0] CR, [31:0] TO, [31:0] CF, [31:0] TIE, [31:0] CFIE, [5:0] EFFL, [4:0] EFAI
0x04 ENDN
0x0C DBTP
0x10 TEST
0x14 RWD
0x18 CCCR
0x1C NBTP
0x20 TSCC
0x24 TSCV
0x28 TOCC
0x2C TOCV
0x40 ECR
0x44 PSR
0x48 TDCR
0x50 IR
0x54 IE
0x58 ILS
0x5C ILE
0x80 GFC
0x84 SIDFC
0x88 XIDFC
0x90 XIDAM
0x94 HPMS
0x98 NDAT1
0x9C NDAT2
0xA0 RXF0C
0xA4 RXF0S
0xA8 RXF0A
0xAC RXBC
0xB0 RXF1C
0xB4 RXF1S
0xB8 RXF1A
0xBC RXESC
0xC0 TXBC
0xC4 TXFQS
0xC8 TXESC
0xCC TXBRP
0xD0 TXBAR
0xD4 TXBCR
0xD8 TXBTO
0xDC TXBCF
0xE0 TXBTIE
0xE4 TXBCIE
0xF0 TXEFC
0xF4 TXEFS
0xF8 TXEFA
