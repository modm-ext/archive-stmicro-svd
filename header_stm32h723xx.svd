# STM32H723xx register map
File version: 1.0
Registers are 32-bit, access not given, reset 0x0 unless marked. A register's access mark holds for its fields unless they carry their own. Offsets are from the block's base; [hi:lo] are bit positions; {n}, {i} and the like mark numbered series.

## PSSI
Base 0x48020400
0x00 CR
  [31] OUTEN, [30] DMAEN, [20:18] DERDYCFG, [14] ENABLE, [11:10] EDM, [8] RDYPOL, [6] DEPOL, [5] CKPOL, [3] RTT1B, [2] RTT4B, [1] OVR_RIS, [1] OVR_IE, [1] OVR_MIS, [1] OVR_ISC, [31:0] DR
0x04 SR
0x08 RIS
0x0C IER
0x10 MIS
0x14 ICR
0x28 DR
0x3F0 HWCFGR
0x3F4 VERR
0x3F8 IPIDR
0x3FC SIDR

## RNG
Base 0x48021800
0x00 CR
  [31] CONFIGLOCK, [30] CONDRST, [25:20] RNG_CONFIG1, [19:16] CLKDIV, [15:13] RNG_CONFIG2, [12] NISTC, [11:8] RNG_CONFIG3, [6] SEIS, [5] CED, [5] CEIS, [3] IE, [2] RNGEN, [2] SECS, [1] CECS, [0] DRDY
0x04 SR
0x08 DR
0x10 HTCR

## SDMMC2
Base 0x48022400
Same registers: SDMMC1 0x52007000
0x00 POWER
  [28] IDMABTC, [28] IDMABTCC, [28] IDMABTCIE, [27] IDMATE, [27] IDMATEC, [26] CKSTOP, [26] CKSTOPC, [26] CKSTOPIE, [25] VSWEND, [25] VSWENDC, [25] VSWENDIE, [24] ACKTIMEOUT, [24] ACKTIMEOUTC, [24] ACKTIMEOUTIE, [23] ACKFAIL, [23] ACKFAILC, [23] ACKFAILIE, [22] SDIOIT, [22] SDIOITC, [22] SDIOITIE, [21] BUSYD0END, [21] BUSYD0ENDC, [21] BUSYD0ENDIE, [21:20] SELCLKRX, [20] BUSYD0, [19] BUSSPEED, [19] RXFIFOE, [18] DDR, [18] TXFIFOE, [18] TXFIFOEIE, [17] HWFC_EN, [17] RXFIFOF, [17] RXFIFOFIE, [16] NEGEDGE, [16] CMDSUSPEND, [16] TXFIFOF, [15] BOOTEN, [15] RXFIFOHF, [15] RXFIFOHFIE, [15:14] WIDBUS, [14] BOOTMODE, [14] TXFIFOHE, [14] TXFIFOHEIE, [13] DTHOLD, [13] FIFORST, [13] CPSMACT, [12] PWRSAV, [12] CPSMEN, [12] BOOTACKEN, [12] DPSMACT, [11] WAITPEND, [11] SDIOEN, [11] DABORT, [11] DABORTC, [11] DABORTIE, [10] WAITINT, [10] RWMOD, [10] DBCKEND, [10] DBCKENDC, [10] DBCKENDIE, [9] RWSTOP, [9] DHOLD, [9] DHOLDC, [9] DHOLDIE, [9:8] WAITRESP, [8] RWSTART, [8] DATAEND, [8] DATAENDC, [8] DATAENDIE, [7] CMDSTOP, [7] CMDSENT, [7] CMDSENTC, [7] CMDSENTIE, [6] CMDTRANS, [6] CMDREND, [6] CMDRENDC, [6] CMDRENDIE, [5] RXOVERR, [5] RXOVERRC, [5] RXOVERRIE, [12:5] IDMABNDT, [4] DIRPOL, [7:4] DBLOCKSIZE, [4] TXUNDERR, [4] TXUNDERRC, [4] TXUNDERRIE, [3] VSWITCHEN, [3] DTIMEOUT, [3] DTIMEOUTC, [3] DTIMEOUTIE, [2] VSWITCH, [3:2] DTMODE, [2] CTIMEOUT, [2] CTIMEOUTC, [2] CTIMEOUTIE, [1] DTDIR, [1] DCRCFAIL, [1] DCRCFAILC, [1] DCRCFAILIE, [1:0] PWRCTRL, [9:0] CLKDIV, [31:0] CMDARG, [5:0] CMDINDEX, [5:0] RESPCMD, [31:0] CARDSTATUS{n} (n=1..4), [31:0] DATATIME, [24:0] DATALENGTH, [0] DTEN, [24:0] DATACOUNT, [0] CCRCFAIL, [0] CCRCFAILC, [0] CCRCFAILIE, [24:0] ACKTIME, [31:0] FIFODATA
0x04 CLKCR
0x08 ARG
0x0C CMD
0x10 RESPCMD
{0x10+4i} RESP{i} (i=1..4)
0x24 DTIMER
0x28 DLEN
0x2C DCTRL
0x30 DCOUNT
0x34 STA
0x38 ICR
0x3C MASK
0x40 ACKTIME
0x50 IDMACTRL
0x54 IDMABSIZE
0x58 IDMABASE0
0x5C IDMABASE1
0x80 FIFO
0x3FC IPVR

## DLYB_SDMMC2
Base 0x48022800
Same registers: DLYB_OCTOSPI1 0x52006000, DLYB_SDMMC1 0x52008000, DLYB_OCTOSPI2 0x5200B000
0x00 CR
  [31] LNGF, [27:16] LNG, [14:8] UNIT, [1] SEN, [0] DEN, [3:0] SEL
0x04 CFGR

## RAMECC2
Base 0x48023000
Same registers: RAMECC1 0x52009000, RAMECC3 0x58027000
0x00 IER
  [5] ECCELEN, [5] ECCELEN, [5] ECCELEN, [5] ECCELEN, [5] ECCELEN, [5] ECCELEN, [5] ECCELEN, [5] ECCELEN, [5] ECCELEN, [5] ECCELEN, [5] ECCELEN, [4] ECCDEBWIE, [4] ECCDEBWIE, [4] ECCDEBWIE, [4] ECCDEBWIE, [4] ECCDEBWIE, [4] ECCDEBWIE, [4] ECCDEBWIE, [4] ECCDEBWIE, [4] ECCDEBWIE, [4] ECCDEBWIE, [4] ECCDEBWIE, [3] GECCDEBWIE, [3] ECCDEIE, [3] ECCDEIE, [3] ECCDEIE, [3] ECCDEIE, [3] ECCDEIE, [3] ECCDEIE, [3] ECCDEIE, [3] ECCDEIE, [3] ECCDEIE, [3] ECCDEIE, [3] ECCDEIE, [2] GECCDEIE, [2] ECCSEIE, [2] ECCSEIE, [2] ECCSEIE, [2] DEBWDF, [2] DEBWDF, [2] DEBWDF, [2] ECCSEIE, [2] ECCSEIE, [2] ECCSEIE, [2] DEBWDF, [2] DEBWDF, [2] DEBWDF, [2] ECCSEIE, [2] ECCSEIE, [2] DEBWDF, [2] DEBWDF, [2] ECCSEIE, [2] DEBWDF, [2] ECCSEIE, [2] DEBWDF, [2] ECCSEIE, [2] DEBWDF, [1] GECCSEIE, [1] DEDF, [1] DEDF, [1] DEDF, [1] DEDF, [1] DEDF, [1] DEDF, [1] DEDF, [1] DEDF, [1] DEDF, [1] DEDF, [1] DEDF, [0] GIE, [0] SEDCF, [0] SEDCF, [0] SEDCF, [31:0] FDATAL, [31:0] FDATAL, [31:0] FDATAL, [0] SEDCF, [0] SEDCF, [0] SEDCF, [31:0] FDATAL, [31:0] FDATAL, [31:0] FDATAL, [31:0] FEC, [31:0] FEC, [31:0] FEC, [0] SEDCF, [0] SEDCF, [31:0] FDATAL, [31:0] FDATAL, [31:0] FEC, [31:0] FEC, [31:0] FEC, [0] SEDCF, [31:0] FDATAL, [31:0] FEC, [31:0] FEC, [0] SEDCF, [31:0] FDATAL, [31:0] FEC, [0] SEDCF, [31:0] FDATAL, [31:0] FEC, [31:0] FEC
{0x0+0x20*i} CR{i} (i=1..6)
{0x4+0x20*i} SR{i} (i=1..6)
{0xC+0x20*i} FAR{i} (i=1..6)
{0x18+0x20*i} FDRL{i} (i=1..6)
{0x28+0x20*i} FDRH{i} (i=1..6)
{0x3C+0x20*i} FECR{i} (i=1..6)
