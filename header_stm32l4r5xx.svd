# STM32L4R5xx register map
File version: 1.0
Registers are 32-bit, access not given, reset 0x0 unless marked. A register's access mark holds for its fields unless they carry their own. Offsets are from the block's base; [hi:lo] are bit positions; {n}, {i} and the like mark numbered series.

## DMAMUX1
Base 0x40020800
0x00 CCR0
0x04 CCR1
0x08 CCR2
0x0C CCR3
{0x0+4i} CCR{i} (i=4..9)
0x28 CCR0
0x2C CCR1
0x30 CCR2
0x34 CCR3
0x80 CCRs
0x100 CCR0
0x104 CCR1
0x108 CCR2
0x10C CCR3
0x140 CCRs

## FLASH
Base 0x40022000
0x00 ACR
  [31] LOCK, [31] ECCD, [31] PCROP_RDP, [30] OPTLOCK, [30] ECCC, [29] ECCD2, [28] ECCC2, [27] OBL_LAUNCH, [27] nBOOT0, [26] RDERRIE, [26] nSWBOOT0, [25] ERRIE, [25] SRAM2_RST, [24] EOPIE, [24] ECCIE, [24] SRAM2_PE, [23] nBOOT1, [22] SYSF_ECC, [22] DBANK, [21] BK_ECC, [21] DB1M, [20] BFB2, [19] WWDG_SW, [18] FSTPG, [18] IWDG_STDBY, [17] PEMPTY, [17] OPTSTRT, [17] IWDG_STOP, [16] BSY, [16] STRT, [16] IWDG_SW, [23:16] WRP1A_END, [23:16] WRP1B_END, [23:16] WRP2A_END, [23:16] WRP2B_END, [15] OPTVERR, [15] MER2, [14] SLEEP_PD, [14] RDERR, [14] nRST_SHDW, [13] RUN_PD, [13] nRST_STDBY, [12] DCRST, [12] nRST_STOP, [11] ICRST, [11] BKER, [10] DCEN, [9] ICEN, [9] FASTERR, [8] PRFTEN, [8] MISERR, [10:8] BOR_LEV, [7] PGSERR, [6] SIZERR, [5] PGAERR, [4] WRPERR, [3] PROGERR, [10:3] PNB, [2] MER1, [1] OPERR, [1] PER, [3:0] LATENCY, [0] EOP, [0] PG, [19:0] ADDR_ECC, [7:0] RDP, [16:0] PCROP1_STRT, [16:0] PCROP1_END, [7:0] WRP1A_STRT, [7:0] WRP1B_STRT, [16:0] PCROP2_STRT, [16:0] PCROP2_END, [7:0] WRP2A_STRT, [7:0] WRP2B_STRT, [0] LVEN
0x04 PDKEYR
0x08 KEYR
0x0C OPTKEYR
0x10 SR
0x14 CR
0x18 ECCR
0x20 OPTR
0x24 PCROP1SR
0x28 PCROP1ER
0x2C WRP1AR
0x30 WRP1BR
0x44 PCROP2SR
0x48 PCROP2ER
0x4C WRP2AR
0x50 WRP2BR
0x130 CFGR

## CRC
Base 0x40023000
0x00 DR
  [7] REV_OUT, [6:5] REV_IN, [4:3] POLYSIZE, [31:0] DR, [31:0] IDR, [0] RESET, [31:0] INIT, [31:0] POL
0x04 IDR
0x08 CR
0x10 INIT
0x14 POL

## TSC
Base 0x40024000
0x00 CR
  [31] G8_IO4, [31] G8_IO4, [31] G8_IO4, [31] G8_IO4, [30] G8_IO3, [30] G8_IO3, [30] G8_IO3, [30] G8_IO3, [29] G8_IO2, [29] G8_IO2, [29] G8_IO2, [29] G8_IO2, [31:28] CTPH, [28] G8_IO1, [28] G8_IO1, [28] G8_IO1, [28] G8_IO1, [27] G7_IO4, [27] G7_IO4, [27] G7_IO4, [27] G7_IO4, [26] G7_IO3, [26] G7_IO3, [26] G7_IO3, [26] G7_IO3, [25] G7_IO2, [25] G7_IO2, [25] G7_IO2, [25] G7_IO2, [27:24] CTPL, [24] G7_IO1, [24] G7_IO1, [24] G7_IO1, [24] G7_IO1, [23] G6_IO4, [23] G6_IO4, [23] G6_IO4, [23] G6_IO4, [n+15] G{n}S (n=1..8), [22] G6_IO3, [22] G6_IO3, [22] G6_IO3, [22] G6_IO3, [21] G6_IO2, [21] G6_IO2, [21] G6_IO2, [21] G6_IO2, [20] G6_IO1, [20] G6_IO1, [20] G6_IO1, [20] G6_IO1, [19] G5_IO4, [19] G5_IO4, [19] G5_IO4, [19] G5_IO4, [18] G5_IO3, [18] G5_IO3, [18] G5_IO3, [18] G5_IO3, [23:17] SSD, [17] G5_IO2, [17] G5_IO2, [17] G5_IO2, [17] G5_IO2, [16] SSE, [16] G5_IO1, [16] G5_IO1, [16] G5_IO1, [16] G5_IO1, [15] SSPSC, [15] G4_IO4, [15] G4_IO4, [15] G4_IO4, [15] G4_IO4, [14] G4_IO3, [14] G4_IO3, [14] G4_IO3, [14] G4_IO3, [13] G4_IO2, [13] G4_IO2, [13] G4_IO2, [13] G4_IO2, [14:12] PGPSC, [12] G4_IO1, [12] G4_IO1, [12] G4_IO1, [12] G4_IO1, [11] G3_IO4, [11] G3_IO4, [11] G3_IO4, [11] G3_IO4, [10] G3_IO3, [10] G3_IO3, [10] G3_IO3, [10] G3_IO3, [9] G3_IO2, [9] G3_IO2, [9] G3_IO2, [9] G3_IO2, [8] G3_IO1, [8] G3_IO1, [8] G3_IO1, [8] G3_IO1, [7] G2_IO4, [7] G2_IO4, [7] G2_IO4, [7] G2_IO4, [n-1] G{n}E (n=1..8), [6] G2_IO3, [6] G2_IO3, [6] G2_IO3, [6] G2_IO3, [7:5] MCV, [5] G2_IO2, [5] G2_IO2, [5] G2_IO2, [5] G2_IO2, [4] IODEF, [4] G2_IO1, [4] G2_IO1, [4] G2_IO1, [4] G2_IO1, [3] SYNCPOL, [3] G1_IO4, [3] G1_IO4, [3] G1_IO4, [3] G1_IO4, [2] AM, [2] G1_IO3, [2] G1_IO3, [2] G1_IO3, [2] G1_IO3, [1] START, [1] MCEIE, [1] MCEIC, [1] MCEF, [1] G1_IO2, [1] G1_IO2, [1] G1_IO2, [1] G1_IO2, [0] TSCE, [0] EOAIE, [0] EOAIC, [0] EOAF, [0] G1_IO1, [0] G1_IO1, [0] G1_IO1, [0] G1_IO1, [13:0] CNT, [13:0] CNT, [13:0] CNT, [13:0] CNT, [13:0] CNT, [13:0] CNT, [13:0] CNT, [13:0] CNT
0x04 IER
0x08 ICR
0x0C ISR
0x10 IOHCR
0x18 IOASCR
0x20 IOSCR
0x28 IOCCR
0x30 IOGCSR
0x34 IOGXCR.0
0x38 IOGXCR.1
0x3C IOGXCR.2
0x40 IOGXCR.3
0x44 IOGXCR.4
0x48 IOGXCR.5
0x4C IOGXCR.6
0x50 IOGXCR.7
