# STM32L4R5xx register map
File version: 1.0
Registers are 32-bit, access not given, reset 0x0 unless marked. A register's access mark holds for its fields unless they carry their own. Offsets are from the block's base; [hi:lo] are bit positions; {n}, {i} and the like mark numbered series.

## CRS
Base 0x40006000
0x00 CR
  [31] SYNCPOL, [29:28] SYNCSRC, [26:24] SYNCDIV, [23:16] FELIM, [31:16] FECAP, [15] FEDIR, [10] TRIMOVF, [9] SYNCMISS, [13:8] TRIM, [8] SYNCERR, [7] SWSYNC, [6] AUTOTRIMEN, [5] CEN, [3] ESYNCIE, [3] ESYNCF, [3] ESYNCC, [2] ERRIE, [2] ERRF, [2] ERRC, [1] SYNCWARNIE, [1] SYNCWARNF, [1] SYNCWARNC, [0] SYNCOKIE, [15:0] RELOAD, [0] SYNCOKF, [0] SYNCOKC
0x04 CFGR
0x08 ISR
0x0C ICR

## PWR
Base 0x40007000
0x00 CR1
  [15] EIWUL, [15] WUFI, [n+11] PVMO{n} (n=1..4), [n] PA{n} (n=12..15), [15] PB15, [15] PB15, [15] PC15, [15] PC15, [15] PD15, [15] PD15, [15] PE15, [15] PE15, [15] PF15, [15] PF15, [15] PG15, [15] PG15, [15] PH15, [15] PH15, [14] LPR, [14] PB14, [14] PB14, [14] PC14, [14] PC14, [14] PD14, [14] PD14, [14] PE14, [14] PE14, [14] PF14, [14] PF14, [14] PG14, [14] PG14, [14] PH14, [14] PH14, [13] PB13, [13] PB13, [13] PC13, [13] PC13, [13] PD13, [13] PD13, [13] PE13, [13] PE13, [13] PF13, [13] PF13, [13] PG13, [13] PG13, [13] PH13, [13] PH13, [12] DSIPDEN, [12] PA12, [12] PB12, [12] PB12, [12] PC12, [12] PC12, [12] PD12, [12] PD12, [12] PE12, [12] PE12, [12] PF12, [12] PF12, [12] PG12, [12] PG12, [12] PH12, [12] PH12, [11] PVDO, [11] PA11, [11] PA11, [11] PB11, [11] PB11, [11] PC11, [11] PC11, [11] PD11, [11] PD11, [11] PE11, [11] PE11, [11] PF11, [11] PF11, [11] PG11, [11] PG11, [11] PH11, [11] PH11, [11] PI11, [11] PI11, [10] USV, [10] APC, [10] VOSF, [10] PA10, [10] PA10, [10] PB10, [10] PB10, [10] PC10, [10] PC10, [10] PD10, [10] PD10, [10] PE10, [10] PE10, [10] PF10, [10] PF10, [10] PG10, [10] PG10, [10] PH10, [10] PH10, [10] PI10, [10] PI10, [10:9] VOS, [9] IOSV, [9] VBRS, [9] REGLPF, [9] PA9, [9] PA9, [9] PB9, [9] PB9, [9] PC9, [9] PC9, [9] PD9, [9] PD9, [9] PE9, [9] PE9, [9] PF9, [9] PF9, [9] PG9, [9] PG9, [9] PH9, [9] PH9, [9] PI9, [9] PI9, [8] DBP, [8] RRS, [8] VBE, [8] SBF, [8] REGLPS, [8] CSBF, [8] PA8, [8] PA8, [8] PB8, [8] PB8, [8] PC8, [8] PC8, [8] PD8, [8] PD8, [8] PE8, [8] PE8, [8] PF8, [8] PF8, [8] PG8, [8] PG8, [8] PH8, [8] PH8, [8] PI8, [8] PI8, [8] R1MODE, [n+3] PVME{n} (n=1..4), [7] PA7, [7] PA7, [7] PB7, [7] PB7, [7] PC7, [7] PC7, [7] PD7, [7] PD7, [7] PE7, [7] PE7, [7] PF7, [7] PF7, [7] PG7, [7] PG7, [7] PH7, [7] PH7, [7] PI7, [7] PI7, [6] PA6, [6] PA6, [6] PB6, [6] PB6, [6] PC6, [6] PC6, [6] PD6, [6] PD6, [6] PE6, [6] PE6, [6] PF6, [6] PF6, [6] PG6, [6] PG6, [6] PH6, [6] PH6, [6] PI6, [6] PI6, [5] PA5, [5] PA5, [5] PB5, [5] PB5, [5] PC5, [5] PC5, [5] PD5, [5] PD5, [5] PE5, [5] PE5, [5] PF5, [5] PF5, [5] PG5, [5] PG5, [5] PH5, [5] PH5, [5] PI5, [5] PI5, [4] RRSTP, [n-1] EWUP{n} (n=1..5), [n-1] WP{n} (n=1..5), [n-1] WUF{n} (n=1..5), [n-1] CWUF{n} (n=1..5), [4] PA4, [4] PA4, [4] PB4, [4] PC4, [4] PC4, [4] PD4, [4] PD4, [4] PE4, [4] PE4, [4] PF4, [4] PF4, [4] PG4, [4] PG4, [4] PH4, [4] PH4, [4] PI4, [4] PI4, [3] PLS_LEV4, [3] PA3, [3] PA3, [3] PB3, [3] PB3, [3] PC3, [3] PC3, [3] PD3, [3] PD3, [3] PE3, [3] PE3, [3] PF3, [3] PF3, [3] PG3, [3] PG3, [3] PH3, [3] PH3, [3] PI3, [3] PI3, [2] LPMS_SHUTDOWN, [3:2] PLS_LEV6, [2] PA2, [2] PA2, [2] PB2, [2] PB2, [2] PC2, [2] PC2, [2] PD2, [2] PD2, [2] PE2, [2] PE2, [2] PF2, [2] PF2, [2] PG2, [2] PG2, [2] PH2, [2] PH2, [2] PI2, [2] PI2, [1] LPMS_STOP2, [3:1] PLS_LEV7, [1] PA1, [1] PA1, [1] PB1, [1] PB1, [1] PC1, [1] PC1, [1] PD1, [1] PD1, [1] PE1, [1] PE1, [1] PF1, [1] PF1, [1] PG1, [1] PG1, [1] PH1, [1] PH1, [1] PI1, [1] PI1, [0] LPMS_STOP1, [0] PVDE, [0] PA0, [0] PA0, [0] PB0, [0] PB0, [0] PC0, [0] PC0, [0] PD0, [0] PD0, [0] PE0, [0] PE0, [0] PF0, [0] PF0, [0] PG0, [0] PG0, [0] PH0, [0] PH0, [0] PI0, [0] PI0
0x04 CR2
0x08 CR3
0x0C CR4
0x10 SR1
0x14 SR2
0x18 SCR
0x20 PUCRA
0x24 PDCRA
0x28 PUCRB
0x2C PDCRB
0x30 PUCRC
0x34 PDCRC
0x38 PUCRD
0x3C PDCRD
0x40 PUCRE
0x44 PDCRE
0x48 PUCRF
0x4C PDCRF
0x50 PUCRG
0x54 PDCRG
0x58 PUCRH
0x5C PDCRH
0x60 PUCRI
0x64 PDCRI
0x80 CR5
