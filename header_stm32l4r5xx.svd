# STM32L4R5xx register map
File version: 1.0
Registers are 32-bit, access not given, reset 0x0 unless marked. A register's access mark holds for its fields unless they carry their own. Offsets are from the block's base; [hi:lo] are bit positions; {n}, {i} and the like mark numbered series.

## ADC1
Base 0x50040000
0x00 ISR
  [31] ADCAL, [31] JQDIS, [31] SMPPLUS, [31] OFFSET{n}_EN (n=1..4), [30] ADCALDIF, [29] DEEPPWD, [28] ADVREGEN, [3n+2:3n] SMP{n} (n=0..9), [30:26] AWD1CH, [6n+6:6n+2] JSQ{n} (n=1..4), [30:26] OFFSET{n}_CH (n=1..4), [25] JAUTO, [24] JAWD1EN, [3n-28:3n-30] SMP{n} (n=10..18), [6n+4:6n] SQ{n} (n=1..4), [6n-26:6n-30] SQ{n} (n=5..9), [6n-56:6n-60] SQ{n} (n=10..14), [24] VBATEN, [23] AWD1EN, [23] TSEN, [22] AWD1SGL, [22] VREFEN, [21] JQM, [20] JDISCEN, [21:18] PRESC, [19:17] DISCNUM, [16] DISCEN, [27:16] HT1, [23:16] HT2, [23:16] HT3, [22:16] CALFACT_D, [17:16] CKMODE, [14] AUTDLY, [13] CONT, [12] OVRMOD, [10] JQOVF, [10] JQOVFIE, [11:10] EXTEN, [10] ROVSM, [9] AWD3, [9] AWD3IE, [9] TROVS, [8] AWD2, [8] AWD2IE, [7] AWD1, [7] AWD1IE, [6] JEOS, [6] JEOSIE, [9:6] EXTSEL, [10:6] SQ16, [7:6] JEXTEN, [5] JEOC, [5] JEOCIE, [5] JADSTP, [5] ALIGN, [8:5] OVSS, [4] OVR, [4] OVRIE, [4] ADSTP, [3] EOS, [3] EOSIE, [3] JADSTART, [4:3] RES, [2] EOC, [2] EOCIE, [2] ADSTART, [2] DFSDMCFG, [4:2] OVSR, [5:2] JEXTSEL, [1] EOSMP, [1] EOSMPIE, [1] ADDIS, [1] DMACFG, [1] JOVSE, [0] ADRDY, [0] ADRDYIE, [0] ADEN, [0] DMAEN, [0] ROVSE, [11:0] LT1, [7:0] LT2, [7:0] LT3, [3:0] L, [4:0] SQ15, [15:0] RDATA, [1:0] JL, [11:0] OFFSET{n} (n=1..4), [15:0] JDATA, [15:0] JDATA, [15:0] JDATA, [15:0] JDATA, [18:0] AWD2CH, [18:0] AWD3CH, [18:0] DIFSEL, [6:0] CALFACT_S
0x04 IER
0x08 CR
0x0C CFGR
0x10 CFGR2
0x14 SMPR1
0x18 SMPR2
{0x1C+4i} TR{i} (i=1..3)
{0x2C+4i} SQR{i} (i=1..4)
0x40 DR
0x4C JSQR
{0x5C+4i} OFR{i} (i=1..4)
{0x7C+4i} JDR{i} (i=1..4)
0xA0 AWD2CR
0xA4 AWD3CR
0xB0 DIFSEL
0xB4 CALFACT
0x308 CCR

## DCMI
Base 0x50050000
0x00 CR
  [31:24] FEC, [31:24] FEU, [8n+7:8n] BYTE{n} (n=0..3), [20] OELS, [19] LSM, [18] OEBS, [17:16] BSM, [23:16] LEC, [23:16] LEU, [14] ENABLE, [11:10] EDM, [9:8] FCRC, [15:8] LSC, [15:8] LSU, [7] VSPOL, [6] HSPOL, [5] PCKPOL, [4] ESS, [4] LINE_IE, [4] LINE_ISC, [3] JPEG, [3] VSYNC_IE, [3] VSYNC_ISC, [2] CROP, [2] FNE, [2] ERR_IE, [2] ERR_ISC, [1] CM, [1] VSYNC, [1] OVR_IE, [1] OVR_ISC, [0] CAPTURE, [0] HSYNC, [4:0] INT_IE, [0] FRAME_ISC, [7:0] FSC, [7:0] FSU
0x04 SR
0x08 RISR
0x0C IER
0x10 MISR
0x14 ICR
0x18 ESCR
0x1C ESUR
0x20 CWSTRTR
0x24 CWSIZER
0x28 DR

## RNG
Base 0x50060800
0x00 CR
  [6] SEIS, [5] CED, [5] CEIS, [3] IE, [2] RNGEN, [2] SECS, [1] CECS, [0] DRDY
0x04 SR
0x08 DR

## OCTOSPIM
Base 0x50061C00
0x04 PCR.0
  [26:25] IOHSRC, [26:25] IOHSRC, [24] IOHEN, [24] IOHEN, [18:17] IOLSRC, [18:17] IOLSRC, [16] IOLEN, [16] IOLEN, [9] NCSSRC, [9] NCSSRC, [8] NCSEN, [8] NCSEN, [5] DQSSRC, [5] DQSSRC, [4] DQSEN, [4] DQSEN, [1] CLKSRC, [1] CLKSRC, [0] CLKEN, [0] CLKEN
0x08 PCR.1

## SDMMC1
Base 0x50062400
0x00 POWER
  [28] IDMABTC, [28] IDMABTCC, [28] IDMABTCIE, [27] IDMATE, [27] IDMATEC, [26] CKSTOP, [26] CKSTOPC, [26] CKSTOPIE, [25] VSWEND, [25] VSWENDC, [25] VSWENDIE, [24] ACKTIMEOUT, [24] ACKTIMEOUTC, [24] ACKTIMEOUTIE, [23] ACKFAIL, [23] ACKFAILC, [23] ACKFAILIE, [22] SDIOIT, [22] SDIOITC, [22] SDIOITIE, [21] BUSYD0END, [21] BUSYD0ENDC, [21] BUSYD0ENDIE, [21:20] SELCLKRX, [20] BUSYD0, [19] BUSSPEED, [19] RXFIFOE, [18] DDR, [18] TXFIFOE, [18] TXFIFOEIE, [17] HWFC_EN, [17] RXFIFOF, [17] RXFIFOFIE, [16] NEGEDGE, [16] CMDSUSPEND, [16] TXFIFOF, [15] BOOTEN, [15] RXFIFOHF, [15] RXFIFOHFIE, [15:14] WIDBUS, [14] BOOTMODE, [14] TXFIFOHE, [14] TXFIFOHEIE, [13] DTHOLD, [13] FIFORST, [13] CPSMACT, [12] PWRSAV, [12] CPSMEN, [12] BOOTACKEN, [12] DPSMACT, [11] WAITPEND, [11] SDIOEN, [11] DABORT, [11] DABORTC, [11] DABORTIE, [10] WAITINT, [10] RWMOD, [10] DBCKEND, [10] DBCKENDC, [10] DBCKENDIE, [9] RWSTOP, [9] DHOLD, [9] DHOLDC, [9] DHOLDIE, [9:8] WAITRESP, [8] RWSTART, [8] DATAEND, [8] DATAENDC, [8] DATAENDIE, [7] CMDSTOP, [7] CMDSENT, [7] CMDSENTC, [7] CMDSENTIE, [6] CMDTRANS, [6] CMDREND, [6] CMDRENDC, [6] CMDRENDIE, [5] RXOVERR, [5] RXOVERRC, [5] RXOVERRIE, [4] DIRPOL, [7:4] DBLOCKSIZE, [4] TXUNDERR, [4] TXUNDERRC, [4] TXUNDERRIE, [3] VSWITCHEN, [3] DTIMEOUT, [3] DTIMEOUTC, [3] DTIMEOUTIE, [2] VSWITCH, [3:2] DTMODE, [2] CTIMEOUT, [2] CTIMEOUTC, [2] CTIMEOUTIE, [1] DTDIR, [1] DCRCFAIL, [1] DCRCFAILC, [1] DCRCFAILIE, [1:0] PWRCTRL, [9:0] CLKDIV, [31:0] CMDARG, [5:0] CMDINDEX, [5:0] RESPCMD, [31:0] CARDSTATUS{n} (n=1..4), [31:0] DATATIME, [24:0] DATALENGTH, [0] DTEN, [24:0] DATACOUNT, [0] CCRCFAIL, [0] CCRCFAILC, [0] CCRCFAILIE, [31:0] FIFODATA
0x04 CLKCR
0x08 ARG
0x0C CMD
0x10 RESPCMD
{0x10+4i} RESP{i} (i=1..4)
0x24 DTIMER
0x28 DLEN
0x2C DCTRL
0x30 DCOUNT
0x34 STA
0x38 ICR
0x3C MASK
0x40 ACKTIME
0x50 IDMACTRL
0x54 IDMABSIZE
0x58 IDMABASE0
0x5C IDMABASE1
0x80 FIFO

## FMC_Bank1_R
Base 0xA0000000
0x00 BTCR.0
0x04 BTCR.1
0x08 BTCR.2
0x0C BTCR.3
0x10 BTCR.4
0x14 BTCR.5
0x18 BTCR.6
0x1C BTCR.7

## FMC_Bank3_R
Base 0xA0000080
0x00 PCR
  [31:24] MEMHIZ, [31:24] ATTHIZ, [19:17] ECCPS, [23:16] MEMHOLD, [23:16] ATTHOLD, [16:13] TAR, [12:9] TCLR, [15:8] MEMWAIT, [15:8] ATTWAIT, [6] ECCEN, [6] FEMPT, [5] IFEN, [5:4] PWID, [4] ILEN, [3] PTYP, [3] IREN, [2] PBKEN, [2] IFS, [1] PWAITEN, [1] ILS, [0] IRS, [7:0] MEMSET, [7:0] ATTSET, [31:0] ECC
0x04 SR
0x08 PMEM
0x0C PATT
0x14 ECCR

## FMC_Bank1E_R
Base 0xA0000104
0x00 BWTR.0
  [31:30] DATAHLD, [31:30] DATAHLD, [31:30] DATAHLD, [31:30] DATAHLD, [31:30] DATAHLD, [31:30] DATAHLD, [31:30] DATAHLD, [29:28] ACCMOD, [29:28] ACCMOD, [29:28] ACCMOD, [29:28] ACCMOD, [29:28] ACCMOD, [29:28] ACCMOD, [29:28] ACCMOD, [19:16] BUSTURN, [19:16] BUSTURN, [19:16] BUSTURN, [19:16] BUSTURN, [19:16] BUSTURN, [19:16] BUSTURN, [19:16] BUSTURN, [15:8] DATAST, [15:8] DATAST, [15:8] DATAST, [15:8] DATAST, [15:8] DATAST, [15:8] DATAST, [15:8] DATAST, [7:4] ADDHLD, [7:4] ADDHLD, [7:4] ADDHLD, [7:4] ADDHLD, [7:4] ADDHLD, [7:4] ADDHLD, [7:4] ADDHLD, [3:0] ADDSET, [3:0] ADDSET, [3:0] ADDSET, [3:0] ADDSET, [3:0] ADDSET, [3:0] ADDSET, [3:0] ADDSET
0x04 BWTR.1
0x08 BWTR.2
0x0C BWTR.3
0x10 BWTR.4
0x14 BWTR.5
0x18 BWTR.6

## OCTOSPI1
Base 0xA0001000
Same registers: OCTOSPI2 0xA0001400
0x00 CR
  [31] SIOO, [30] SSHIFT, [29] DQSE, [29] DQSE, [29:28] FMODE, [28] DHQC, [27] DDTR, [27] DDTR, [26:24] MTYP, [26:24] DMODE, [26:24] DMODE, [23] PMM, [22] APMS, [20] TOIE, [21:20] ABSIZE, [21:20] ABSIZE, [19] SMIE, [19] ABDTR, [19] ABDTR, [18] FTIE, [17] TCIE, [16] TEIE, [20:16] DEVSIZE, [20:16] CSBOUND, [18:16] ABMODE, [18:16] ABMODE, [23:16] TRWR, [13:12] ADSIZE, [13:12] ADSIZE, [11] ADDTR, [11] ADDTR, [12:8] FTHRES, [10:8] CSHT, [13:8] FLEVEL, [10:8] ADMODE, [10:8] ADMODE, [15:8] TACC, [7] FSEL, [6] DQM, [5] BUSY, [4] TOF, [4] TOF, [5:4] ISIZE, [5:4] ISIZE, [3] TCEN, [3] DLYBYP, [3] SMF, [3] CSMF, [3] IDTR, [3] IDTR, [2] DMAEN, [2] FTF, [1] ABORT, [1] FRCK, [1] TCF, [1] CTCF, [1] WZL, [0] EN, [0] CKMODE, [7:0] PRESCALER, [0] TEF, [0] CTEF, [31:0] DL, [31:0] ADDRESS, [31:0] DATA, [31:0] MASK, [31:0] MATCH, [15:0] INTERVAL, [2:0] IMODE, [4:0] DCYC, [31:0] INSTRUCTION, [31:0] ALTERNATE, [15:0] TIMEOUT, [2:0] IMODE, [4:0] DCYC, [31:0] INSTRUCTION, [31:0] ALTERNATE, [0] LM
{0x4+4i} DCR{i} (i=1..3)
0x20 SR
0x24 FCR
0x40 DLR
0x48 AR
0x50 DR
0x80 PSMKR
0x88 PSMAR
0x90 PIR
0x100 CCR
0x108 TCR
0x110 IR
0x120 ABR
0x130 LPTR
0x180 WCCR
0x188 WTCR
0x190 WIR
0x1A0 WABR
0x200 HLCR

## DBGMCU
Base 0xE0042000
0x00 IDCODE
  [31] DBG_LPTIM1_STOP, [25] DBG_CAN_STOP, [23] DBG_I2C3_STOP, [22] DBG_I2C2_STOP, [21] DBG_I2C1_STOP, [18] DBG_TIM17_STOP, [17] DBG_TIM16_STOP, [31:16] REV_ID, [16] DBG_TIM15_STOP, [13] DBG_TIM8_STOP, [12] DBG_IWDG_STOP, [11] DBG_WWDG_STOP, [11] DBG_TIM1_STOP, [10] DBG_RTC_STOP, [7:6] TRACE_MODE, [5] TRACE_IOEN, [n-2] DBG_TIM{n}_STOP (n=2..7), [5] DBG_LPTIM2_STOP, [2] DBG_STANDBY, [1] DBG_STOP, [1] DBG_I2C4_STOP, [11:0] DEV_ID, [0] DBG_SLEEP
0x04 CR
0x08 APB1FZR1
0x0C APB1FZR2
0x10 APB2FZ
