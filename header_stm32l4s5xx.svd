# STM32L4S5xx register map
File version: 1.0
STM32L4S5AII3,STM32L4S5AII6,STM32L4S5AII7,STM32L4S5QII3,STM32L4S5QII6,STM32L4S5QII7,STM32L4S5VIT3,STM32L4S5VIT6,STM32L4S5VIT7,STM32L4S5ZIT6,STM32L4S5ZIY6
Registers are 32-bit, access not given, reset 0x0 unless marked. A register's access mark holds for its fields unless they carry their own. Offsets are from the block's base; lines under a group give offsets from that group; [hi:lo] are bit positions; {n}, {i} and the like mark numbered series; 'fields as' and 'values as' point back to an identical list; <NAME> marks a mode.

## Memory map
0x40000000 TIM2
0x40000400 TIM3
0x40000800 TIM4
0x40000C00 TIM5
0x40001000 TIM6
0x40001400 TIM7
0x40002800 RTC
0x40002C00 WWDG
0x40003000 IWDG
0x40003800 SPI2
0x40003C00 SPI3
0x40004400 USART2
0x40004800 USART3
0x40004C00 UART4
0x40005000 UART5
0x40005400 I2C1
0x40005800 I2C2
0x40005C00 I2C3
0x40006000 CRS
0x40006400 CAN
0x40006400 CAN1
0x40007000 PWR
0x40007400 DAC
0x40007400 DAC1
0x40007800 OPAMP
0x40007800 OPAMP1
0x40007800 OPAMP12_COMMON
0x40007810 OPAMP2
0x40007C00 LPTIM1
0x40008000 LPUART1
0x40008400 I2C4
0x40009400 LPTIM2
0x40010000 SYSCFG
0x40010030 VREFBUF
0x40010200 COMP1
0x40010204 COMP2
0x40010204 COMP12_COMMON
0x40010400 EXTI
0x40011C00 FIREWALL
0x40012C00 TIM1
0x40013000 SPI1
0x40013400 TIM8
0x40013800 USART1
0x40014000 TIM15
0x40014400 TIM16
0x40014800 TIM17
0x40015400 SAI1
0x40015800 SAI2
0x40016000 DFSDM1
0x40020000 DMA1
0x40020400 DMA2
0x40020800 DMAMUX1
0x40021000 RCC
0x40022000 FLASH
0x40023000 CRC
0x40024000 TSC
0x4002B000 DMA2D
0x48000000 GPIOA
0x48000400 GPIOB
0x48000800 GPIOC
0x48000C00 GPIOD
0x48001000 GPIOE
0x48001400 GPIOF
0x48001800 GPIOG
0x48001C00 GPIOH
0x48002000 GPIOI
0x50000000 USB_OTG_FS
0x50040000 ADC1
0x50050000 DCMI
0x50060000 AES
0x50060400 HASH
0x50060710 HASH_DIGEST
0x50060800 RNG
0x50061C00 OCTOSPIM
0x50062400 SDMMC1
0xA0000000 FMC_Bank1_R
0xA0000080 FMC_Bank3_R
0xA0000104 FMC_Bank1E_R
0xA0001000 OCTOSPI1
0xA0001400 OCTOSPI2
0xE0042000 DBGMCU

## TIM2
Base 0x40000000
Same registers: TIM3 0x40000400, TIM4 0x40000800, TIM5 0x40000C00, TIM6 0x40001000, TIM7 0x40001400, TIM1 0x40012C00, TIM8 0x40013400, TIM15 0x40014000, TIM16 0x40014400, TIM17 0x40014800
0x00 CR1
  [31] UIFCPY, [31] GC5C3, [30] GC5C2, [29] GC5C1, [25] BK2P, [24] BK2E, [4n-3] CC{n}P (n=1..6), [23:20] MMS2, [4n-4] CC{n}E (n=1..6), [23:20] BK2F, [2n+6] OIS{n} (n=1..6), [17] CC6IF, [16] CC5IF, [19:16] BKF, [15] ETP, [15] OC2CE, [15] OC4CE, [4n-1] CC{n}NP (n=1..4), [15] MOE, [15] OC6CE, [14] ECE, [14] TDE, [14] AOE, [13] OIS3N, [13] COMDE, [13] SBIF, [13] BKP, [13:12] ETPS, [n+8] CC{n}DE (n=1..4), [n+8] CC{n}OF (n=1..4), [24:12] OC2M, [24:12] OC4M, [12] BKE, [24:12] OC6M, [11] UIFREMAP, [11] OIS2N, [11] OC2PE, [11] OC4PE, [11] OSSR, [11] OC6PE, [10] OC2FE, [10] OC4FE, [10] CC3NE, [10] OSSI, [10] OC6FE, [9] OIS1N, [9:8] CKD, [11:8] ETF, [8] UDE, [8] B2IF, [8] B2G, [9:8] CC2S, [9:8] CC4S, [9:8] LOCK, [12:8] DBL, [7] ARPE, [7] TI1S, [7] MSM, [7] BIE, [7] BIF, [7] BG, [7] OC1CE, [7] OC3CE, [7] OC5CE, [6] TIE, [6] TIF, [6] TG, [6] CC2NE, [6:5] CMS, [5] COMIE, [5] COMIF, [5] COMG, [4] DIR, [6:4] MMS, [6:4] TS, [n] CC{n}IE (n=1..4), [n] CC{n}IF (n=1..4), [n] CC{n}G (n=1..4), [16:4] OC1M, [16:4] OC3M, [16:4] OC5M, [3] OPM, [3] CCDS, [3] OCCS, [3] OC1PE, [3] OC3PE, [3] OC5PE, [2] URS, [2] CCUS, [2] OC1FE, [2] OC3FE, [2] CC1NE, [2] OC5FE, [1] UDIS, [0] CEN, [0] CCPC, [16:0] SMS, [0] UIE, [0] UIF, [0] UG, [1:0] CC1S, [1:0] CC3S, [31:0] CNT, [15:0] PSC, [31:0] ARR, [15:0] REP, [15:0] CCR{n} (n=1..4), [7:0] DTG, [4:0] DBA, [15:0] DMAB, [31:0] CCR5, [15:0] CCR6
0x04 CR2
0x08 SMCR
0x0C DIER
0x10 SR
0x14 EGR
0x18 CCMR1
0x1C CCMR2
0x20 CCER
0x24 CNT
0x28 PSC
0x2C ARR
0x30 RCR
{0x30+4i} CCR{i} (i=1..4)
0x44 BDTR
0x48 DCR
0x4C DMAR
0x50 OR1
0x54 CCMR3
0x58 CCR5
0x5C CCR6
0x60 OR2
0x64 OR3

## RTC
Base 0x40002800
0x00 TR
  [31] MSK4, [31] MSK4, [31] ADD1S, [30] WDSEL, [30] WDSEL, [29:28] DT, [29:28] DT, [24] ITSE, [27:24] DU, [27:24] DU, [24] TAMP3MF, [27:24] MASKSS, [27:24] MASKSS, [23] COE, [23] MSK3, [23] MSK3, [23] TAMP3NOERASE, [22] PM, [22] PM, [22] PM, [22] PM, [22] TAMP3IE, [22:21] OSEL, [21] TAMP2MF, [21:20] HT, [23:20] YT, [20] POL, [21:20] HT, [21:20] HT, [21:20] HT, [20] TAMP2NOERASE, [19] COSEL, [19] TAMP2IE, [18] BKP, [18] TAMP1MF, [17] SUB1H, [17] ITSF, [17] TAMP1NOERASE, [19:16] HU, [19:16] YU, [16] ADD1H, [16] RECALPF, [22:16] PREDIV_A, [19:16] HU, [19:16] HU, [19:16] HU, [16] TAMP1IE, [15] TSIE, [15] TAMP3F, [15] MSK2, [15] MSK2, [15] CALP, [15] TAMPPUDIS, [14] WUTIE, [14] TAMP2F, [14] CALW8, [15:13] WDU, [13] ALRBIE, [13] TAMP1F, [15:13] WDU, [13] CALW16, [14:13] TAMPPRCH, [14:12] MNT, [12] MT, [12] ALRAIE, [12] TSOVF, [14:12] MNT, [14:12] MNT, [14:12] MNT, [12] MT, [11] TSE, [11] TSF, [12:11] TAMPFLT, [10] WUTE, [10] WUTF, [9] ALRBE, [9] ALRBF, [11:8] MNU, [11:8] MU, [8] ALRAE, [8] ALRAF, [11:8] MNU, [11:8] MNU, [11:8] MNU, [11:8] MU, [10:8] TAMPFREQ, [7] INIT, [7] MSK1, [7] MSK1, [7] TAMPTS, [6] FMT, [6] INITF, [6] TAMP3TRG, [5] BYPSHAD, [5] RSF, [5] TAMP3E, [6:4] ST, [5:4] DT, [4] REFCKON, [4] INITS, [6:4] ST, [6:4] ST, [6:4] ST, [5:4] DT, [4] TAMP2TRG, [3] TSEDGE, [3] SHPF, [3] TAMP2E, [2] WUTWF, [2] TAMPIE, [1] ALRBWF, [1] TAMP1TRG, [1] OUT_RMP, [3:0] SU, [3:0] DU, [2:0] WUCKSEL, [0] ALRAWF, [14:0] PREDIV_S, [15:0] WUT, [3:0] SU, [3:0] SU, [7:0] KEY, [15:0] SS, [14:0] SUBFS, [3:0] SU, [3:0] DU, [15:0] SS, [8:0] CALM, [0] TAMP1E, [14:0] SS, [14:0] SS, [0] ALARMOUTTYPE
0x04 DR
0x08 CR
0x0C ISR
0x10 PRER
0x14 WUTR
0x1C ALRMAR
0x20 ALRMBR
0x24 WPR
0x28 SSR
0x2C SHIFTR
0x30 TSTR
0x34 TSDR
0x38 TSSSR
0x3C CALR
0x40 TAMPCR
0x44 ALRMASSR
0x48 ALRMBSSR
0x4C OR
{0x50+4i} BKP{i}R (i=0..31)
