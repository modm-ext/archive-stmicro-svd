# STM32L4S5xx register map
File version: 1.0
Registers are 32-bit, access not given, reset 0x0 unless marked. A register's access mark holds for its fields unless they carry their own. Offsets are from the block's base; [hi:lo] are bit positions; {n}, {i} and the like mark numbered series.

## ADC1
Base 0x50040000
0x00 ISR
  [31] ADCAL, [31] JQDIS, [31] SMPPLUS, [31] OFFSET{n}_EN (n=1..4), [30] ADCALDIF, [29] DEEPPWD, [28] ADVREGEN, [3n+2:3n] SMP{n} (n=0..9), [30:26] AWD1CH, [6n+6:6n+2] JSQ{n} (n=1..4), [30:26] OFFSET{n}_CH (n=1..4), [25] JAUTO, [24] JAWD1EN, [3n-28:3n-30] SMP{n} (n=10..18), [6n+4:6n] SQ{n} (n=1..4), [6n-26:6n-30] SQ{n} (n=5..9), [6n-56:6n-60] SQ{n} (n=10..14), [24] VBATEN, [23] AWD1EN, [23] TSEN, [22] AWD1SGL, [22] VREFEN, [21] JQM, [20] JDISCEN, [21:18] PRESC, [19:17] DISCNUM, [16] DISCEN, [27:16] HT1, [23:16] HT2, [23:16] HT3, [22:16] CALFACT_D, [17:16] CKMODE, [14] AUTDLY, [13] CONT, [12] OVRMOD, [10] JQOVF, [10] JQOVFIE, [11:10] EXTEN, [10] ROVSM, [9] AWD3, [9] AWD3IE, [9] TROVS, [8] AWD2, [8] AWD2IE, [7] AWD1, [7] AWD1IE, [6] JEOS, [6] JEOSIE, [9:6] EXTSEL, [10:6] SQ16, [7:6] JEXTEN, [5] JEOC, [5] JEOCIE, [5] JADSTP, [5] ALIGN, [8:5] OVSS, [4] OVR, [4] OVRIE, [4] ADSTP, [3] EOS, [3] EOSIE, [3] JADSTART, [4:3] RES, [2] EOC, [2] EOCIE, [2] ADSTART, [2] DFSDMCFG, [4:2] OVSR, [5:2] JEXTSEL, [1] EOSMP, [1] EOSMPIE, [1] ADDIS, [1] DMACFG, [1] JOVSE, [0] ADRDY, [0] ADRDYIE, [0] ADEN, [0] DMAEN, [0] ROVSE, [11:0] LT1, [7:0] LT2, [7:0] LT3, [3:0] L, [4:0] SQ15, [15:0] RDATA, [1:0] JL, [11:0] OFFSET{n} (n=1..4), [15:0] JDATA, [15:0] JDATA, [15:0] JDATA, [15:0] JDATA, [18:0] AWD2CH, [18:0] AWD3CH, [18:0] DIFSEL, [6:0] CALFACT_S
0x04 IER
0x08 CR
0x0C CFGR
0x10 CFGR2
0x14 SMPR1
0x18 SMPR2
{0x1C+4i} TR{i} (i=1..3)
{0x2C+4i} SQR{i} (i=1..4)
0x40 DR
0x4C JSQR
{0x5C+4i} OFR{i} (i=1..4)
{0x7C+4i} JDR{i} (i=1..4)
0xA0 AWD2CR
0xA4 AWD3CR
0xB0 DIFSEL
0xB4 CALFACT
0x308 CCR

## DCMI
Base 0x50050000
0x00 CR
  [31:24] FEC, [31:24] FEU, [8n+7:8n] BYTE{n} (n=0..3), [20] OELS, [19] LSM, [18] OEBS, [17:16] BSM, [23:16] LEC, [23:16] LEU, [14] ENABLE, [11:10] EDM, [9:8] FCRC, [15:8] LSC, [15:8] LSU, [7] VSPOL, [6] HSPOL, [5] PCKPOL, [4] ESS, [4] LINE_IE, [4] LINE_ISC, [3] JPEG, [3] VSYNC_IE, [3] VSYNC_ISC, [2] CROP, [2] FNE, [2] ERR_IE, [2] ERR_ISC, [1] CM, [1] VSYNC, [1] OVR_IE, [1] OVR_ISC, [0] CAPTURE, [0] HSYNC, [4:0] INT_IE, [0] FRAME_ISC, [7:0] FSC, [7:0] FSU
0x04 SR
0x08 RISR
0x0C IER
0x10 MISR
0x14 ICR
0x18 ESCR
0x1C ESUR
0x20 CWSTRTR
0x24 CWSIZER
0x28 DR

## AES
Base 0x50060000
0x00 CR
  [23:20] NPBLB, [18] KEYSIZE, [14:13] GCMPH, [12] DMAOUTEN, [11] DMAINEN, [10] ERRIE, [9] CCFIE, [8] ERRC, [7] CCFC, [16:5] CHMOD, [4:3] MODE, [3] BUSY, [2] WRERR, [2:1] DATATYPE, [1] RDERR, [0] EN, [0] CCF
0x04 SR
0x08 DINR
0x0C DOUTR
{0x10+4i} KEYR{i} (i=0..3)
{0x20+4i} IVR{i} (i=0..3)
{0x20+4i} KEYR{i} (i=4..7)
{0x40+4i} SUSP{i}R (i=0..7)

## HASH
Base 0x50060400
0x00 CR
  [16] LKEY, [13] MDMAT, [12] DINNE, [11:8] NBW, [8] DCAL, [18:7] ALGO, [6] MODE, [5:4] DATATYPE, [3] DMAE, [3] BUSY, [2] INIT, [2] DMAS, [1] DCIE, [1] DCIS, [4:0] NBLW, [0] DINIE, [0] DINIS
0x04 DIN
0x08 STR
0x0C HR.0
0x10 HR.1
0x14 HR.2
0x18 HR.3
0x1C HR.4
0x20 IMR
0x24 SR
0xF8 CSR.0
0xFC CSR.1
0x100 CSR.2
0x104 CSR.3
0x108 CSR.4
0x10C CSR.5
0x110 CSR.6
0x114 CSR.7
0x118 CSR.8
0x11C CSR.9
0x120 CSR.10
0x124 CSR.11
0x128 CSR.12
0x12C CSR.13
0x130 CSR.14
0x134 CSR.15
0x138 CSR.16
0x13C CSR.17
0x140 CSR.18
0x144 CSR.19
0x148 CSR.20
0x14C CSR.21
0x150 CSR.22
0x154 CSR.23
0x158 CSR.24
0x15C CSR.25
0x160 CSR.26
0x164 CSR.27
0x168 CSR.28
0x16C CSR.29
0x170 CSR.30
0x174 CSR.31
0x178 CSR.32
0x17C CSR.33
0x180 CSR.34
0x184 CSR.35
0x188 CSR.36
0x18C CSR.37
0x190 CSR.38
0x194 CSR.39
0x198 CSR.40
0x19C CSR.41
0x1A0 CSR.42
0x1A4 CSR.43
0x1A8 CSR.44
0x1AC CSR.45
0x1B0 CSR.46
0x1B4 CSR.47
0x1B8 CSR.48
0x1BC CSR.49
0x1C0 CSR.50
0x1C4 CSR.51
0x1C8 CSR.52
0x1CC CSR.53

## HASH_DIGEST
Base 0x50060710
0x00 HR.0
0x04 HR.1
0x08 HR.2
0x0C HR.3
0x10 HR.4
0x14 HR.5
0x18 HR.6
0x1C HR.7
