# STM32H730xx register map
File version: 1.0
Registers are 32-bit, access not given, reset 0x0 unless marked. A register's access mark holds for its fields unless they carry their own. Offsets are from the block's base; [hi:lo] are bit positions; {n}, {i} and the like mark numbered series.

## MDMA
Base 0x52000000
0x00 GISR0
  [31] BWM, [31] BWM, [31] BWM, [31] BWM, [31] BWM, [31] BWM, [31] BWM, [31] BWM, [31] BWM, [31] BWM, [31] BWM, [31] BWM, [31] BWM, [31] BWM, [31] BWM, [31] BWM, [30] SWRM, [30] SWRM, [30] SWRM, [30] SWRM, [30] SWRM, [30] SWRM, [30] SWRM, [30] SWRM, [30] SWRM, [30] SWRM, [30] SWRM, [30] SWRM, [30] SWRM, [30] SWRM, [30] SWRM, [30] SWRM, [29:28] TRGM, [29:28] TRGM, [29:28] TRGM, [29:28] TRGM, [29:28] TRGM, [29:28] TRGM, [29:28] TRGM, [29:28] TRGM, [29:28] TRGM, [29:28] TRGM, [29:28] TRGM, [29:28] TRGM, [29:28] TRGM, [29:28] TRGM, [29:28] TRGM, [29:28] TRGM, [27:26] PAM, [27:26] PAM, [27:26] PAM, [27:26] PAM, [27:26] PAM, [27:26] PAM, [27:26] PAM, [27:26] PAM, [27:26] PAM, [27:26] PAM, [27:26] PAM, [27:26] PAM, [27:26] PAM, [27:26] PAM, [27:26] PAM, [27:26] PAM, [25] PKE, [25] PKE, [25] PKE, [25] PKE, [25] PKE, [25] PKE, [25] PKE, [25] PKE, [25] PKE, [25] PKE, [25] PKE, [25] PKE, [25] PKE, [25] PKE, [25] PKE, [25] PKE, [31:20] BRC, [31:20] BRC, [31:20] BRC, [31:20] BRC, [31:20] BRC, [31:20] BRC, [31:20] BRC, [31:20] BRC, [31:20] BRC, [31:20] BRC, [31:20] BRC, [31:20] BRC, [31:20] BRC, [31:20] BRC, [31:20] BRC, [31:20] BRC, [19] BRDUM, [19] BRDUM, [19] BRDUM, [19] BRDUM, [19] BRDUM, [19] BRDUM, [19] BRDUM, [19] BRDUM, [19] BRDUM, [19] BRDUM, [19] BRDUM, [19] BRDUM, [19] BRDUM, [19] BRDUM, [19] BRDUM, [19] BRDUM, [24:18] TLEN, [18] BRSUM, [24:18] TLEN, [18] BRSUM, [24:18] TLEN, [18] BRSUM, [24:18] TLEN, [18] BRSUM, [24:18] TLEN, [18] BRSUM, [24:18] TLEN, [18] BRSUM, [24:18] TLEN, [18] BRSUM, [24:18] TLEN, [18] BRSUM, [24:18] TLEN, [18] BRSUM, [24:18] TLEN, [18] BRSUM, [24:18] TLEN, [18] BRSUM, [24:18] TLEN, [18] BRSUM, [24:18] TLEN, [18] BRSUM, [24:18] TLEN, [18] BRSUM, [24:18] TLEN, [18] BRSUM, [24:18] TLEN, [18] BRSUM, [17] DBUS, [17] DBUS, [17] DBUS, [17] DBUS, [17] DBUS, [17] DBUS, [17] DBUS, [17] DBUS, [17] DBUS, [17] DBUS, [17] DBUS, [17] DBUS, [17] DBUS, [17] DBUS, [17] DBUS, [17] DBUS, [16] CRQA, [16] SWRQ, [16] CRQA, [16] SWRQ, [16] CRQA, [31:16] DUV, [16] SWRQ, [16] CRQA, [31:16] DUV, [16] SWRQ, [16] SBUS, [16] CRQA, [31:16] DUV, [16] SWRQ, [16] SBUS, [16] CRQA, [31:16] DUV, [16] SWRQ, [16] SBUS, [16] CRQA, [31:16] DUV, [16] SWRQ, [16] SBUS, [16] CRQA, [31:16] DUV, [16] SWRQ, [16] SBUS, [16] CRQA, [31:16] DUV, [16] SWRQ, [16] SBUS, [16] CRQA, [31:16] DUV, [16] SWRQ, [16] SBUS, [16] CRQA, [31:16] DUV, [16] SWRQ, [16] SBUS, [16] CRQA, [31:16] DUV, [16] SWRQ, [16] SBUS, [16] CRQA, [31:16] DUV, [16] SWRQ, [16] SBUS, [16] CRQA, [31:16] DUV, [16] SWRQ, [16] SBUS, [16] CRQA, [31:16] DUV, [16] SWRQ, [16] SBUS, [16] CRQA, [31:16] DUV, [16] SWRQ, [16] SBUS, [31:16] DUV, [16] SBUS, [31:16] DUV, [16] SBUS, [16] SBUS, [n] GIF{n} (n=0..15), [17:15] DBURST, [17:15] DBURST, [17:15] DBURST, [17:15] DBURST, [17:15] DBURST, [17:15] DBURST, [17:15] DBURST, [17:15] DBURST, [17:15] DBURST, [17:15] DBURST, [17:15] DBURST, [17:15] DBURST, [17:15] DBURST, [17:15] DBURST, [17:15] DBURST, [17:15] DBURST, [14] WEX, [14] WEX, [14] WEX, [14] WEX, [14] WEX, [14] WEX, [14] WEX, [14] WEX, [14] WEX, [14] WEX, [14] WEX, [14] WEX, [14] WEX, [14] WEX, [14] WEX, [14] WEX, [13] HEX, [13] HEX, [13] HEX, [13] HEX, [13] HEX, [13] HEX, [13] HEX, [13] HEX, [13] HEX, [13] HEX, [13] HEX, [13] HEX, [13] HEX, [13] HEX, [13] HEX, [13] HEX, [12] BEX, [14:12] SBURST, [12] BEX, [14:12] SBURST, [12] BEX, [14:12] SBURST, [12] BEX, [14:12] SBURST, [12] BEX, [14:12] SBURST, [12] BEX, [14:12] SBURST, [12] BEX, [14:12] SBURST, [12] BEX, [14:12] SBURST, [12] BEX, [14:12] SBURST, [12] BEX, [14:12] SBURST, [12] BEX, [14:12] SBURST, [12] BEX, [14:12] SBURST, [12] BEX, [14:12] SBURST, [12] BEX, [14:12] SBURST, [12] BEX, [14:12] SBURST, [12] BEX, [14:12] SBURST, [11] BSE, [11] BSE, [11] BSE, [11] BSE, [11] BSE, [11] BSE, [11] BSE, [11] BSE, [11] BSE, [11] BSE, [11] BSE, [11] BSE, [11] BSE, [11] BSE, [11] BSE, [11] BSE, [10] ASE, [11:10] DINCOS, [10] ASE, [11:10] DINCOS, [10] ASE, [11:10] DINCOS, [10] ASE, [11:10] DINCOS, [10] ASE, [11:10] DINCOS, [10] ASE, [11:10] DINCOS, [10] ASE, [11:10] DINCOS, [10] ASE, [11:10] DINCOS, [10] ASE, [11:10] DINCOS, [10] ASE, [11:10] DINCOS, [10] ASE, [11:10] DINCOS, [10] ASE, [11:10] DINCOS, [10] ASE, [11:10] DINCOS, [10] ASE, [11:10] DINCOS, [10] ASE, [11:10] DINCOS, [10] ASE, [11:10] DINCOS, [9] TEMD, [9] TEMD, [9] TEMD, [9] TEMD, [9] TEMD, [9] TEMD, [9] TEMD, [9] TEMD, [9] TEMD, [9] TEMD, [9] TEMD, [9] TEMD, [9] TEMD, [9] TEMD, [9] TEMD, [9] TEMD, [8] TELD, [9:8] SINCOS, [8] TELD, [9:8] SINCOS, [8] TELD, [9:8] SINCOS, [8] TELD, [9:8] SINCOS, [8] TELD, [9:8] SINCOS, [8] TELD, [9:8] SINCOS, [8] TELD, [9:8] SINCOS, [8] TELD, [9:8] SINCOS, [8] TELD, [9:8] SINCOS, [8] TELD, [9:8] SINCOS, [8] TELD, [9:8] SINCOS, [8] TELD, [9:8] SINCOS, [8] TELD, [9:8] SINCOS, [8] TELD, [9:8] SINCOS, [8] TELD, [9:8] SINCOS, [8] TELD, [9:8] SINCOS, [7] TED, [7] TED, [7] TED, [7] TED, [7] TED, [7] TED, [7] TED, [7] TED, [7] TED, [7] TED, [7] TED, [7] TED, [7] TED, [7] TED, [7] TED, [7] TED, [7:6] PL, [7:6] DSIZE, [7:6] PL, [7:6] DSIZE, [7:6] PL, [7:6] DSIZE, [7:6] PL, [7:6] DSIZE, [7:6] PL, [7:6] DSIZE, [7:6] PL, [7:6] DSIZE, [7:6] PL, [7:6] DSIZE, [7:6] PL, [7:6] DSIZE, [7:6] PL, [7:6] DSIZE, [7:6] PL, [7:6] DSIZE, [7:6] PL, [7:6] DSIZE, [7:6] PL, [7:6] DSIZE, [7:6] PL, [7:6] DSIZE, [7:6] PL, [7:6] DSIZE, [7:6] PL, [7:6] DSIZE, [7:6] PL, [7:6] DSIZE, [5] TCIE, [5] TCIE, [5] TCIE, [5] TCIE, [5] TCIE, [5] TCIE, [5] TCIE, [5] TCIE, [5] TCIE, [5] TCIE, [5] TCIE, [5] TCIE, [5] TCIE, [5] TCIE, [5] TCIE, [5] TCIE, [4] TCIF, [4] CLTCIF, [4] BTIE, [5:4] SSIZE, [4] TCIF, [4] CLTCIF, [4] BTIE, [5:4] SSIZE, [4] TCIF, [4] CLTCIF, [4] BTIE, [5:4] SSIZE, [4] TCIF, [4] CLTCIF, [4] BTIE, [5:4] SSIZE, [4] TCIF, [4] CLTCIF, [4] BTIE, [5:4] SSIZE, [4] TCIF, [4] CLTCIF, [4] BTIE, [5:4] SSIZE, [4] TCIF, [4] CLTCIF, [4] BTIE, [5:4] SSIZE, [4] TCIF, [4] CLTCIF, [4] BTIE, [5:4] SSIZE, [4] TCIF, [4] CLTCIF, [4] BTIE, [5:4] SSIZE, [4] TCIF, [4] CLTCIF, [4] BTIE, [5:4] SSIZE, [4] TCIF, [4] CLTCIF, [4] BTIE, [5:4] SSIZE, [4] TCIF, [4] CLTCIF, [4] BTIE, [5:4] SSIZE, [4] TCIF, [4] CLTCIF, [4] BTIE, [5:4] SSIZE, [4] TCIF, [4] CLTCIF, [4] BTIE, [5:4] SSIZE, [4] TCIF, [4] CLTCIF, [4] BTIE, [5:4] SSIZE, [4] TCIF, [4] CLTCIF, [4] BTIE, [5:4] SSIZE, [3] BTIF, [3] CBTIF, [3] BRTIE, [3] BTIF, [3] CBTIF, [3] BRTIE, [3] BTIF, [3] CBTIF, [3] BRTIE, [3] BTIF, [3] CBTIF, [3] BRTIE, [3] BTIF, [3] CBTIF, [3] BRTIE, [3] BTIF, [3] CBTIF, [3] BRTIE, [3] BTIF, [3] CBTIF, [3] BRTIE, [3] BTIF, [3] CBTIF, [3] BRTIE, [3] BTIF, [3] CBTIF, [3] BRTIE, [3] BTIF, [3] CBTIF, [3] BRTIE, [3] BTIF, [3] CBTIF, [3] BRTIE, [3] BTIF, [3] CBTIF, [3] BRTIE, [3] BTIF, [3] CBTIF, [3] BRTIE, [3] BTIF, [3] CBTIF, [3] BRTIE, [3] BTIF, [3] CBTIF, [3] BRTIE, [3] BTIF, [3] CBTIF, [3] BRTIE, [2] BRTIF, [2] CBRTIF, [2] CTCIE, [3:2] DINC, [2] BRTIF, [2] CBRTIF, [2] CTCIE, [3:2] DINC, [2] BRTIF, [2] CBRTIF, [2] CTCIE, [3:2] DINC, [2] BRTIF, [2] CBRTIF, [2] CTCIE, [3:2] DINC, [2] BRTIF, [2] CBRTIF, [2] CTCIE, [3:2] DINC, [2] BRTIF, [2] CBRTIF, [2] CTCIE, [3:2] DINC, [2] BRTIF, [2] CBRTIF, [2] CTCIE, [3:2] DINC, [2] BRTIF, [2] CBRTIF, [2] CTCIE, [3:2] DINC, [2] BRTIF, [2] CBRTIF, [2] CTCIE, [3:2] DINC, [2] BRTIF, [2] CBRTIF, [2] CTCIE, [3:2] DINC, [2] BRTIF, [2] CBRTIF, [2] CTCIE, [3:2] DINC, [2] BRTIF, [2] CBRTIF, [2] CTCIE, [3:2] DINC, [2] BRTIF, [2] CBRTIF, [2] CTCIE, [3:2] DINC, [2] BRTIF, [2] CBRTIF, [2] CTCIE, [3:2] DINC, [2] BRTIF, [2] CBRTIF, [2] CTCIE, [3:2] DINC, [2] BRTIF, [2] CBRTIF, [2] CTCIE, [3:2] DINC, [1] CTCIF, [1] CCTCIF, [1] TEIE, [1] CTCIF, [1] CCTCIF, [1] TEIE, [1] CTCIF, [1] CCTCIF, [1] TEIE, [1] CTCIF, [1] CCTCIF, [1] TEIE, [1] CTCIF, [1] CCTCIF, [1] TEIE, [1] CTCIF, [1] CCTCIF, [1] TEIE, [1] CTCIF, [1] CCTCIF, [1] TEIE, [1] CTCIF, [1] CCTCIF, [1] TEIE, [1] CTCIF, [1] CCTCIF, [1] TEIE, [1] CTCIF, [1] CCTCIF, [1] TEIE, [1] CTCIF, [1] CCTCIF, [1] TEIE, [1] CTCIF, [1] CCTCIF, [1] TEIE, [1] CTCIF, [1] CCTCIF, [1] TEIE, [1] CTCIF, [1] CCTCIF, [1] TEIE, [1] CTCIF, [1] CCTCIF, [1] TEIE, [1] CTCIF, [1] CCTCIF, [1] TEIE, [0] TEIF, [0] CTEIF, [6:0] TEA, [0] EN, [1:0] SINC, [16:0] BNDT, [0] TEIF, [0] CTEIF, [6:0] TEA, [31:0] SAR, [0] EN, [1:0] SINC, [31:0] DAR, [16:0] BNDT, [0] TEIF, [0] CTEIF, [6:0] TEA, [15:0] SUV, [31:0] SAR, [0] EN, [1:0] SINC, [31:0] DAR, [31:0] LAR, [16:0] BNDT, [0] TEIF, [0] CTEIF, [6:0] TEA, [15:0] SUV, [31:0] SAR, [0] EN, [7:0] TSEL, [1:0] SINC, [31:0] DAR, [31:0] LAR, [16:0] BNDT, [0] TEIF, [0] CTEIF, [31:0] MAR, [6:0] TEA, [15:0] SUV, [31:0] SAR, [0] EN, [7:0] TSEL, [1:0] SINC, [31:0] DAR, [31:0] LAR, [16:0] BNDT, [31:0] MDR, [0] TEIF, [0] CTEIF, [31:0] MAR, [6:0] TEA, [15:0] SUV, [31:0] SAR, [0] EN, [7:0] TSEL, [1:0] SINC, [31:0] DAR, [31:0] LAR, [16:0] BNDT, [31:0] MDR, [0] TEIF, [0] CTEIF, [31:0] MAR, [6:0] TEA, [15:0] SUV, [31:0] SAR, [0] EN, [7:0] TSEL, [1:0] SINC, [31:0] DAR, [31:0] LAR, [16:0] BNDT, [31:0] MDR, [0] TEIF, [0] CTEIF, [31:0] MAR, [6:0] TEA, [15:0] SUV, [31:0] SAR, [0] EN, [7:0] TSEL, [1:0] SINC, [31:0] DAR, [31:0] LAR, [16:0] BNDT, [31:0] MDR, [0] TEIF, [0] CTEIF, [31:0] MAR, [6:0] TEA, [15:0] SUV, [31:0] SAR, [0] EN, [7:0] TSEL, [1:0] SINC, [31:0] DAR, [31:0] LAR, [16:0] BNDT, [31:0] MDR, [0] TEIF, [0] CTEIF, [31:0] MAR, [6:0] TEA, [15:0] SUV, [31:0] SAR, [0] EN, [7:0] TSEL, [1:0] SINC, [31:0] DAR, [31:0] LAR, [16:0] BNDT, [31:0] MDR, [0] TEIF, [0] CTEIF, [31:0] MAR, [6:0] TEA, [15:0] SUV, [31:0] SAR, [0] EN, [7:0] TSEL, [1:0] SINC, [31:0] DAR, [31:0] LAR, [16:0] BNDT, [31:0] MDR, [0] TEIF, [0] CTEIF, [31:0] MAR, [6:0] TEA, [15:0] SUV, [31:0] SAR, [0] EN, [7:0] TSEL, [1:0] SINC, [31:0] DAR, [31:0] LAR, [16:0] BNDT, [31:0] MDR, [0] TEIF, [0] CTEIF, [31:0] MAR, [6:0] TEA, [15:0] SUV, [31:0] SAR, [0] EN, [7:0] TSEL, [1:0] SINC, [31:0] DAR, [31:0] LAR, [16:0] BNDT, [31:0] MDR, [0] TEIF, [0] CTEIF, [31:0] MAR, [6:0] TEA, [15:0] SUV, [31:0] SAR, [0] EN, [7:0] TSEL, [1:0] SINC, [31:0] DAR, [31:0] LAR, [16:0] BNDT, [31:0] MDR, [0] TEIF, [0] CTEIF, [31:0] MAR, [6:0] TEA, [15:0] SUV, [31:0] SAR, [0] EN, [7:0] TSEL, [1:0] SINC, [31:0] DAR, [31:0] LAR, [16:0] BNDT, [31:0] MDR, [0] TEIF, [0] CTEIF, [31:0] MAR, [6:0] TEA, [15:0] SUV, [31:0] SAR, [0] EN, [7:0] TSEL, [1:0] SINC, [31:0] DAR, [31:0] LAR, [16:0] BNDT, [31:0] MDR, [31:0] MAR, [15:0] SUV, [31:0] SAR, [7:0] TSEL, [31:0] DAR, [31:0] LAR, [31:0] MDR, [31:0] MAR, [15:0] SUV, [7:0] TSEL, [31:0] LAR, [31:0] MDR, [31:0] MAR, [7:0] TSEL, [31:0] MDR, [31:0] MAR, [31:0] MDR
0x40 CISR0
0x44 CIFCR0
0x4C CESR0
0x58 CCR0
0x68 CTCR0
0x7C CBNDTR0
0x80 CISR1
0x84 CIFCR1
0x8C CESR1
0x94 CSAR0
0x98 CCR1
0xA8 CTCR1
0xB0 CDAR0
0xBC CBNDTR1
0xC0 CISR2
0xC4 CIFCR2
0xCC CESR2
0xD0 CBRUR0
0xD4 CSAR1
0xD8 CCR2
0xE8 CTCR2
0xF0 CDAR1
0xF4 CLAR0
0xFC CBNDTR2
0x100 CISR3
0x104 CIFCR3
0x10C CESR3
0x110 CBRUR1
0x114 CSAR2
0x118 CCR3
0x11C CTBR0
0x128 CTCR3
0x130 CDAR2
0x134 CLAR1
0x13C CBNDTR3
0x140 CISR4
0x144 CIFCR4
0x14C CMAR0
0x14C CESR4
0x150 CBRUR2
0x154 CSAR3
0x158 CCR4
0x15C CTBR1
0x168 CTCR4
0x170 CDAR3
0x174 CLAR2
0x17C CBNDTR4
0x180 CMDR0
0x180 CISR5
0x184 CIFCR5
0x18C CMAR1
0x18C CESR5
0x190 CBRUR3
0x194 CSAR4
0x198 CCR5
0x19C CTBR2
0x1A8 CTCR5
0x1B0 CDAR4
0x1B4 CLAR3
0x1BC CBNDTR5
0x1C0 CMDR1
{0x40+0x40*i} CISR{i} (i=6..9)
{0x44+0x40*i} CIFCR{i} (i=6..9)
0x1CC CMAR2
{0x4C+0x40*i} CESR{i} (i=6..9)
0x1D0 CBRUR4
0x1D4 CSAR5
{0x58+0x40*i} CCR{i} (i=6..9)
0x1DC CTBR3
{0x68+0x40*i} CTCR{i} (i=6..9)
0x1F0 CDAR5
0x1F4 CLAR4
{0x7C+0x40*i} CBNDTR{i} (i=6..9)
0x200 CMDR2
0x20C CMAR3
0x210 CBRUR5
{0x94+0x40*i} CSAR{i} (i=6..9)
0x21C CTBR4
{0xB0+0x40*i} CDAR{i} (i=6..9)
0x234 CLAR5
0x240 CMDR3
0x24C CMAR4
{0xD0+0x40*i} CBRUR{i} (i=6..9)
0x25C CTBR5
{0xF4+0x40*i} CLAR{i} (i=6..9)
0x280 CMDR4
0x28C CMAR5
{0x11C+0x40*i} CTBR{i} (i=6..9)
0x2C0 CMDR5
0x2C0 CISR0
0x2C4 CIFCR0
{0x14C+0x40*i} CMAR{i} (i=6..9)
0x2CC CESR0
0x2D8 CCR0
0x2E8 CTCR0
0x2FC CBNDTR0
{0x180+0x40*i} CMDR{i} (i=6..9)
0x300 CISR1
0x304 CIFCR1
0x30C CESR1
0x314 CSAR0
0x318 CCR1
0x328 CTCR1
0x330 CDAR0
0x33C CBNDTR1
0x340 CISR2
0x344 CIFCR2
0x34C CESR2
0x350 CBRUR0
0x354 CSAR1
0x358 CCR2
0x368 CTCR2
0x370 CDAR1
0x374 CLAR0
0x37C CBNDTR2
0x380 CISR3
0x384 CIFCR3
0x38C CESR3
0x390 CBRUR1
0x394 CSAR2
0x398 CCR3
0x39C CTBR0
0x3A8 CTCR3
0x3B0 CDAR2
0x3B4 CLAR1
0x3BC CBNDTR3
0x3C0 CISR4
0x3C4 CIFCR4
0x3CC CMAR0
0x3CC CESR4
0x3D0 CBRUR2
0x3D4 CSAR3
0x3D8 CCR4
0x3DC CTBR1
0x3E8 CTCR4
0x3F0 CDAR3
0x3F4 CLAR2
0x3FC CBNDTR4
0x400 CMDR0
0x400 CISR5
0x404 CIFCR5
0x40C CMAR1
0x40C CESR5
0x410 CBRUR3
0x414 CSAR4
0x418 CCR5
0x41C CTBR2
0x428 CTCR5
0x430 CDAR4
0x434 CLAR3
0x43C CBNDTR5
0x440 CMDR1
0x44C CMAR2
0x450 CBRUR4
0x454 CSAR5
0x45C CTBR3
0x470 CDAR5
0x474 CLAR4
0x480 CMDR2
0x48C CMAR3
0x490 CBRUR5
0x49C CTBR4
0x4B4 CLAR5
0x4C0 CMDR3
0x4CC CMAR4
0x4DC CTBR5
0x500 CMDR4
0x50C CMAR5
0x540 CMDR5
