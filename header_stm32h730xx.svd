# STM32H730xx register map
File version: 1.0
Registers are 32-bit, access not given, reset 0x0 unless marked. A register's access mark holds for its fields unless they carry their own. Offsets are from the block's base; [hi:lo] are bit positions; {n}, {i} and the like mark numbered series.

## PSSI
Base 0x48020400
0x00 CR
  [31] OUTEN, [30] DMAEN, [20:18] DERDYCFG, [14] ENABLE, [11:10] EDM, [8] RDYPOL, [6] DEPOL, [5] CKPOL, [3] RTT1B, [2] RTT4B, [1] OVR_RIS, [1] OVR_IE, [1] OVR_MIS, [1] OVR_ISC, [31:0] DR
0x04 SR
0x08 RIS
0x0C IER
0x10 MIS
0x14 ICR
0x28 DR
0x3F0 HWCFGR
0x3F4 VERR
0x3F8 IPIDR
0x3FC SIDR

## CRYP
Base 0x48021000
0x00 CR
  [23:20] NPBLB, [19] ALGOMODE_AES_GCM, [17:16] GCM_CCMPH, [15] CRYPEN, [14] FFLUSH, [9:8] KEYSIZE, [7:6] DATATYPE, [5] ALGOMODE_AES_ECB, [4] ALGOMODE_DES_ECB, [4] BUSY, [3] ALGOMODE_TDES_CBC, [3] OFFU, [2] ALGODIR, [2] OFNE, [1] IFNF, [1] DOEN, [1] OUTIM, [1] OUTRIS, [1] OUTMIS, [0] IFEM, [0] DIEN, [0] INIM, [0] INRIS, [0] INMIS
0x04 SR
0x08 DIN
0x0C DOUT
0x10 DMACR
0x14 IMSCR
0x18 RISR
0x1C MISR
{0x20+8i} K{i}LR (i=0..3)
{0x24+8i} K{i}RR (i=0..3)
0x40 IV0LR
0x44 IV0RR
0x48 IV1LR
0x4C IV1RR
{0x50+4i} CSGCMCCM{i}R (i=0..7)
{0x70+4i} CSGCM{i}R (i=0..7)

## HASH
Base 0x48021400
0x00 CR
  [16] LKEY, [13] MDMAT, [12] DINNE, [11:8] NBW, [8] DCAL, [18:7] ALGO, [6] MODE, [5:4] DATATYPE, [3] DMAE, [3] BUSY, [2] INIT, [2] DMAS, [1] DCIE, [1] DCIS, [4:0] NBLW, [0] DINIE, [0] DINIS
0x04 DIN
0x08 STR
0x0C HR.0
0x10 HR.1
0x14 HR.2
0x18 HR.3
0x1C HR.4
0x20 IMR
0x24 SR
0xF8 CSR.0
0xFC CSR.1
0x100 CSR.2
0x104 CSR.3
0x108 CSR.4
0x10C CSR.5
0x110 CSR.6
0x114 CSR.7
0x118 CSR.8
0x11C CSR.9
0x120 CSR.10
0x124 CSR.11
0x128 CSR.12
0x12C CSR.13
0x130 CSR.14
0x134 CSR.15
0x138 CSR.16
0x13C CSR.17
0x140 CSR.18
0x144 CSR.19
0x148 CSR.20
0x14C CSR.21
0x150 CSR.22
0x154 CSR.23
0x158 CSR.24
0x15C CSR.25
0x160 CSR.26
0x164 CSR.27
0x168 CSR.28
0x16C CSR.29
0x170 CSR.30
0x174 CSR.31
0x178 CSR.32
0x17C CSR.33
0x180 CSR.34
0x184 CSR.35
0x188 CSR.36
0x18C CSR.37
0x190 CSR.38
0x194 CSR.39
0x198 CSR.40
0x19C CSR.41
0x1A0 CSR.42
0x1A4 CSR.43
0x1A8 CSR.44
0x1AC CSR.45
0x1B0 CSR.46
0x1B4 CSR.47
0x1B8 CSR.48
0x1BC CSR.49
0x1C0 CSR.50
0x1C4 CSR.51
0x1C8 CSR.52
0x1CC CSR.53

## HASH_DIGEST
Base 0x48021710
0x00 HR.0
0x04 HR.1
0x08 HR.2
0x0C HR.3
0x10 HR.4
0x14 HR.5
0x18 HR.6
0x1C HR.7

## RNG
Base 0x48021800
0x00 CR
  [31] CONFIGLOCK, [30] CONDRST, [25:20] RNG_CONFIG1, [19:16] CLKDIV, [15:13] RNG_CONFIG2, [12] NISTC, [11:8] RNG_CONFIG3, [6] SEIS, [5] CED, [5] CEIS, [3] IE, [2] RNGEN, [2] SECS, [1] CECS, [0] DRDY
0x04 SR
0x08 DR
0x10 HTCR

## SDMMC2
Base 0x48022400
Same registers: SDMMC1 0x52007000
0x00 POWER
  [28] IDMABTC, [28] IDMABTCC, [28] IDMABTCIE, [27] IDMATE, [27] IDMATEC, [26] CKSTOP, [26] CKSTOPC, [26] CKSTOPIE, [25] VSWEND, [25] VSWENDC, [25] VSWENDIE, [24] ACKTIMEOUT, [24] ACKTIMEOUTC, [24] ACKTIMEOUTIE, [23] ACKFAIL, [23] ACKFAILC, [23] ACKFAILIE, [22] SDIOIT, [22] SDIOITC, [22] SDIOITIE, [21] BUSYD0END, [21] BUSYD0ENDC, [21] BUSYD0ENDIE, [21:20] SELCLKRX, [20] BUSYD0, [19] BUSSPEED, [19] RXFIFOE, [18] DDR, [18] TXFIFOE, [18] TXFIFOEIE, [17] HWFC_EN, [17] RXFIFOF, [17] RXFIFOFIE, [16] NEGEDGE, [16] CMDSUSPEND, [16] TXFIFOF, [15] BOOTEN, [15] RXFIFOHF, [15] RXFIFOHFIE, [15:14] WIDBUS, [14] BOOTMODE, [14] TXFIFOHE, [14] TXFIFOHEIE, [13] DTHOLD, [13] FIFORST, [13] CPSMACT, [12] PWRSAV, [12] CPSMEN, [12] BOOTACKEN, [12] DPSMACT, [11] WAITPEND, [11] SDIOEN, [11] DABORT, [11] DABORTC, [11] DABORTIE, [10] WAITINT, [10] RWMOD, [10] DBCKEND, [10] DBCKENDC, [10] DBCKENDIE, [9] RWSTOP, [9] DHOLD, [9] DHOLDC, [9] DHOLDIE, [9:8] WAITRESP, [8] RWSTART, [8] DATAEND, [8] DATAENDC, [8] DATAENDIE, [7] CMDSTOP, [7] CMDSENT, [7] CMDSENTC, [7] CMDSENTIE, [6] CMDTRANS, [6] CMDREND, [6] CMDRENDC, [6] CMDRENDIE, [5] RXOVERR, [5] RXOVERRC, [5] RXOVERRIE, [12:5] IDMABNDT, [4] DIRPOL, [7:4] DBLOCKSIZE, [4] TXUNDERR, [4] TXUNDERRC, [4] TXUNDERRIE, [3] VSWITCHEN, [3] DTIMEOUT, [3] DTIMEOUTC, [3] DTIMEOUTIE, [2] VSWITCH, [3:2] DTMODE, [2] CTIMEOUT, [2] CTIMEOUTC, [2] CTIMEOUTIE, [1] DTDIR, [1] DCRCFAIL, [1] DCRCFAILC, [1] DCRCFAILIE, [1:0] PWRCTRL, [9:0] CLKDIV, [31:0] CMDARG, [5:0] CMDINDEX, [5:0] RESPCMD, [31:0] CARDSTATUS{n} (n=1..4), [31:0] DATATIME, [24:0] DATALENGTH, [0] DTEN, [24:0] DATACOUNT, [0] CCRCFAIL, [0] CCRCFAILC, [0] CCRCFAILIE, [24:0] ACKTIME, [31:0] FIFODATA
0x04 CLKCR
0x08 ARG
0x0C CMD
0x10 RESPCMD
{0x10+4i} RESP{i} (i=1..4)
0x24 DTIMER
0x28 DLEN
0x2C DCTRL
0x30 DCOUNT
0x34 STA
0x38 ICR
0x3C MASK
0x40 ACKTIME
0x50 IDMACTRL
0x54 IDMABSIZE
0x58 IDMABASE0
0x5C IDMABASE1
0x80 FIFO
0x3FC IPVR
