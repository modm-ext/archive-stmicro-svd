# STM32H730xx register map
File version: 1.0
Registers are 32-bit, access not given, reset 0x0 unless marked. A register's access mark holds for its fields unless they carry their own. Offsets are from the block's base; [hi:lo] are bit positions.

## I2C1
Base 0x40005400
Same registers: I2C2 0x40005800, I2C3 0x40005C00, I2C5 0x40006400, I2C4 0x58001C00
0x00 CR1
  [31] TEXTEN, [31:28] PRESC, [26] PECBYTE, [25] AUTOEND, [24] RELOAD, [23] PECEN, [22] ALERTEN, [21] SMBDEN, [20] SMBHEN, [23:20] SCLDEL, [19] GCEN, [18] WUPEN, [17] NOSTRETCH, [23:17] ADDCODE, [16] SBC, [23:16] NBYTES, [19:16] SDADEL, [27:16] TIMEOUTB, [16] DIR, [15] RXDMAEN, [15] NACK, [15] OA1EN, [15] OA2EN, [15] TIMOUTEN, [15] BUSY, [14] TXDMAEN, [14] STOP, [13] START, [13] ALERT, [13] ALERTCF, [12] ANFOFF, [12] HEAD10R, [12] TIDLE, [12] TIMEOUT, [12] TIMOUTCF, [11] ADD10, [11] PECERR, [11] PECCF, [10] RD_WRN, [10] OA1MODE, [10] OA2MASK04, [10] OVR, [10] OVRCF, [10:9] OA2MASK06, [9] ARLO, [9] ARLOCF, [11:8] DNF, [10:8] OA2MSK, [15:8] SCLH, [8] BERR, [8] BERRCF, [7] ERRIE, [7] TCR, [6] TCIE, [6] TC, [5] STOPIE, [5] STOPF, [5] STOPCF, [4] NACKIE, [4] NACKF, [4] NACKCF, [3] ADDRIE, [3] ADDR, [3] ADDRCF, [2] RXIE, [2] RXNE, [1] TXIE, [7:1] OA2, [1] TXIS, [0] PE, [9:0] SADD, [9:0] OA1, [7:0] SCLL, [11:0] TIMEOUTA, [0] TXE, [7:0] PEC, [7:0] RXDATA, [7:0] TXDATA
0x04 CR2
0x08 OAR1
0x0C OAR2
0x10 TIMINGR
0x14 TIMEOUTR
0x18 ISR
0x1C ICR
0x20 PECR
0x24 RXDR
0x28 TXDR

## CEC
Base 0x40006C00
0x00 CR
  [31] LSTN, [30:16] OAR, [12] TXACKE, [12] TXACKEIE, [11] TXERR, [11] TXERRIE, [10] TXUDR, [10] TXUDRIE, [9] TXEND, [9] TXENDIE, [8] SFTOPT, [8] TXBR, [8] TXBRIE, [7] BRDNOGEN, [7] ARBLST, [7] ARBLSTIE, [6] LBPEGEN, [6] RXACKE, [6] RXACKEIE, [5] BREGEN, [5] LBPE, [5] LBPEIE, [4] BRESTP, [4] SBPE, [4] SBPEIE, [3] RXTOL, [3] BRE, [3] BREIE, [2] TXEOM, [2] RXOVR, [2] RXOVRIE, [1] TXSOM, [1] RXEND, [1] RXENDIE, [0] CECEN, [2:0] SFT, [7:0] TXD, [7:0] RXD, [0] RXBR, [0] RXBRIE
0x04 CFGR
0x08 TXDR
0x0C RXDR
0x10 ISR
0x14 IER

## DAC1
Base 0x40007400
0x00 CR
  [31] BWST2, [30] CEN2, [30] CAL_FLAG2, [29] DMAUDRIE2, [29] DMAUDR2, [28] DMAEN2, [27:24] MAMP2, [23:22] WAVE2, [31:20] DACC2DHR, [21:18] TSEL2, [17] TEN2, [16] EN2, [27:16] DACC2DHR, [20:16] OTRIM2, [18:16] MODE2, [25:16] THOLD2, [23:16] TREFRESH2, [29:15] BWST1, [14] CEN1, [14] CAL_FLAG1, [13] DMAUDRIE1, [13] DMAUDR1, [12] DMAEN1, [11:8] MAMP1, [15:8] DACC2DHR, [7:6] WAVE1, [15:4] DACC1DHR, [15:4] DACC2DHR, [15:4] DACC1DHR, [5:2] TSEL1, [1] TEN1, [1] SWTRIG2, [0] EN1, [0] SWTRIG1, [11:0] DACC1DHR, [7:0] DACC1DHR, [11:0] DACC2DHR, [7:0] DACC2DHR, [11:0] DACC1DHR, [7:0] DACC1DHR, [11:0] DACC1DOR, [11:0] DACC2DOR, [4:0] OTRIM1, [2:0] MODE1, [9:0] TSAMPLE1, [9:0] TSAMPLE2, [9:0] THOLD1, [7:0] TREFRESH1
0x04 SWTRIGR
0x08 DHR12R1
0x0C DHR12L1
0x10 DHR8R1
0x14 DHR12R2
0x18 DHR12L2
0x1C DHR8R2
0x20 DHR12RD
0x24 DHR12LD
0x28 DHR8RD
0x2C DOR1
0x30 DOR2
0x34 SR
0x38 CCR
0x3C MCR
0x40 SHSR1
0x44 SHSR2
0x48 SHHR
0x4C SHRR

## CRS
Base 0x40008400
0x00 CR
  [31] SYNCPOL, [29:28] SYNCSRC, [26:24] SYNCDIV, [23:16] FELIM, [31:16] FECAP, [15] FEDIR, [10] TRIMOVF, [9] SYNCMISS, [13:8] TRIM, [8] SYNCERR, [7] SWSYNC, [6] AUTOTRIMEN, [5] CEN, [3] ESYNCIE, [3] ESYNCF, [3] ESYNCC, [2] ERRIE, [2] ERRF, [2] ERRC, [1] SYNCWARNIE, [1] SYNCWARNF, [1] SYNCWARNC, [0] SYNCOKIE, [15:0] RELOAD, [0] SYNCOKF, [0] SYNCOKC
0x04 CFGR
0x08 ISR
0x0C ICR

## SWPMI1
Base 0x40008800
0x00 CR
  [11] SWPEN, [11] RDYF, [11] CRDYF, [11] RDYIE, [10] DEACT, [10] DEACTF, [9] SUSP, [8] SRF, [8] CSRF, [8] SRIE, [7] TCF, [7] CTCF, [7] TCIE, [6] TXE, [6] TIE, [5] SWPACT, [5] RXNE, [5] RIE, [4] LPBK, [4] TXUNRF, [4] CTXUNRF, [4] TXUNRIE, [3] TXMODE, [3] RXOVRF, [3] CRXOVRF, [3] RXOVRIE, [2] RXMODE, [2] RXBERF, [2] CRXBERF, [2] RXBERIE, [1] TXDMA, [1] TXBEF, [1] CTXBEF, [1] TXBEIE, [1] CLASS, [0] RXDMA, [7:0] BR, [0] RXBFF, [0] CRXBFF, [0] RXBFIE, [4:0] RFL, [31:0] TD, [31:0] RD, [0] TBYP
0x04 BRR
0x0C ISR
0x10 ICR
0x14 IER
0x18 RFL
0x1C TDR
0x20 RDR
0x24 OR
