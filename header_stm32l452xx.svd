# STM32L452xx register map
File version: 1.0
Registers are 32-bit, access not given, reset 0x0 unless marked. A register's access mark holds for its fields unless they carry their own. Offsets are from the block's base; [hi:lo] are bit positions; {n}, {i} and the like mark numbered series.

## USB
Base 0x40006800
{0x0+4i} EP{i}R 16-bit (i=0..7)
0x40 CNTR 16-bit
0x44 ISTR 16-bit
0x48 FNR 16-bit
0x4C DADDR 16-bit
0x50 BTABLE 16-bit
0x54 LPMCSR 16-bit
0x58 BCDR 16-bit

## PWR
Base 0x40007000
0x00 CR1
  [15] EIWUL, [15] WUFI, [15] PVMO4, [n] PA{n} (n=12..15), [15] PB15, [15] PB15, [15] PC15, [15] PC15, [15] PD15, [15] PD15, [15] PE15, [15] PE15, [14] LPR, [14] PVMO3, [14] PB14, [14] PB14, [14] PC14, [14] PC14, [14] PD14, [14] PD14, [14] PE14, [14] PE14, [13] PB13, [13] PB13, [13] PC13, [13] PC13, [13] PD13, [13] PD13, [13] PE13, [13] PE13, [12] PVMO1, [12] PA12, [12] PB12, [12] PB12, [12] PC12, [12] PC12, [12] PD12, [12] PD12, [12] PE12, [12] PE12, [11] PVDO, [11] PA11, [11] PA11, [11] PB11, [11] PB11, [11] PC11, [11] PC11, [11] PD11, [11] PD11, [11] PE11, [11] PE11, [10] USV, [10] APC, [10] VOSF, [10] PA10, [10] PA10, [10] PB10, [10] PB10, [10] PC10, [10] PC10, [10] PD10, [10] PD10, [10] PE10, [10] PE10, [10:9] VOS, [9] VBRS, [9] REGLPF, [9] PA9, [9] PA9, [9] PB9, [9] PB9, [9] PC9, [9] PC9, [9] PD9, [9] PD9, [9] PE9, [9] PE9, [8] DBP, [8] RRS, [8] VBE, [8] SBF, [8] REGLPS, [8] CSBF, [8] PA8, [8] PA8, [8] PB8, [8] PB8, [8] PC8, [8] PC8, [8] PD8, [8] PD8, [8] PE8, [8] PE8, [7] PVME4, [7] PA7, [7] PA7, [7] PB7, [7] PB7, [7] PC7, [7] PC7, [7] PD7, [7] PD7, [7] PE7, [7] PE7, [6] PVME3, [6] PA6, [6] PA6, [6] PB6, [6] PB6, [6] PC6, [6] PC6, [6] PD6, [6] PD6, [6] PE6, [6] PE6, [5] PA5, [5] PA5, [5] PB5, [5] PB5, [5] PC5, [5] PC5, [5] PD5, [5] PD5, [5] PE5, [5] PE5, [4] PVME1, [n-1] EWUP{n} (n=1..5), [n-1] WP{n} (n=1..5), [n-1] WUF{n} (n=1..5), [n-1] CWUF{n} (n=1..5), [4] PA4, [4] PA4, [4] PB4, [4] PC4, [4] PC4, [4] PD4, [4] PD4, [4] PE4, [4] PE4, [3] PLS_LEV4, [3] PA3, [3] PA3, [3] PB3, [3] PB3, [3] PC3, [3] PC3, [3] PD3, [3] PD3, [3] PE3, [3] PE3, [2] LPMS_SHUTDOWN, [3:2] PLS_LEV6, [2] PA2, [2] PA2, [2] PB2, [2] PB2, [2] PC2, [2] PC2, [2] PD2, [2] PD2, [2] PE2, [2] PE2, [1] LPMS_STOP2, [3:1] PLS_LEV7, [1] PA1, [1] PA1, [1] PB1, [1] PB1, [1] PC1, [1] PC1, [1] PD1, [1] PD1, [1] PE1, [1] PE1, [1] PH1, [1] PH1, [0] LPMS_STOP1, [0] PVDE, [0] PA0, [0] PA0, [0] PB0, [0] PB0, [0] PC0, [0] PC0, [0] PD0, [0] PD0, [0] PE0, [0] PE0, [0] PH0, [0] PH0
0x04 CR2
0x08 CR3
0x0C CR4
0x10 SR1
0x14 SR2
0x18 SCR
0x20 PUCRA
0x24 PDCRA
0x28 PUCRB
0x2C PDCRB
0x30 PUCRC
0x34 PDCRC
0x38 PUCRD
0x3C PDCRD
0x40 PUCRE
0x44 PDCRE
0x58 PUCRH
0x5C PDCRH

## DAC
Base 0x40007400
0x00 CR
  [15] BWST1, [14] CEN1, [14] CAL_FLAG1, [13] DMAUDRIE1, [13] DMAUDR1, [12] DMAEN1, [11:8] MAMP1, [7:6] WAVE1, [15:4] DACC1DHR, [15:4] DACC1DHR, [5:3] TSEL1, [2] TEN1, [0] EN1, [0] SWTRIG1, [11:0] DACC1DHR, [7:0] DACC1DHR, [11:0] DACC1DHR, [7:0] DACC1DHR, [11:0] DACC1DOR, [4:0] OTRIM1, [2:0] MODE1, [9:0] TSAMPLE1, [9:0] THOLD1, [7:0] TREFRESH1
0x04 SWTRIGR
0x08 DHR12R1
0x0C DHR12L1
0x10 DHR8R1
0x14 DHR12R2
0x18 DHR12L2
0x1C DHR8R2
0x20 DHR12RD
0x24 DHR12LD
0x28 DHR8RD
0x2C DOR1
0x30 DOR2
0x34 SR
0x38 CCR
0x3C MCR
0x40 SHSR1
0x44 SHSR2
0x48 SHHR
0x4C SHRR

## DAC1
Base 0x40007400
0x00 CR
  [15] BWST1, [14] CEN1, [14] CAL_FLAG1, [13] DMAUDRIE1, [13] DMAUDR1, [12] DMAEN1, [11:8] MAMP1, [7:6] WAVE1, [15:4] DACC1DHR, [15:4] DACC1DHR, [5:3] TSEL1, [2] TEN1, [0] EN1, [0] SWTRIG1, [11:0] DACC1DHR, [7:0] DACC1DHR, [11:0] DACC1DHR, [7:0] DACC1DHR, [11:0] DACC1DOR, [4:0] OTRIM1, [2:0] MODE1, [9:0] TSAMPLE1, [9:0] THOLD1, [7:0] TREFRESH1
0x04 SWTRIGR
0x08 DHR12R1
0x0C DHR12L1
0x10 DHR8R1
0x14 DHR12R2
0x18 DHR12L2
0x1C DHR8R2
0x20 DHR12RD
0x24 DHR12LD
0x28 DHR8RD
0x2C DOR1
0x30 DOR2
0x34 SR
0x38 CCR
0x3C MCR
0x40 SHSR1
0x44 SHSR2
0x48 SHHR
0x4C SHRR

## OPAMP
Base 0x40007800
0x00 CSR
  [15] CALOUT, [14] USERTRIM, [13] CALSEL, [12] CALON, [10] VPSEL, [9:8] VMSEL, [12:8] TRIMOFFSETP, [12:8] TRIMLPOFFSETP, [5:4] PGGAIN, [3:2] OPAMODE, [1] OPALPM, [0] OPAMPxEN, [4:0] TRIMOFFSETN, [4:0] TRIMLPOFFSETN
0x04 OTR
0x08 LPOTR
