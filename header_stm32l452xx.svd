# STM32L452xx register map
File version: 1.0
Registers are 32-bit, access not given, reset 0x0 unless marked. A register's access mark holds for its fields unless they carry their own. Offsets are from the block's base; [hi:lo] are bit positions; {n}, {i} and the like mark numbered series.

## RCC
Base 0x40021000
0x00 CR
  [31] LPTIM1RST, [31] LPTIM1EN, [31] LPTIM1SMEN, [31] DFSDM1SEL, [31] LPWRRSTF, [30] OPAMPRST, [30] OPAMPEN, [30] OPAMPSMEN, [30] WWDGRSTF, [29] DAC1RST, [29] DAC1EN, [29] DAC1SMEN, [29] IWDGRSTF, [30:28] MCOPRE, [28] PWRRST, [28] PWREN, [28] PWRSMEN, [29:28] ADCSEL, [28] SFTRSTF, [27] PLLSAI1RDY, [31:27] PLLPDIV, [31:27] PLLSAI1PDIV, [27] BORRSTF, [26] PLLSAI1ON, [26] USBFSRST, [26] USBFSEN, [26] USBFSSMEN, [27:26] CLK48SEL, [26] PINRSTF, [25] PLLRDY, [26:25] PLLR, [26:25] PLLSAI1R, [25] CAN1RST, [25] CAN1EN, [25] CAN1SMEN, [25] LSCOSEL, [25] OBLRSTF, [24] PLLON, [30:24] HSITRIM, [27:24] MCOSEL, [24] PLLREN, [24] PLLSAI1REN, [24] CRSRST, [24] DFSDM1RST, [24] CRSEN, [24] DFSDM1EN, [24] CRSSMEN, [24] DFSDM1SMEN, [24] LSCOEN, [24] FWRSTF, [23] I2C3RST, [23] I2C3EN, [23] I2C3SMEN, [23] RMVF, [22] I2C2RST, [22] I2C2EN, [22] I2C2SMEN, [23:22] SAI1SEL, [22:21] PLLQ, [22:21] PLLSAI1Q, [21] I2C1RST, [21] SAI1RST, [21] I2C1EN, [21] SAI1EN, [21] I2C1SMEN, [21] SAI1SMEN, [20] PLLQEN, [20] PLLSAI1QEN, [21:20] LPTIM2SEL, [19] CSSON, [19] UART4RST, [19] UART4EN, [19] UART4SMEN, [18] HSEBYP, [18] RNGRST, [18] USART3RST, [18] RNGEN, [18] USART3EN, [18] RNGSMEN, [18] USART3SMEN, [19:18] LPTIM1SEL, [17] HSERDY, [17] PLLP, [17] PLLSAI1P, [17] USART2RST, [17] TIM16RST, [17] USART2EN, [17] TIM16EN, [17] USART2SMEN, [17] TIM16SMEN, [16] HSEON, [23:16] HSICAL, [16] PLLPEN, [16] PLLSAI1PEN, [16] TSCRST, [16] TIM15RST, [16] TSCEN, [16] TIM15EN, [16] TSCSMEN, [16] TIM15SMEN, [17:16] I2C3SEL, [16] BDRST, [15] STOPWUCK, [15] SPI3RST, [15] SPI3EN, [15] SPI3SMEN, [15] RTCEN, [14] SPI2RST, [14] USART1RST, [14] SPI2EN, [14] USART1EN, [14] SPI2SMEN, [14] USART1SMEN, [15:14] I2C2SEL, [13] ADCRST, [13] ADCEN, [13] ADCSMEN, [12] CRCRST, [12] SPI1RST, [12] CRCEN, [12] SPI1EN, [12] CRCSMEN, [12] SPI1SMEN, [13:12] I2C1SEL, [11] HSIASFS, [13:11] PPRE2, [11] TIM1RST, [11] WWDGEN, [11] TIM1EN, [11] WWDGSMEN, [11] TIM1SMEN, [10] HSIRDY, [10] HSI48RDYIE, [10] HSI48RDYF, [10] HSI48RDYC, [10] SDMMC1RST, [10] RTCAPBEN, [10] SDMMC1EN, [10] RTCAPBSMEN, [10] SDMMC1SMEN, [11:10] LPUART1SEL, [9] HSIKERON, [9] LSECSSIE, [9] LSECSSF, [9] LSECSSC, [9] SRAM1SMEN, [9] SRAM2SMEN, [8] HSION, [15:8] MSITRIM, [10:8] PPRE1, [14:8] PLLN, [14:8] PLLSAI1N, [8] CSSF, [8] CSSC, [8] FLASHRST, [8] QSPIRST, [8] FLASHEN, [8] QSPIEN, [8] FLASHSMEN, [8] QSPISMEN, [9:8] RTCSEL, [11:8] MSISRANGE, [7] GPIOHRST, [7] GPIOHEN, [7] FWEN, [7] GPIOHSMEN, [15:7] HSI48CAL, [6] PLLSAI1RDYIE, [6] PLLSAI1RDYF, [6] PLLSAI1RDYC, [7:6] UART4SEL, [6] LSECSSD, [5] PLLRDYIE, [5] PLLRDYF, [5] PLLRDYC, [5] LPTIM2RST, [5] LPTIM2EN, [5] LPTIM2SMEN, [5] LSECSSON, [7:4] MSIRANGE, [7:4] HPRE, [6:4] PLLM, [4] HSERDYIE, [4] HSERDYF, [4] HSERDYC, [4] GPIOERST, [4] TIM6RST, [4] GPIOEEN, [4] TIM6EN, [4] GPIOESMEN, [4] TIM6SMEN, [5:4] USART3SEL, [3] MSIRGSEL, [3] HSIRDYIE, [3] HSIRDYF, [3] HSIRDYC, [3] GPIODRST, [3] GPIODEN, [3] GPIODSMEN, [4:3] LSEDRV, [2] MSIPLLEN, [3:2] SWS, [2] MSIRDYIE, [2] MSIRDYF, [2] MSIRDYC, [2] GPIOCRST, [2] GPIOCEN, [2] GPIOCSMEN, [3:2] USART2SEL, [2] LSEBYP, [1] MSIRDY, [1] PLLSRC_HSI, [1] LSERDYIE, [1] LSERDYF, [1] LSERDYC, [1] DMA2RST, [1] GPIOBRST, [1] TIM3RST, [1] I2C4RST, [1] DMA2EN, [1] GPIOBEN, [1] TIM3EN, [1] I2C4EN, [1] DMA2SMEN, [1] GPIOBSMEN, [1] TIM3SMEN, [1] I2C4SMEN, [1] LSERDY, [1] LSIRDY, [1] HSI48RDY, [0] MSION, [7:0] MSICAL, [1:0] SW, [0] PLLSRC_MSI, [0] LSIRDYIE, [0] LSIRDYF, [0] LSIRDYC, [0] DMA1RST, [0] GPIOARST, [0] TIM2RST, [0] LPUART1RST, [0] SYSCFGRST, [0] DMA1EN, [0] GPIOAEN, [0] TIM2EN, [0] LPUART1EN, [0] SYSCFGEN, [0] DMA1SMEN, [0] GPIOASMEN, [0] TIM2SMEN, [0] LPUART1SMEN, [0] SYSCFGSMEN, [1:0] USART1SEL, [0] LSEON, [0] LSION, [0] HSI48ON, [1:0] I2C4SEL
0x04 ICSCR
0x08 CFGR
0x0C PLLCFGR
0x10 PLLSAI1CFGR
0x18 CIER
0x1C CIFR
0x20 CICR
{0x24+4i} AHB{i}RSTR (i=1..3)
0x38 APB1RSTR1
0x3C APB1RSTR2
0x40 APB2RSTR
{0x44+4i} AHB{i}ENR (i=1..3)
0x58 APB1ENR1
0x5C APB1ENR2
0x60 APB2ENR
{0x64+4i} AHB{i}SMENR (i=1..3)
0x78 APB1SMENR1
0x7C APB1SMENR2
0x80 APB2SMENR
0x88 CCIPR
0x90 BDCR
0x94 CSR
0x98 CRRCR
0x9C CCIPR2
