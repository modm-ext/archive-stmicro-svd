# STM32L486xx register map
File version: 1.0
STM32L486JGY6,STM32L486QGI6,STM32L486RGT6,STM32L486VGT3,STM32L486VGT6,STM32L486VGT7,STM32L486ZGT3,STM32L486ZGT6,STM32L486ZGT7
Registers are 32-bit, access not given, reset 0x0 unless marked. A register's access mark holds for its fields unless they carry their own. Offsets are from the block's base; lines under a group give offsets from that group; [hi:lo] are bit positions; {n}, {i} and the like mark numbered series; 'fields as' and 'values as' point back to an identical list; <NAME> marks a mode.

## Memory map
0x40000000 TIM2
0x40000400 TIM3
0x40000800 TIM4
0x40000C00 TIM5
0x40001000 TIM6
0x40001400 TIM7
0x40002400 LCD
0x40002800 RTC
0x40002C00 WWDG
0x40003000 IWDG
0x40003800 SPI2
0x40003C00 SPI3
0x40004400 USART2
0x40004800 USART3
0x40004C00 UART4
0x40005000 UART5
0x40005400 I2C1
0x40005800 I2C2
0x40005C00 I2C3
0x40006400 CAN
0x40006400 CAN1
0x40007000 PWR
0x40007400 DAC
0x40007400 DAC1
0x40007800 OPAMP
0x40007800 OPAMP1
0x40007800 OPAMP12_COMMON
0x40007810 OPAMP2
0x40007C00 LPTIM1
0x40008000 LPUART1
0x40008800 SWPMI1
0x40009400 LPTIM2
0x40010000 SYSCFG
0x40010030 VREFBUF
0x40010200 COMP1
0x40010204 COMP2
0x40010204 COMP12_COMMON
0x40010400 EXTI
0x40011C00 FIREWALL
0x40012800 SDMMC1
0x40012C00 TIM1
0x40013000 SPI1
0x40013400 TIM8
0x40013800 USART1
0x40014000 TIM15
0x40014400 TIM16
0x40014800 TIM17
0x40015400 SAI1
0x40015800 SAI2
0x40016000 DFSDM1
0x40020000 DMA1
0x400200A8 DMA1_CSELR
0x40020400 DMA2
0x400204A8 DMA2_CSELR
0x40021000 RCC
0x40022000 FLASH
0x40023000 CRC
0x40024000 TSC
0x48000000 GPIOA
0x48000400 GPIOB
0x48000800 GPIOC
0x48000C00 GPIOD
0x48001000 GPIOE
0x48001400 GPIOF
0x48001800 GPIOG
0x48001C00 GPIOH
0x50000000 USB_OTG_FS
0x50040000 ADC1
0x50040100 ADC2
0x50040200 ADC3
0x50040300 ADC123_COMMON
0x50060000 AES
0x50060800 RNG
0xA0000000 FMC_Bank1_R
0xA0000080 FMC_Bank3_R
0xA0000104 FMC_Bank1E_R
0xA0001000 QUADSPI
0xE0042000 DBGMCU

## TIM2
Base 0x40000000
Same registers: TIM3 0x40000400, TIM4 0x40000800, TIM5 0x40000C00, TIM6 0x40001000, TIM7 0x40001400, TIM1 0x40012C00, TIM8 0x40013400, TIM15 0x40014000, TIM16 0x40014400, TIM17 0x40014800
0x00 CR1
  [31] UIFCPY, [31] GC5C3, [30] GC5C2, [29] GC5C1, [25] BK2P, [24] BK2E, [4n-3] CC{n}P (n=1..6), [23:20] MMS2, [4n-4] CC{n}E (n=1..6), [23:20] BK2F, [2n+6] OIS{n} (n=1..6), [17] CC6IF, [16] CC5IF, [19:16] BKF, [15] ETP, [15] OC2CE, [15] OC4CE, [4n-1] CC{n}NP (n=1..4), [15] MOE, [15] OC6CE, [14] ECE, [14] TDE, [14] AOE, [13] OIS3N, [13] COMDE, [13] SBIF, [13] BKP, [13:12] ETPS, [n+8] CC{n}DE (n=1..4), [n+8] CC{n}OF (n=1..4), [24:12] OC2M, [24:12] OC4M, [12] BKE, [24:12] OC6M, [11] UIFREMAP, [11] OIS2N, [11] OC2PE, [11] OC4PE, [11] OSSR, [11] OC6PE, [10] OC2FE, [10] OC4FE, [10] CC3NE, [10] OSSI, [10] OC6FE, [9] OIS1N, [9:8] CKD, [11:8] ETF, [8] UDE, [8] B2IF, [8] B2G, [9:8] CC2S, [9:8] CC4S, [9:8] LOCK, [12:8] DBL, [7] ARPE, [7] TI1S, [7] MSM, [7] BIE, [7] BIF, [7] BG, [7] OC1CE, [7] OC3CE, [7] OC5CE, [6] TIE, [6] TIF, [6] TG, [6] CC2NE, [6:5] CMS, [5] COMIE, [5] COMIF, [5] COMG, [4] DIR, [6:4] MMS, [6:4] TS, [n] CC{n}IE (n=1..4), [n] CC{n}IF (n=1..4), [n] CC{n}G (n=1..4), [16:4] OC1M, [16:4] OC3M, [16:4] OC5M, [3] OPM, [3] CCDS, [3] OCCS, [3] OC1PE, [3] OC3PE, [3] OC5PE, [2] URS, [2] CCUS, [2] OC1FE, [2] OC3FE, [2] CC1NE, [2] OC5FE, [1] UDIS, [0] CEN, [0] CCPC, [16:0] SMS, [0] UIE, [0] UIF, [0] UG, [1:0] CC1S, [1:0] CC3S, [31:0] CNT, [15:0] PSC, [31:0] ARR, [15:0] REP, [15:0] CCR{n} (n=1..4), [7:0] DTG, [4:0] DBA, [15:0] DMAB, [31:0] CCR5, [15:0] CCR6
0x04 CR2
0x08 SMCR
0x0C DIER
0x10 SR
0x14 EGR
0x18 CCMR1
0x1C CCMR2
0x20 CCER
0x24 CNT
0x28 PSC
0x2C ARR
0x30 RCR
{0x30+4i} CCR{i} (i=1..4)
0x44 BDTR
0x48 DCR
0x4C DMAR
0x50 OR1
0x54 CCMR3
0x58 CCR5
0x5C CCR6
0x60 OR2
0x64 OR3

## LCD
Base 0x40002400
0x00 CR
  [25:22] PS, [21:18] DIV, [17:16] BLINK, [15:13] BLINKF, [12:10] CC, [8] BUFEN, [7] MUX_SEG, [9:7] DEAD, [6:5] BIAS, [5] FCRSR, [6:4] PON, [4] RDY, [3] UDDIE, [3] UDD, [3] UDDC, [4:2] DUTY, [2] UDR, [1] VSEL, [1] SOFIE, [1] SOF, [1] SOFC, [0] LCDEN, [0] HD, [0] ENS, [31:0] SEGMENT_DATA, [31:0] SEGMENT_DATA, [31:0] SEGMENT_DATA, [31:0] SEGMENT_DATA, [31:0] SEGMENT_DATA, [31:0] SEGMENT_DATA, [31:0] SEGMENT_DATA, [31:0] SEGMENT_DATA, [31:0] SEGMENT_DATA, [31:0] SEGMENT_DATA, [31:0] SEGMENT_DATA, [31:0] SEGMENT_DATA, [31:0] SEGMENT_DATA, [31:0] SEGMENT_DATA, [31:0] SEGMENT_DATA, [31:0] SEGMENT_DATA
0x04 FCR
0x08 SR
0x0C CLR
0x14 RAM.0
0x18 RAM.1
0x1C RAM.2
0x20 RAM.3
0x24 RAM.4
0x28 RAM.5
0x2C RAM.6
0x30 RAM.7
0x34 RAM.8
0x38 RAM.9
0x3C RAM.10
0x40 RAM.11
0x44 RAM.12
0x48 RAM.13
0x4C RAM.14
0x50 RAM.15
