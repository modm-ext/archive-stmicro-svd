# STM32L486xx register map
File version: 1.0
Registers are 32-bit, access not given, reset 0x0 unless marked. A register's access mark holds for its fields unless they carry their own. Offsets are from the block's base; [hi:lo] are bit positions; {n}, {i} and the like mark numbered series.

## ADC1
Base 0x50040000
Same registers: ADC2 0x50040100, ADC3 0x50040200
0x00 ISR
  [31] ADCAL, [31] JQDIS, [31] OFFSET{n}_EN (n=1..4), [30] ADCALDIF, [29] DEEPPWD, [28] ADVREGEN, [3n+2:3n] SMP{n} (n=0..9), [30:26] AWD1CH, [6n+6:6n+2] JSQ{n} (n=1..4), [30:26] OFFSET{n}_CH (n=1..4), [25] JAUTO, [24] JAWD1EN, [3n-28:3n-30] SMP{n} (n=10..18), [6n+4:6n] SQ{n} (n=1..4), [6n-26:6n-30] SQ{n} (n=5..9), [6n-56:6n-60] SQ{n} (n=10..14), [23] AWD1EN, [22] AWD1SGL, [21] JQM, [20] JDISCEN, [19:17] DISCNUM, [16] DISCEN, [27:16] HT1, [23:16] HT2, [23:16] HT3, [22:16] CALFACT_D, [14] AUTDLY, [13] CONT, [12] OVRMOD, [10] JQOVF, [10] JQOVFIE, [11:10] EXTEN, [10] ROVSM, [9] AWD3, [9] AWD3IE, [9] TROVS, [8] AWD2, [8] AWD2IE, [7] AWD1, [7] AWD1IE, [6] JEOS, [6] JEOSIE, [9:6] EXTSEL, [10:6] SQ16, [7:6] JEXTEN, [5] JEOC, [5] JEOCIE, [5] JADSTP, [5] ALIGN, [8:5] OVSS, [4] OVR, [4] OVRIE, [4] ADSTP, [3] EOS, [3] EOSIE, [3] JADSTART, [4:3] RES, [2] EOC, [2] EOCIE, [2] ADSTART, [4:2] OVSR, [5:2] JEXTSEL, [1] EOSMP, [1] EOSMPIE, [1] ADDIS, [1] DMACFG, [1] JOVSE, [0] ADRDY, [0] ADRDYIE, [0] ADEN, [0] DMAEN, [0] ROVSE, [11:0] LT1, [7:0] LT2, [7:0] LT3, [3:0] L, [4:0] SQ15, [15:0] RDATA, [1:0] JL, [11:0] OFFSET{n} (n=1..4), [15:0] JDATA, [15:0] JDATA, [15:0] JDATA, [15:0] JDATA, [18:0] AWD2CH, [18:0] AWD3CH, [18:0] DIFSEL, [6:0] CALFACT_S
0x04 IER
0x08 CR
0x0C CFGR
0x10 CFGR2
0x14 SMPR1
0x18 SMPR2
{0x1C+4i} TR{i} (i=1..3)
{0x2C+4i} SQR{i} (i=1..4)
0x40 DR
0x4C JSQR
{0x5C+4i} OFR{i} (i=1..4)
{0x7C+4i} JDR{i} (i=1..4)
0xA0 AWD2CR
0xA4 AWD3CR
0xB0 DIFSEL
0xB4 CALFACT

## ADC123_COMMON
Base 0x50040300
0x00 CSR
  [26] JQOVF_SLV, [25] AWD3_SLV, [24] AWD2_SLV, [24] VBATEN, [23] AWD1_SLV, [23] TSEN, [22] JEOS_SLV, [22] VREFEN, [21] JEOC_SLV, [20] OVR_SLV, [19] EOS_SLV, [18] EOC_SLV, [21:18] PRESC, [17] EOSMP_SLV, [16] ADRDY_SLV, [17:16] CKMODE, [31:16] RDATA_SLV, [15:14] MDMA, [13] DMACFG, [10] JQOVF_MST, [9] AWD3_MST, [8] AWD2_MST, [11:8] DELAY, [7] AWD1_MST, [6] JEOS_MST, [5] JEOC_MST, [4] OVR_MST, [3] EOS_MST, [2] EOC_MST, [1] EOSMP_MST, [0] ADRDY_MST, [4:0] DUAL, [15:0] RDATA_MST
0x08 CCR
0x0C CDR

## AES
Base 0x50060000
0x00 CR
  [18] KEYSIZE, [14:13] GCMPH, [12] DMAOUTEN, [11] DMAINEN, [10] ERRIE, [9] CCFIE, [8] ERRC, [7] CCFC, [16:5] CHMOD, [4:3] MODE, [3] BUSY, [2] WRERR, [2:1] DATATYPE, [1] RDERR, [0] EN, [0] CCF
0x04 SR
0x08 DINR
0x0C DOUTR
{0x10+4i} KEYR{i} (i=0..3)
{0x20+4i} IVR{i} (i=0..3)
{0x20+4i} KEYR{i} (i=4..7)
{0x40+4i} SUSP{i}R (i=0..7)

## RNG
Base 0x50060800
0x00 CR
  [6] SEIS, [5] CEIS, [3] IE, [2] RNGEN, [2] SECS, [1] CECS, [0] DRDY
0x04 SR
0x08 DR

## FMC_Bank1_R
Base 0xA0000000
0x00 BTCR.0
0x04 BTCR.1
0x08 BTCR.2
0x0C BTCR.3
0x10 BTCR.4
0x14 BTCR.5
0x18 BTCR.6
0x1C BTCR.7

## FMC_Bank3_R
Base 0xA0000080
0x00 PCR
  [31:24] MEMHIZ, [31:24] ATTHIZ, [19:17] ECCPS, [23:16] MEMHOLD, [23:16] ATTHOLD, [16:13] TAR, [12:9] TCLR, [15:8] MEMWAIT, [15:8] ATTWAIT, [6] ECCEN, [6] FEMPT, [5] IFEN, [5:4] PWID, [4] ILEN, [3] PTYP, [3] IREN, [2] PBKEN, [2] IFS, [1] PWAITEN, [1] ILS, [0] IRS, [7:0] MEMSET, [7:0] ATTSET, [31:0] ECC
0x04 SR
0x08 PMEM
0x0C PATT
0x14 ECCR

## FMC_Bank1E_R
Base 0xA0000104
0x00 BWTR.0
  [29:28] ACCMOD, [29:28] ACCMOD, [29:28] ACCMOD, [29:28] ACCMOD, [29:28] ACCMOD, [29:28] ACCMOD, [29:28] ACCMOD, [19:16] BUSTURN, [19:16] BUSTURN, [19:16] BUSTURN, [19:16] BUSTURN, [19:16] BUSTURN, [19:16] BUSTURN, [19:16] BUSTURN, [15:8] DATAST, [15:8] DATAST, [15:8] DATAST, [15:8] DATAST, [15:8] DATAST, [15:8] DATAST, [15:8] DATAST, [7:4] ADDHLD, [7:4] ADDHLD, [7:4] ADDHLD, [7:4] ADDHLD, [7:4] ADDHLD, [7:4] ADDHLD, [7:4] ADDHLD, [3:0] ADDSET, [3:0] ADDSET, [3:0] ADDSET, [3:0] ADDSET, [3:0] ADDSET, [3:0] ADDSET, [3:0] ADDSET
0x04 BWTR.1
0x08 BWTR.2
0x0C BWTR.3
0x10 BWTR.4
0x14 BWTR.5
0x18 BWTR.6

## QUADSPI
Base 0xA0001000
0x00 CR
  [31] DDRM, [28] SIOO, [27:26] FMODE, [31:24] PRESCALER, [25:24] DMODE, [23] PMM, [22] APMS, [20] TOIE, [19] SMIE, [18] FTIE, [22:18] DCYC, [17] TCIE, [16] TEIE, [20:16] FSIZE, [17:16] ABSIZE, [15:14] ABMODE, [13:12] ADSIZE, [11:10] ADMODE, [11:8] FTHRES, [10:8] CSHT, [12:8] FLEVEL, [9:8] IMODE, [5] BUSY, [4] SSHIFT, [4] TOF, [4] CTOF, [3] TCEN, [3] SMF, [3] CSMF, [2] DMAEN, [2] FTF, [1] ABORT, [1] TCF, [1] CTCF, [0] EN, [0] CKMODE, [0] TEF, [0] CTEF, [31:0] DL, [7:0] INSTRUCTION, [31:0] ADDRESS, [31:0] ALTERNATE, [31:0] DATA, [31:0] MASK, [31:0] MATCH, [15:0] INTERVAL, [15:0] TIMEOUT
0x04 DCR
0x08 SR
0x0C FCR
0x10 DLR
0x14 CCR
0x18 AR
0x1C ABR
0x20 DR
0x24 PSMKR
0x28 PSMAR
0x2C PIR
0x30 LPTR

## DBGMCU
Base 0xE0042000
0x00 IDCODE
  [31] DBG_LPTIM1_STOP, [25] DBG_CAN_STOP, [23] DBG_I2C3_STOP, [22] DBG_I2C2_STOP, [21] DBG_I2C1_STOP, [18] DBG_TIM17_STOP, [17] DBG_TIM16_STOP, [31:16] REV_ID, [16] DBG_TIM15_STOP, [13] DBG_TIM8_STOP, [12] DBG_IWDG_STOP, [11] DBG_WWDG_STOP, [11] DBG_TIM1_STOP, [10] DBG_RTC_STOP, [7:6] TRACE_MODE, [5] TRACE_IOEN, [n-2] DBG_TIM{n}_STOP (n=2..7), [5] DBG_LPTIM2_STOP, [2] DBG_STANDBY, [1] DBG_STOP, [11:0] DEV_ID, [0] DBG_SLEEP
0x04 CR
0x08 APB1FZR1
0x0C APB1FZR2
0x10 APB2FZ
