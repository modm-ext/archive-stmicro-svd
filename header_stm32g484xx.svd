# STM32G484xx register map
File version: 1.0
Registers are 32-bit, access not given, reset 0x0 unless marked. A register's access mark holds for its fields unless they carry their own. Offsets are from the block's base; [hi:lo] are bit positions; {n}, {i} and the like mark numbered series.

## CRS
Base 0x40002000
0x00 CR
  [31] SYNCPOL, [29:28] SYNCSRC, [26:24] SYNCDIV, [23:16] FELIM, [31:16] FECAP, [15] FEDIR, [10] TRIMOVF, [9] SYNCMISS, [14:8] TRIM, [8] SYNCERR, [7] SWSYNC, [6] AUTOTRIMEN, [5] CEN, [3] ESYNCIE, [3] ESYNCF, [3] ESYNCC, [2] ERRIE, [2] ERRF, [2] ERRC, [1] SYNCWARNIE, [1] SYNCWARNF, [1] SYNCWARNC, [0] SYNCOKIE, [15:0] RELOAD, [0] SYNCOKF, [0] SYNCOKC
0x04 CFGR
0x08 ISR
0x0C ICR

## TAMP
Base 0x40002400
0x00 CR1
  [26] TAMP3TRG, [25] TAMP2TRG, [24] TAMP1TRG, [n+15] ITAMP{n}E (n=3..6), [n+15] ITAMP{n}IE (n=3..6), [n+15] ITAMP{n}F (n=3..6), [n+15] ITAMP{n}MF (n=3..6), [n+15] CITAMP{n}F (n=3..6), [18] TAMP3MF, [17] TAMP2MF, [16] TAMP1MF, [7] TAMPPUDIS, [6:5] TAMPPRCH, [4:3] TAMPFLT, [2] TAMP3E, [2] TAMP3NOERASE, [2] TAMP3IE, [2] TAMP3F, [2] TAMP3MF, [2] CTAMP3F, [1] TAMP2E, [1] TAMP2NOERASE, [1] TAMP2IE, [1] TAMP2F, [1] TAMP2MF, [1] CTAMP2F, [0] TAMP1E, [0] TAMP1NOERASE, [2:0] TAMPFREQ, [0] TAMP1IE, [0] TAMP1F, [0] TAMP1MF, [0] CTAMP1F
0x04 CR2
0x0C FLTCR
0x2C IER
0x30 SR
0x34 MISR
0x3C SCR
{0x100+4i} BKP{i}R (i=0..31)

## RTC
Base 0x40002800
0x00 TR
  [31] OUT2EN, [31] ADD1S, [31] MSK4, [31] MSK4, [30] TAMPALRM_TYPE, [30] WDSEL, [30] WDSEL, [29] TAMPALRM_PU, [29:28] DT, [29:28] DT, [26] TAMPOE, [25] TAMPTS, [24] ITSE, [27:24] DU, [27:24] MASKSS, [27:24] DU, [27:24] MASKSS, [23] COE, [23] MSK3, [23] MSK3, [22] PM, [22] PM, [22] PM, [22] PM, [22:21] OSEL, [21:20] HT, [23:20] YT, [20] POL, [21:20] HT, [21:20] HT, [21:20] HT, [19] COSEL, [18] BKP, [17] SUB1H, [19:16] HU, [19:16] YU, [16] RECALPF, [22:16] PREDIV_A, [16] ADD1H, [19:16] HU, [19:16] HU, [19:16] HU, [15] TSIE, [15] CALP, [15] MSK2, [15] MSK2, [14] WUTIE, [14] CALW8, [15:13] WDU, [13] ALRBIE, [13] CALW16, [15:13] WDU, [14:12] MNT, [12] MT, [12] ALRAIE, [14:12] MNT, [12] MT, [14:12] MNT, [14:12] MNT, [11] TSE, [10] WUTE, [9] ALRBE, [11:8] MNU, [11:8] MU, [8] ALRAE, [11:8] MNU, [11:8] MU, [11:8] MNU, [11:8] MNU, [7] INIT, [7] MSK1, [7] MSK1, [6] INITF, [6] FMT, [5] RSF, [5] BYPSHAD, [5] ITSF, [5] ITSMF, [5] CITSF, [6:4] ST, [5:4] DT, [4] INITS, [4] REFCKON, [6:4] ST, [5:4] DT, [6:4] ST, [6:4] ST, [4] TSOVF, [4] TSOVMF, [4] CTSOVF, [3] SHPF, [3] TSEDGE, [3] TSF, [3] TSMF, [3] CTSF, [2] WUTWF, [2] WUTF, [2] WUTMF, [2] CWUTF, [1] ALRBWF, [1] ALRBF, [1] ALRBMF, [1] CALRBF, [3:0] SU, [3:0] DU, [15:0] SS, [0] ALRAWF, [14:0] PREDIV_S, [15:0] WUT, [2:0] WUCKSEL, [7:0] KEY, [8:0] CALM, [14:0] SUBFS, [3:0] SU, [3:0] DU, [15:0] SS, [3:0] SU, [14:0] SS, [3:0] SU, [14:0] SS, [0] ALRAF, [0] ALRAMF, [0] CALRAF
0x04 DR
0x08 SSR
0x0C ICSR
0x10 PRER
0x14 WUTR
0x18 CR
0x24 WPR
0x28 CALR
0x2C SHIFTR
0x30 TSTR
0x34 TSDR
0x38 TSSSR
0x40 ALRMAR
0x44 ALRMASSR
0x48 ALRMBR
0x4C ALRMBSSR
0x50 SR
0x54 MISR
0x5C SCR

## WWDG
Base 0x40002C00
0x00 CR
  [13:11] WDGTB, [9] EWI, [7] WDGA, [6:0] T, [6:0] W, [0] EWIF
0x04 CFR
0x08 SR

## IWDG
Base 0x40003000
0x00 KR
  [2] WVU, [1] RVU, [15:0] KEY, [2:0] PR, [11:0] RL, [0] PVU, [11:0] WIN
0x04 PR
0x08 RLR
0x0C SR
0x10 WINR

## SPI2
Base 0x40003800
Same registers: SPI3 0x40003C00, SPI1 0x40013000, SPI4 0x40013C00
0x00 CR1
  [15] BIDIMODE, [14] BIDIOE, [14] LDMATX, [13] CRCEN, [13] LDMARX, [12] CRCNEXT, [12] FRXTH, [12] ASTRTEN, [11] CRCL, [12:11] FTLVL, [11] I2SMOD, [10] RXONLY, [10] I2SE, [9] SSM, [10:9] FRLVL, [9] MCKOE, [8] SSI, [11:8] DS, [8] FRE, [9:8] I2SCFG, [8] ODD, [7] LSBFIRST, [7] TXEIE, [7] BSY, [7] PCMSYNC, [6] SPE, [6] RXNEIE, [6] OVR, [5] ERRIE, [5] MODF, [4] FRF, [4] CRCERR, [5:4] I2SSTD, [5:3] BR, [3] NSSP, [3] UDR, [3] CKPOL, [2] MSTR, [2] SSOE, [2] CHSIDE, [1] CPOL, [1] TXDMAEN, [1] TXE, [2:1] DATLEN, [0] CPHA, [0] RXDMAEN, [0] RXNE, [15:0] DR, [15:0] CRCPOLY, [15:0] RXCRC, [15:0] TXCRC, [0] CHLEN, [7:0] I2SDIV
0x04 CR2
0x08 SR
0x0C DR
0x10 CRCPR
0x14 RXCRCR
0x18 TXCRCR
0x1C I2SCFGR
0x20 I2SPR
