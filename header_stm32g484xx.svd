# STM32G484xx register map
File version: 1.0
Registers are 32-bit, access not given, reset 0x0 unless marked. A register's access mark holds for its fields unless they carry their own. Offsets are from the block's base; [hi:lo] are bit positions; {n}, {i} and the like mark numbered series.

## HRTIM1
Base 0x40016800
0x00 MCR
  [31] BMSTAT, [31] OCHPEV, [31] AD1TEPER, [31] AD2TERST, [31] AD3TEPER, [31] AD4TERST, [8n-1] FLT{n}LCK (n=1..4), [8n-1] FLT{n}RSTM (n=1..4), [31:30] BRSTDMA, [30] EEV8, [31:30] EEVSD, [30] AD{n}TEC4 (n=1..4), [8n-2] FLT{n}CRES (n=1..4), [29] MREPU, [29] EEV7, [6n-1] EE{n}FAST (n=1..5), [29] AD{n}TEC3 (n=1..4), [28] TDEEV8, [28] AD1TFRST, [28] AD2TEC2, [28] AD3TFRST, [28] AD4TEC2, [27] PREEN, [27] TAEEV7, [6n-2:6n-3] EE{n}SNS (n=1..5), [6n-32:6n-33] EE{n}SNS (n=6..10), [27] AD1TDPER, [27] AD2TDRST, [27] AD3TDPER, [27] AD4TDRST, [8n-2:8n-5] FLT{n}F (n=1..4), [26] TECMP2, [6n-4] EE{n}POL (n=1..5), [6n-34] EE{n}POL (n=6..10), [26] AD1TDC4, [26] AD2TDPER, [26] AD3TDC4, [26] AD4TDPER, [8n-6] FLT{n}SRC_0 (n=1..4), [30:26] AD10TRG, [8n-3:8n-6] FLT{n}CNT (n=1..4), [26:25] DACSYNC, [3n+15:3n+13] ADC{n}USRC (n=1..4), [25] TECMP1, [25] AD1TDC3, [25] AD2TDC4, [25] AD3TDC3, [25] AD4TDC4, [8n-7] FLT{n}P (n=1..4), [8n-7] FLT{n}BLKS (n=1..4), [24] TEREP, [6n-5:6n-6] EE{n}SRC (n=1..5), [6n-35:6n-36] EE{n}SRC (n=6..10), [6n-33:6n-36] EE{n}F (n=6..10), [24] AD{n}TFPER (n=1..4), [8n-8] FLT{n}E (n=1..4), [25:24] FLTSD, [6n-2:6n-6] AD{n}PSC (n=1..5), [6n-32:6n-36] AD{n}PSC (n=6..10), [8n-8] FLT{n}BLKE (n=1..4), [23] TFCMP1, [23] AD1TCPER, [23] AD2TDC2, [23] AD3TCPER, [23] AD4TDC2, [22] TFCEN, [22] MUPDDE, [22] TFBM, [22] TDCMP2, [22] AD1TCC4, [22] AD2TCRST, [22] AD3TCC4, [22] AD4TCRST, [21] TECEN, [21] SYNCDE, [21] SWPF, [21] TEBM, [21] TFREP, [21] AD1TCC3, [21] AD2TCPER, [21] AD3TCC3, [21] AD4TCPER, [n+15] FLT{n}SRC_1 (n=1..6), [25:21] AD9TRG, [20] TDCEN, [20] MREPDE, [20] SWPE, [20] TDBM, [20] TDREP, [20] AD1TFC4, [20] AD2TCC4, [20] AD3TFC4, [20] AD4TCC4, [4n-18:4n-20] AD{n}USRC (n=5..10), [19] TCCEN, [n+15] MCMP{n}DE (n=1..4), [19] SWPD, [19] TCBM, [19] TDRST, [19] AD1TBRST, [19] AD2TFC4, [19] AD3TBRST, [19] AD4TFC4, [18] TBCEN, [18] SWPC, [18] TBBM, [18] TFRST, [18] AD1TBPER, [18] AD2TCC2, [18] AD3TBPER, [18] AD4TCC2, [17] TACEN, [17] SWPB, [17] BMPER, [17] BMPERC, [17] BMPER, [17] TABM, [17] TCCMP1, [17] AD1TBC4, [17] AD2TBPER, [17] AD3TBC4, [17] AD4TBPER, [16] MCEN, [16] SWPA, [16] DLLRDY, [16] DLLRDYC, [16] DLLRDY, [16] MTBM, [16] TCREP, [16] AD1TBC3, [16] AD2TBC4, [16] AD3TBC3, [16] AD4TBC4, [20:16] AD8TRG, [15] TCRST, [15] AD{n}TFC3 (n=1..4), [15] FLT6LCK, [15] FLT6RSTM, [15:14] SYNC_SRC, [14] TFRST, [14] TBCMP2, [14] AD1TARST, [14] AD2TBC2, [14] AD3TARST, [14] AD4TBC2, [14] FLT6CRES, [13] TERST, [13] TBCMP1, [13] AD{n}TAPER (n=1..4), [13:12] SYNC_OUT, [12] TDRST, [12] TBREP, [12] AD{n}TAC4 (n=1..4), [11] SYNCSTRTM, [11] TCRST, [11] TF2OEN, [11] TF2ODIS, [11] TF2ODS, [11] TBRST, [11] AD1TAC3, [11] AD2TFC2, [11] AD3TAC3, [11] AD4TFC2, [14:11] FLT6F, [10] SYNCRSTM, [10] TBRST, [10] TF1OEN, [10] TF1ODIS, [10] TF1ODS, [10] BMPREN, [10] TACMP2, [10] AD1TFC2, [10] AD2TAC2, [10] AD3TFC2, [10] AD4TAC2, [10] FLT6SRC_0, [14:10] AD7TRG, [13:10] FLT6CNT, [9] TARST, [9] TE2OEN, [9] TE2ODIS, [9] TE2ODS, [9] TACMP1, [n+4] AD1EEV{n} (n=1..5), [n-1] AD2EEV{n} (n=6..10), [n+4] AD3EEV{n} (n=1..5), [n-1] AD4EEV{n} (n=6..10), [9] FLT6P, [9] MCMP4, [9] FLT6BLKS, [9:8] SYNC_IN, [8] MRST, [8] TE1OEN, [8] TE1ODIS, [8] TE1ODS, [8] TAREP, [8] FLT6E, [8] MCMP3, [8] FLT6BLKE, [7] TD2OEN, [7] TD2ODIS, [7] TD2ODS, [7] TARST, [7] FLT5LCK, [7] MCMP2, [7] FLT5RSTM, [7:6] INTLVD, [6] MUPD, [6] MUPD, [6] MUPDIE, [6] TFUDIS, [6] TFSWU, [6] FLT6, [6] FLT6C, [6] FLT6, [6] TD1OEN, [6] TD1ODIS, [6] TD1ODS, [9:6] BMPRSC, [n+2] MSTCMP{n} (n=1..4), [6] MCMP1, [6] FLT5CRES, [5] HALF, [5] SYNC, [5] SYNC, [5] SYNCIE, [5] TEUDIS, [5] TESWU, [5] SYSFLT, [5] SYSFLTC, [5] SYSFLT, [5] TC2OEN, [5] TC2ODIS, [5] TC2ODS, [5] MREP, [9:5] AD6TRG, [4] RETRIG, [4] MREP, [4] MREP, [4] MREPIE, [4] TDUDIS, [4] TDSWU, [4] FLT5, [n-1] FLT{n}C (n=1..5), [4] FLT5, [4] TC1OEN, [4] TC1ODIS, [4] TC1ODS, [4] AD{n}MPER (n=1..4), [4] MPER, [3] CONT, [3] MCMP4, [3] MCMP4, [n-1] MCMP{n}IE (n=1..4), [3] TCUDIS, [3] TCSWU, [3] FLT4, [3] FLT4, [3] TB2OEN, [3] TB2ODIS, [3] TB2ODS, [3] AD{n}MC4 (n=1..4), [6:3] FLT5F, [3] MCNT, [2] MCMP3, [2] MCMP3, [2] TBUDIS, [2] TBSWU, [2] FLT3, [2] FLT3, [2] TB1OEN, [2] TB1ODIS, [2] TB1ODS, [5:2] BMCLK, [2] MSTREP, [2] AD{n}MC3 (n=1..4), [3:2] CALRTE, [2] FLT5SRC_0, [2] MDIER, [5:2] FLT5CNT, [1] MCMP2, [1] MCMP2, [1] TAUDIS, [1] TASWU, [1] FLT2, [1] FLT2, [1] TA2OEN, [1] TA2ODIS, [1] TA2ODS, [1] BMOM, [1] MSTRST, [1] AD{n}MC2 (n=1..4), [1] CALEN, [1] FLT5P, [1] MICR, [1] FLT5BLKS, [2:0] CK_PSC, [0] MCMP1, [0] MCMP1, [15:0] MCNTR, [15:0] MPER, [7:0] MREP, [15:0] MCMP{n}R (n=1..4), [0] MUDIS, [0] MSWU, [0] FLT1, [0] FLT1, [0] TA1OEN, [0] TA1ODIS, [0] TA1ODS, [0] BME, [0] SW, [15:0] BMCMPR, [15:0] BMPER, [0] AD{n}MC1 (n=1..4), [0] CAL, [0] FLT5E, [0] MCR, [31:0] BDMADR, [4:0] AD5TRG, [0] FLT5BLKE
0x04 MISR
0x08 MICR
0x0C MDIER
0x10 MCNTR
0x14 MPER
0x18 MREP
0x1C MCMP1R
{0x1C+4i} MCMP{i}R (i=2..4)
0x80 sTimerxRegs.0.TIMxCR
0x84 sTimerxRegs.0.TIMxISR
0x88 sTimerxRegs.0.TIMxICR
0x8C sTimerxRegs.0.TIMxDIER
0x90 sTimerxRegs.0.CNTxR
0x94 sTimerxRegs.0.PERxR
0x98 sTimerxRegs.0.REPxR
0x9C sTimerxRegs.0.CMP1xR
0xA0 sTimerxRegs.0.CMP1CxR
{0x9C+4i} sTimerxRegs.0.CMP{i}xR (i=2..4)
0xB0 sTimerxRegs.0.CPT1xR
0xB4 sTimerxRegs.0.CPT2xR
0xB8 sTimerxRegs.0.DTxR
0xBC sTimerxRegs.0.SETx1R
0xC0 sTimerxRegs.0.RSTx1R
0xC4 sTimerxRegs.0.SETx2R
0xC8 sTimerxRegs.0.RSTx2R
0xCC sTimerxRegs.0.EEFxR1
0xD0 sTimerxRegs.0.EEFxR2
0xD4 sTimerxRegs.0.RSTxR
0xD8 sTimerxRegs.0.CHPxR
0xDC sTimerxRegs.0.CPT1xCR
0xE0 sTimerxRegs.0.CPT2xCR
0xE4 sTimerxRegs.0.OUTxR
0xE8 sTimerxRegs.0.FLTxR
0xEC sTimerxRegs.0.TIMxCR2
0xF0 sTimerxRegs.0.EEFxR3
0x100 sTimerxRegs.1.TIMxCR
0x104 sTimerxRegs.1.TIMxISR
0x108 sTimerxRegs.1.TIMxICR
0x10C sTimerxRegs.1.TIMxDIER
0x110 sTimerxRegs.1.CNTxR
0x114 sTimerxRegs.1.PERxR
0x118 sTimerxRegs.1.REPxR
0x11C sTimerxRegs.1.CMP1xR
0x120 sTimerxRegs.1.CMP1CxR
{0x11C+4i} sTimerxRegs.1.CMP{i}xR (i=2..4)
0x130 sTimerxRegs.1.CPT1xR
0x134 sTimerxRegs.1.CPT2xR
0x138 sTimerxRegs.1.DTxR
0x13C sTimerxRegs.1.SETx1R
0x140 sTimerxRegs.1.RSTx1R
0x144 sTimerxRegs.1.SETx2R
0x148 sTimerxRegs.1.RSTx2R
0x14C sTimerxRegs.1.EEFxR1
0x150 sTimerxRegs.1.EEFxR2
0x154 sTimerxRegs.1.RSTxR
0x158 sTimerxRegs.1.CHPxR
0x15C sTimerxRegs.1.CPT1xCR
0x160 sTimerxRegs.1.CPT2xCR
0x164 sTimerxRegs.1.OUTxR
0x168 sTimerxRegs.1.FLTxR
0x16C sTimerxRegs.1.TIMxCR2
0x170 sTimerxRegs.1.EEFxR3
0x180 sTimerxRegs.2.TIMxCR
0x184 sTimerxRegs.2.TIMxISR
0x188 sTimerxRegs.2.TIMxICR
0x18C sTimerxRegs.2.TIMxDIER
0x190 sTimerxRegs.2.CNTxR
0x194 sTimerxRegs.2.PERxR
0x198 sTimerxRegs.2.REPxR
0x19C sTimerxRegs.2.CMP1xR
0x1A0 sTimerxRegs.2.CMP1CxR
{0x19C+4i} sTimerxRegs.2.CMP{i}xR (i=2..4)
0x1B0 sTimerxRegs.2.CPT1xR
0x1B4 sTimerxRegs.2.CPT2xR
0x1B8 sTimerxRegs.2.DTxR
0x1BC sTimerxRegs.2.SETx1R
0x1C0 sTimerxRegs.2.RSTx1R
0x1C4 sTimerxRegs.2.SETx2R
0x1C8 sTimerxRegs.2.RSTx2R
0x1CC sTimerxRegs.2.EEFxR1
0x1D0 sTimerxRegs.2.EEFxR2
0x1D4 sTimerxRegs.2.RSTxR
0x1D8 sTimerxRegs.2.CHPxR
0x1DC sTimerxRegs.2.CPT1xCR
0x1E0 sTimerxRegs.2.CPT2xCR
0x1E4 sTimerxRegs.2.OUTxR
0x1E8 sTimerxRegs.2.FLTxR
0x1EC sTimerxRegs.2.TIMxCR2
0x1F0 sTimerxRegs.2.EEFxR3
0x200 sTimerxRegs.3.TIMxCR
0x204 sTimerxRegs.3.TIMxISR
0x208 sTimerxRegs.3.TIMxICR
0x20C sTimerxRegs.3.TIMxDIER
0x210 sTimerxRegs.3.CNTxR
0x214 sTimerxRegs.3.PERxR
0x218 sTimerxRegs.3.REPxR
0x21C sTimerxRegs.3.CMP1xR
0x220 sTimerxRegs.3.CMP1CxR
{0x21C+4i} sTimerxRegs.3.CMP{i}xR (i=2..4)
0x230 sTimerxRegs.3.CPT1xR
0x234 sTimerxRegs.3.CPT2xR
0x238 sTimerxRegs.3.DTxR
0x23C sTimerxRegs.3.SETx1R
0x240 sTimerxRegs.3.RSTx1R
0x244 sTimerxRegs.3.SETx2R
0x248 sTimerxRegs.3.RSTx2R
0x24C sTimerxRegs.3.EEFxR1
0x250 sTimerxRegs.3.EEFxR2
0x254 sTimerxRegs.3.RSTxR
0x258 sTimerxRegs.3.CHPxR
0x25C sTimerxRegs.3.CPT1xCR
0x260 sTimerxRegs.3.CPT2xCR
0x264 sTimerxRegs.3.OUTxR
0x268 sTimerxRegs.3.FLTxR
0x26C sTimerxRegs.3.TIMxCR2
0x270 sTimerxRegs.3.EEFxR3
0x280 sTimerxRegs.4.TIMxCR
0x284 sTimerxRegs.4.TIMxISR
0x288 sTimerxRegs.4.TIMxICR
0x28C sTimerxRegs.4.TIMxDIER
0x290 sTimerxRegs.4.CNTxR
0x294 sTimerxRegs.4.PERxR
0x298 sTimerxRegs.4.REPxR
0x29C sTimerxRegs.4.CMP1xR
0x2A0 sTimerxRegs.4.CMP1CxR
{0x29C+4i} sTimerxRegs.4.CMP{i}xR (i=2..4)
0x2B0 sTimerxRegs.4.CPT1xR
0x2B4 sTimerxRegs.4.CPT2xR
0x2B8 sTimerxRegs.4.DTxR
0x2BC sTimerxRegs.4.SETx1R
0x2C0 sTimerxRegs.4.RSTx1R
0x2C4 sTimerxRegs.4.SETx2R
0x2C8 sTimerxRegs.4.RSTx2R
0x2CC sTimerxRegs.4.EEFxR1
0x2D0 sTimerxRegs.4.EEFxR2
0x2D4 sTimerxRegs.4.RSTxR
0x2D8 sTimerxRegs.4.CHPxR
0x2DC sTimerxRegs.4.CPT1xCR
0x2E0 sTimerxRegs.4.CPT2xCR
0x2E4 sTimerxRegs.4.OUTxR
0x2E8 sTimerxRegs.4.FLTxR
0x2EC sTimerxRegs.4.TIMxCR2
0x2F0 sTimerxRegs.4.EEFxR3
0x300 sTimerxRegs.5.TIMxCR
0x304 sTimerxRegs.5.TIMxISR
0x308 sTimerxRegs.5.TIMxICR
0x30C sTimerxRegs.5.TIMxDIER
0x310 sTimerxRegs.5.CNTxR
0x314 sTimerxRegs.5.PERxR
0x318 sTimerxRegs.5.REPxR
0x31C sTimerxRegs.5.CMP1xR
0x320 sTimerxRegs.5.CMP1CxR
{0x31C+4i} sTimerxRegs.5.CMP{i}xR (i=2..4)
0x330 sTimerxRegs.5.CPT1xR
0x334 sTimerxRegs.5.CPT2xR
0x338 sTimerxRegs.5.DTxR
0x33C sTimerxRegs.5.SETx1R
0x340 sTimerxRegs.5.RSTx1R
0x344 sTimerxRegs.5.SETx2R
0x348 sTimerxRegs.5.RSTx2R
0x34C sTimerxRegs.5.EEFxR1
0x350 sTimerxRegs.5.EEFxR2
0x354 sTimerxRegs.5.RSTxR
0x358 sTimerxRegs.5.CHPxR
0x35C sTimerxRegs.5.CPT1xCR
0x360 sTimerxRegs.5.CPT2xCR
0x364 sTimerxRegs.5.OUTxR
0x368 sTimerxRegs.5.FLTxR
0x36C sTimerxRegs.5.TIMxCR2
0x370 sTimerxRegs.5.EEFxR3
0x380 CR1
0x384 CR2
0x388 ISR
0x38C ICR
0x390 IER
0x394 OENR
0x398 ODISR
0x39C ODSR
0x3A0 BMCR
0x3A4 BMTRGR
0x3A8 BMCMPR
0x3AC BMPER
{0x3AC+4i} EECR{i} (i=1..3)
{0x3B8+4i} ADC{i}R (i=1..4)
0x3CC DLLCR
0x3D0 FLTINR1
0x3D4 FLTINR2
0x3D8 BDMUPR
0x3DC BDTAUPR
0x3E0 BDTBUPR
0x3E4 BDTCUPR
0x3E8 BDTDUPR
0x3EC BDTEUPR
0x3F0 BDMADR
0x3F4 BDTFUPR
0x3F8 ADCER
0x3FC ADCUR
0x400 ADCPS1
0x404 ADCPS2
0x408 FLTINR3
0x40C FLTINR4
