# STM32G484xx register map
File version: 1.0
Registers are 32-bit, access not given, reset 0x0 unless marked. A register's access mark holds for its fields unless they carry their own. Offsets are from the block's base; [hi:lo] are bit positions; {n}, {i} and the like mark numbered series.

## USART2
Base 0x40004400
Same registers: USART3 0x40004800, UART4 0x40004C00, UART5 0x40005000, LPUART1 0x40008000, USART1 0x40013800
0x00 CR1
  [31] RXFFIE, [30] TXFEIE, [29] FIFOEN, [31:29] TXFTCFG, [28] M1, [28] RXFTIE, [27] EOBIE, [27] TXFT, [26] RTOIE, [26] RXFT, [27:25] RXFTCFG, [25] TCBGT, [31:24] ADD, [24] TCBGTIE, [31:24] BLEN, [24] RXFF, [23] RTOEN, [23] TXFTIE, [23] TXFE, [22] WUFIE, [22] REACK, [25:21] DEAT, [22:21] ABRMODE, [21] TEACK, [20] ABREN, [21:20] WUS, [20] WUF, [20] WUCF, [19] MSBFIRST, [19] RWU, [18] DATAINV, [18] SBKF, [17] TXINV, [19:17] SCARCNT, [17] CMF, [17] CMCF, [20:16] DEDT, [16] RXINV, [16] BUSY, [15] OVER8, [15] SWAP, [15] DEP, [15] ABRF, [14] CMIE, [14] LINEN, [14] DEM, [14] ABRE, [13] MME, [13] DDRE, [13] UDR, [13] UDRCF, [12] M0, [13:12] STOP, [12] OVRDIS, [12] EOBF, [12] EOBCF, [11] WAKE, [11] CLKEN, [11] ONEBIT, [11] RTOF, [11] RTOCF, [10] PCE, [10] CPOL, [10] CTSIE, [10] CTS, [9] PS, [9] CPHA, [9] CTSE, [9] CTSIF, [9] CTSCF, [8] PEIE, [8] LBCL, [8] RTSE, [15:8] GT, [8] LBDF, [8] LBDCF, [7] TXEIE_TXFNFIE, [7] DMAT, [7] TXE_TXFNF, [7] TCBGTCF, [6] TCIE, [6] LBDIE, [6] DMAR, [6] TC, [6] TCCF, [5] RXNEIE_RXFNEIE, [5] LBDL, [5] SCEN, [5] RXNE_RXFNE, [5] TXFECF, [4] IDLEIE, [4] ADDM7, [4] NACK, [4] TXFRQ, [4] IDLE, [4] IDLECF, [3] TE, [3] DIS_NSS, [3] HDSEL, [3] RXFRQ, [3] ORE, [3] ORECF, [2] RE, [2] IRLP, [2] MMRQ, [2] NE, [2] NECF, [1] UESM, [1] IREN, [1] SBKRQ, [1] FE, [1] FECF, [0] UE, [0] SLVEN, [0] EIE, [19:0] LPUART, [7:0] PSC, [23:0] RTO, [0] ABRRQ, [0] PE, [0] PECF, [8:0] RDR, [8:0] TDR, [3:0] PRESCALER
0x04 CR2
0x08 CR3
0x0C BRR
0x10 GTPR
0x14 RTOR
0x18 RQR
0x1C ISR
0x20 ICR
0x24 RDR
0x28 TDR
0x2C PRESC

## I2C1
Base 0x40005400
Same registers: I2C2 0x40005800, I2C3 0x40007800, I2C4 0x40008400
0x00 CR1
  [31] TEXTEN, [31:28] PRESC, [26] PECBYTE, [25] AUTOEND, [24] RELOAD, [23] PECEN, [22] ALERTEN, [21] SMBDEN, [20] SMBHEN, [23:20] SCLDEL, [19] GCEN, [18] WUPEN, [17] NOSTRETCH, [23:17] ADDCODE, [16] SBC, [23:16] NBYTES, [19:16] SDADEL, [27:16] TIMEOUTB, [16] DIR, [15] RXDMAEN, [15] NACK, [15] OA1EN, [15] OA2EN, [15] TIMOUTEN, [15] BUSY, [14] TXDMAEN, [14] STOP, [13] SWRST, [13] START, [13] ALERT, [13] ALERTCF, [12] ANFOFF, [12] HEAD10R, [12] TIDLE, [12] TIMEOUT, [12] TIMOUTCF, [11] ADD10, [11] PECERR, [11] PECCF, [10] RD_WRN, [10] OA1MODE, [10] OA2MASK04, [10] OVR, [10] OVRCF, [10:9] OA2MASK06, [9] ARLO, [9] ARLOCF, [11:8] DNF, [10:8] OA2MSK, [15:8] SCLH, [8] BERR, [8] BERRCF, [7] ERRIE, [7] TCR, [6] TCIE, [6] TC, [5] STOPIE, [5] STOPF, [5] STOPCF, [4] NACKIE, [4] NACKF, [4] NACKCF, [3] ADDRIE, [3] ADDR, [3] ADDRCF, [2] RXIE, [2] RXNE, [1] TXIE, [7:1] OA2, [1] TXIS, [0] PE, [9:0] SADD, [9:0] OA1, [7:0] SCLL, [11:0] TIMEOUTA, [0] TXE, [7:0] PEC, [7:0] RXDATA, [7:0] TXDATA
0x04 CR2
0x08 OAR1
0x0C OAR2
0x10 TIMINGR
0x14 TIMEOUTR
0x18 ISR
0x1C ICR
0x20 PECR
0x24 RXDR
0x28 TXDR

## USB
Base 0x40005C00
{0x0+4i} EP{i}R 16-bit (i=0..7)
0x40 CNTR 16-bit
0x44 ISTR 16-bit
0x48 FNR 16-bit
0x4C DADDR 16-bit
0x50 BTABLE 16-bit
0x54 LPMCSR 16-bit
0x58 BCDR 16-bit

## FDCAN1
Base 0x40006400
Same registers: FDCAN2 0x40006800, FDCAN3 0x40006C00
0x00 CREL
  [31:28] REL, [31:25] NSJW, [25] RF0L, [25] RF1L, [25] TEFL, [27:24] STEP, [27:24] LSE, [24] F0F, [24] F1F, [24] TFQM, [24] EFF, [23] TDC, [23] ARA, [23] ARAE, [22] PED, [22] PEDE, [21] PEA, [21] PEAE, [21] TFQF, [23:20] SUBSTEP, [20] WDI, [20] WDIE, [19] BO, [19] BOE, [18] EW, [18] EWE, [17] EP, [17] EPE, [19:16] YEAR, [20:16] DBRP, [24:16] NBRP, [19:16] TCP, [31:16] TOP, [23:16] CEL, [22:16] TDCV, [16] ELO, [16] ELOE, [20:16] LSS, [17:16] F0PI, [17:16] F1PI, [17:16] TFQPI, [17:16] EFPI, [15] NISO, [15] RP, [15] TOO, [15] TOOE, [15] FLST, [14] TXP, [14] PXE, [14] MRAF, [14] MRAFE, [13] EFBI, [13] REDL, [13] TSW, [13] TSWE, [12] PXHD, [12] RBRS, [12] TEFL, [12] TEFLE, [11] RESI, [11] TEFF, [11] TEFFE, [10] TEFN, [10] TEFNE, [9] BRSE, [9] TFE, [9] TFEE, [9] F0OM, [15:8] MON, [12:8] DTSEG1, [15:8] WDV, [8] FDOE, [15:8] NTSEG1, [14:8] REC, [10:8] DLEC, [14:8] TDCO, [8] TCF, [8] TCFE, [8] F1OM, [12:8] FIDX, [9:8] F0GI, [9:8] F1GI, [9:8] TFGI, [9:8] EFGI, [7] RX, [7] TEST, [7] BO, [7] TC, [7] TCE, [6] DAR, [6] EW, [6] HPM, [6] HPME, [6] PERR, [7:6] MSI, [6:5] TX, [5] MON, [5] EP, [5] RF1L, [5] RF1LE, [5] BERR, [7:4] DTSEG2, [4] LBCK, [4] CSR, [4] RF1F, [4] RF1FE, [4] MISC, [5:4] ANFS, [3] CSA, [4:3] ACT, [3] RF1N, [3] RF1NE, [3] TFERR, [2] ASM, [2] RF0L, [2] RF0LE, [2] SMSG, [3:2] ANFE, [1] CCE, [2:1] TOS, [1] RF0F, [1] RF0FE, [1] RXFIFO1, [1] EINT1, [1] RRFS, [7:0] DAY, [31:0] ETV, [3:0] DSJW, [7:0] WDC, [0] INIT, [6:0] NTSEG2, [1:0] TSS, [15:0] TSC, [0] ETOC, [15:0] TOC, [7:0] TEC, [2:0] LEC, [6:0] TDCF, [0] RF0N, [0] RF0NE, [0] RXFIFO0, [0] EINT0, [0] RRFE, [28:0] EIDM, [2:0] BIDX, [3:0] F0FL, [2:0] F0AI, [3:0] F1FL, [2:0] F1AI, [2:0] TFFL, [2:0] TRP, [2:0] AR, [2:0] CR, [2:0] TO, [2:0] CF, [2:0] TIE, [2:0] CFIE, [2:0] EFFL, [1:0] EFAI
0x04 ENDN
0x0C DBTP
0x10 TEST
0x14 RWD
0x18 CCCR
0x1C NBTP
0x20 TSCC
0x24 TSCV
0x28 TOCC
0x2C TOCV
0x40 ECR
0x44 PSR
0x48 TDCR
0x50 IR
0x54 IE
0x58 ILS
0x5C ILE
0x80 RXGFC
0x84 XIDAM
0x88 HPMS
0x90 RXF0S
0x94 RXF0A
0x98 RXF1S
0x9C RXF1A
0xC0 TXBC
0xC4 TXFQS
0xC8 TXBRP
0xCC TXBAR
0xD0 TXBCR
0xD4 TXBTO
0xD8 TXBCF
0xDC TXBTIE
0xE0 TXBCIE
0xE4 TXEFS
0xE8 TXEFA
