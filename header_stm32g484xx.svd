# STM32G484xx register map
File version: 1.0
Registers are 32-bit, access not given, reset 0x0 unless marked. A register's access mark holds for its fields unless they carry their own. Offsets are from the block's base; [hi:lo] are bit positions; {n}, {i} and the like mark numbered series.

## DMAMUX1
Base 0x40020800
0x00 CCR0
0x04 CCR1
0x08 CCR2
0x0C CCR3
0x10 CCR4
0x14 CCR5
{0x0+4i} CCR{i} (i=6..9)
0x28 CCR0
0x2C CCR1
0x30 CCR2
0x34 CCR3
0x38 CCR4
0x3C CCR5
0x80 CCRs
0x100 CCR0
0x104 CCR1
0x108 CCR2
0x10C CCR3
0x140 CCRs

## CORDIC
Base 0x40020C00
0x00 CSR
  [31] RRDY, [22] ARGSIZE, [21] RESSIZE, [20] NARGS, [19] NRES, [18] DMAWEN, [17] DMAREN, [16] IEN, [10:8] SCALE, [7:4] PRECISION, [3:0] FUNC, [31:0] ARG, [31:0] RES
0x04 WDATA
0x08 RDATA

## FMAC
Base 0x40021400
0x00 X1BUFCFG
  [31] START, [25:24] FULL_WM, [25:24] EMPTY_WM, [30:24] FUNC, [23:16] R, [16] RESET, [15] CLIPEN, [10] SAT, [9] DMAWEN, [9] UNFL, [15:8] X1_BUF_SIZE, [15:8] X2_BUF_SIZE, [15:8] Y_BUF_SIZE, [15:8] Q, [8] DMAREN, [8] OVFL, [4] SATIEN, [3] UNFLIEN, [2] OVFLIEN, [1] WIEN, [1] X1FULL, [7:0] X1_BASE, [7:0] X2_BASE, [7:0] Y_BASE, [7:0] P, [0] RIEN, [0] YEMPTY, [15:0] WDATA, [15:0] RDATA
0x04 X2BUFCFG
0x08 YBUFCFG
0x0C PARAM
0x10 CR
0x14 SR
0x18 WDATA
0x1C RDATA

## FLASH
Base 0x40022000
0x00 ACR
  [31] LOCK, [31] ECCD, [31] PCROP_RDP, [30] OPTLOCK, [30] ECCC, [30] IRHEN, [29] SEC_PROT2, [29] ECCD2, [28] SEC_PROT1, [28] ECCC2, [29:28] NRST_MODE, [27] OBL_LAUNCH, [27] nBOOT0, [26] RDERRIE, [26] nSWBOOT0, [25] ERRIE, [25] CCMSRAM_RST, [24] EOPIE, [24] ECCIE, [24] SRAM_PE, [23] nBOOT1, [22] SYSF_ECC, [22] DBANK, [21] BK_ECC, [20] BFB2, [19] WWDG_SW, [18] DBG_SWEN, [18] FSTPG, [18] IWDG_STDBY, [17] OPTSTRT, [17] IWDG_STOP, [16] BSY, [16] STRT, [16] IWDG_SW, [22:16] WRP1A_END, [22:16] WRP1B_END, [22:16] WRP2A_END, [22:16] WRP2B_END, [16] BOOT_LOCK, [15] OPTVERR, [15] MER2, [14] SLEEP_PD, [14] RDERR, [14] nRST_SHDW, [13] RUN_PD, [13] nRST_STDBY, [12] DCRST, [12] nRST_STOP, [11] ICRST, [11] BKER, [10] DCEN, [9] ICEN, [9] FASTERR, [8] PRFTEN, [8] MISERR, [10:8] BOR_LEV, [7] PGSERR, [6] SIZERR, [5] PGAERR, [4] WRPERR, [3] PROGERR, [9:3] PNB, [2] MER1, [1] OPERR, [1] PER, [3:0] LATENCY, [0] EOP, [0] PG, [18:0] ADDR_ECC, [7:0] RDP, [14:0] PCROP1_STRT, [14:0] PCROP1_END, [6:0] WRP1A_STRT, [6:0] WRP1B_STRT, [14:0] PCROP2_STRT, [14:0] PCROP2_END, [6:0] WRP2A_STRT, [6:0] WRP2B_STRT, [7:0] SEC_SIZE1, [7:0] SEC_SIZE2
0x04 PDKEYR
0x08 KEYR
0x0C OPTKEYR
0x10 SR
0x14 CR
0x18 ECCR
0x20 OPTR
0x24 PCROP1SR
0x28 PCROP1ER
0x2C WRP1AR
0x30 WRP1BR
0x44 PCROP2SR
0x48 PCROP2ER
0x4C WRP2AR
0x50 WRP2BR
0x70 SEC1R
0x74 SEC2R

## CRC
Base 0x40023000
0x00 DR
  [7] REV_OUT, [6:5] REV_IN, [4:3] POLYSIZE, [31:0] DR, [31:0] IDR, [0] RESET, [31:0] INIT, [31:0] POL
0x04 IDR
0x08 CR
0x10 INIT
0x14 POL

## GPIOA
Base 0x48000000
Same registers: GPIOB 0x48000400, GPIOC 0x48000800, GPIOD 0x48000C00, GPIOE 0x48001000, GPIOF 0x48001400, GPIOG 0x48001800
0x00 MODER
  [31] BR15, [2n+1:2n] MODE{n} (n=0..15), [2n+1:2n] OSPEED{n} (n=0..15), [2n+1:2n] PUPD{n} (n=0..15), [30] BR14, [29] BR13, [28] BR12, [4n+3:4n] AFSEL{n} (n=0..7), [4n-29:4n-32] AFSEL{n} (n=8..15), [27] BR11, [26] BR10, [25] BR9, [24] BR8, [23] BR7, [22] BR6, [21] BR5, [20] BR4, [19] BR3, [18] BR2, [17] BR1, [16] BR0, [16] LCKK, [n] OT{n} (n=0..15), [n] ID{n} (n=0..15), [n] OD{n} (n=0..15), [n] BS{n} (n=0..15), [n] LCK{n} (n=0..15), [15] BR15, [14] BR14, [13] BR13, [12] BR12, [11] BR11, [10] BR10, [9] BR9, [8] BR8, [7] BR7, [6] BR6, [5] BR5, [4] BR4, [3] BR3, [2] BR2, [1] BR1, [0] BR0
0x04 OTYPER
0x08 OSPEEDR
0x0C PUPDR
0x10 IDR
0x14 ODR
0x18 BSRR
0x1C LCKR
0x20 AFR.0
0x24 AFR.1
0x28 BRR

## ADC1
Base 0x50000000
Same registers: ADC2 0x50000100, ADC3 0x50000400, ADC4 0x50000500, ADC5 0x50000600
0x00 ISR
  [31] ADCAL, [31] JQDIS, [31] SMPPLUS, [31] OFFSET{n}_EN (n=1..4), [30] ADCALDIF, [29] DEEPPWD, [28] ADVREGEN, [27] SMPTRIG, [3n+2:3n] SMP{n} (n=0..9), [6n+7:6n+3] JSQ{n} (n=1..4), [30:26] AWD1CH, [26] BULB, [30:26] OFFSET{n}_CH (n=1..4), [25] JAUTO, [25] SWTRIG, [25] SATEN, [25] SATEN, [25] SATEN, [25] SATEN, [24] JAWD1EN, [3n-28:3n-30] SMP{n} (n=10..18), [6n+4:6n] SQ{n} (n=1..4), [6n-26:6n-30] SQ{n} (n=5..9), [6n-56:6n-60] SQ{n} (n=10..14), [24] OFFSETPOS, [24] OFFSETPOS, [24] OFFSETPOS, [24] OFFSETPOS, [23] AWD1EN, [22] AWD1SGL, [21] JQM, [20] JDISCEN, [19:17] DISCNUM, [16] DISCEN, [16] GCOMP, [27:16] HT1, [23:16] HT2, [23:16] HT3, [22:16] CALFACT_D, [15] ALIGN, [14] AUTDLY, [13] CONT, [12] OVRMOD, [14:12] AWDFILT, [10] JQOVF, [10] JQOVFIE, [11:10] EXTEN, [10] ROVSM, [9] AWD3, [9] AWD3IE, [9] TROVS, [8] AWD2, [8] AWD2IE, [7] AWD1, [7] AWD1IE, [8:7] JEXTEN, [6] JEOS, [6] JEOSIE, [10:6] SQ16, [5] JEOC, [5] JEOCIE, [5] JADSTP, [9:5] EXTSEL, [8:5] OVSS, [4] OVR, [4] OVRIE, [4] ADSTP, [3] EOS, [3] EOSIE, [3] JADSTART, [4:3] RES, [2] EOC, [2] EOCIE, [2] ADSTART, [4:2] OVSR, [6:2] JEXTSEL, [1] EOSMP, [1] EOSMPIE, [1] ADDIS, [1] DMACFG, [1] JOVSE, [0] ADRDY, [0] ADRDYIE, [0] ADEN, [0] DMAEN, [0] ROVSE, [11:0] LT1, [7:0] LT2, [7:0] LT3, [3:0] L, [4:0] SQ15, [15:0] RDATA, [1:0] JL, [11:0] OFFSET{n} (n=1..4), [15:0] JDATA, [15:0] JDATA, [15:0] JDATA, [15:0] JDATA, [18:0] AWD2CH, [18:0] AWD3CH, [18:0] DIFSEL, [6:0] CALFACT_S, [13:0] GCOMPCOEFF
0x04 IER
0x08 CR
0x0C CFGR
0x10 CFGR2
0x14 SMPR1
0x18 SMPR2
{0x1C+4i} TR{i} (i=1..3)
{0x2C+4i} SQR{i} (i=1..4)
0x40 DR
0x4C JSQR
{0x5C+4i} OFR{i} (i=1..4)
{0x7C+4i} JDR{i} (i=1..4)
0xA0 AWD2CR
0xA4 AWD3CR
0xB0 DIFSEL
0xB4 CALFACT
0xC0 GCOMP
