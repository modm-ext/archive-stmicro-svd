# STM32G484xx register map
File version: 1.0
Registers are 32-bit, access not given, reset 0x0 unless marked. A register's access mark holds for its fields unless they carry their own. Offsets are from the block's base; [hi:lo] are bit positions; {n}, {i} and the like mark numbered series.

## RCC
Base 0x40021000
0x00 CR
  [31] LPTIM1RST, [31] LPTIM1EN, [31] LPTIM1SMEN, [31] LPWRRSTF, [30] I2C3RST, [30] I2C3EN, [30] I2C3SMEN, [31:30] ADC345SEL, [30] WWDGRSTF, [29] IWDGRSTF, [30:28] MCOPRE, [28] PWRRST, [28] PWREN, [28] PWRSMEN, [29:28] ADC12SEL, [28] SFTRSTF, [31:27] PLLPDIV, [27] BORRSTF, [26] RNGRST, [26] HRTIM1RST, [26] RNGEN, [26] HRTIM1EN, [26] RNGSMEN, [26] HRTIM1SMEN, [27:26] CLK48SEL, [26] PINRSTF, [25] PLLRDY, [26:25] PLLR, [25] FDCANRST, [25] FDCANEN, [25] FDCANSMEN, [25] LSCOSEL, [25] OBLRSTF, [24] PLLON, [30:24] HSITRIM, [27:24] MCOSEL, [24] PLLREN, [24] AESRST, [24] AESEN, [24] AESSMEN, [25:24] FDCANSEL, [24] LSCOEN, [23] USBRST, [23] USBEN, [23] USBSMEN, [23] RMVF, [22] I2C2RST, [22] I2C2EN, [22] I2C2SMEN, [23:22] I2S23SEL, [22:21] PLLQ, [21] I2C1RST, [21] SAI1RST, [21] I2C1EN, [21] SAI1EN, [21] I2C1SMEN, [21] SAI1SMEN, [20] PLLQEN, [20] UART5RST, [20] TIM20RST, [20] UART5EN, [20] TIM20EN, [20] UART5SMEN, [20] TIM20SMEN, [21:20] SAI1SEL, [21:20] QSPISEL, [19] CSSON, [n+15] DAC{n}RST (n=1..4), [19] UART4RST, [n+15] DAC{n}EN (n=1..4), [19] UART4EN, [n+15] DAC{n}SMEN (n=1..4), [19] UART4SMEN, [18] HSEBYP, [18] USART3RST, [18] TIM17RST, [18] USART3EN, [18] TIM17EN, [18] USART3SMEN, [18] TIM17SMEN, [19:18] LPTIM1SEL, [17] HSERDY, [17] PLLP, [17] USART2RST, [17] TIM16RST, [17] USART2EN, [17] TIM16EN, [17] USART2SMEN, [17] TIM16SMEN, [16] HSEON, [23:16] HSICAL, [16] PLLPEN, [16] TIM15RST, [16] TIM15EN, [16] TIM15SMEN, [17:16] I2C3SEL, [16] BDRST, [15] SPI3RST, [15] SPI4RST, [15] SPI3EN, [15] SPI4EN, [15] SPI3SMEN, [15] SPI4SMEN, [15] RTCEN, [14] ADC345RST, [14] SPI2RST, [14] USART1RST, [14] ADC345EN, [14] SPI2EN, [14] USART1EN, [14] ADC345SMEN, [14] SPI2SMEN, [14] USART1SMEN, [15:14] I2C2SEL, [13] ADC12RST, [13] TIM8RST, [13] ADC12EN, [13] TIM8EN, [13] ADC12SMEN, [13] TIM8SMEN, [12] CRCRST, [12] SPI1RST, [12] CRCEN, [12] SPI1EN, [12] CRCSMEN, [12] SPI1SMEN, [13:12] I2C1SEL, [13:11] PPRE2, [11] TIM1RST, [11] WWDGEN, [11] TIM1EN, [11] WWDGSMEN, [11] TIM1SMEN, [10] HSIRDY, [10] HSI48RDYIE, [10] HSI48RDYF, [10] HSI48RDYC, [10] RTCAPBEN, [10] SRAM2SMEN, [10] RTCAPBSMEN, [11:10] LPUART1SEL, [9] HSIKERON, [9] LSECSSIE, [9] LSECSSF, [9] LSECSSC, [9] SRAM1SMEN, [9] CCMSRAMSMEN, [8] HSION, [10:8] PPRE1, [14:8] PLLN, [8] CSSF, [8] CSSC, [8] FLASHRST, [8] QSPIRST, [8] CRSRST, [8] UCPD1RST, [8] FLASHEN, [8] QSPIEN, [8] CRSEN, [8] UCPD1EN, [8] FLASHSMEN, [8] QSPISMEN, [8] CRSSMEN, [8] UCPD1SMEN, [9:8] UART5SEL, [9:8] RTCSEL, [15:7] HSI48CAL, [6] GPIOGRST, [6] GPIOGEN, [6] GPIOGSMEN, [7:6] UART4SEL, [6] LSECSSD, [5] PLLRDYIE, [5] PLLRDYF, [5] PLLRDYC, [5] GPIOFRST, [n-2] TIM{n}RST (n=2..7), [5] GPIOFEN, [n-2] TIM{n}EN (n=2..7), [5] GPIOFSMEN, [n-2] TIM{n}SMEN (n=2..7), [5] LSECSSON, [7:4] HPRE, [7:4] PLLM, [4] HSERDYIE, [4] HSERDYF, [4] HSERDYC, [4] FMACRST, [4] GPIOERST, [4] FMACEN, [4] GPIOEEN, [4] FMACSMEN, [4] GPIOESMEN, [5:4] USART3SEL, [3] HSIRDYIE, [3] HSIRDYF, [3] HSIRDYC, [3] CORDICRST, [3] GPIODRST, [3] CORDICEN, [3] GPIODEN, [3] CORDICSMEN, [3] GPIODSMEN, [4:3] LSEDRV, [3:2] SWS, [2] DMAMUX1RST, [2] GPIOCRST, [2] DMAMUX1EN, [2] GPIOCEN, [2] DMAMUX1SMEN, [2] GPIOCSMEN, [3:2] USART2SEL, [2] LSEBYP, [1] PLLSRC_HSI, [1] LSERDYIE, [1] LSERDYF, [1] LSERDYC, [1] DMA2RST, [1] GPIOBRST, [1] I2C4RST, [1] DMA2EN, [1] GPIOBEN, [1] I2C4EN, [1] DMA2SMEN, [1] GPIOBSMEN, [1] I2C4SMEN, [1] LSERDY, [1] LSIRDY, [1] HSI48RDY, [1:0] SW, [1:0] PLLSRC_HSE, [0] LSIRDYIE, [0] LSIRDYF, [0] LSIRDYC, [0] DMA1RST, [0] GPIOARST, [0] FMCRST, [0] LPUART1RST, [0] SYSCFGRST, [0] DMA1EN, [0] GPIOAEN, [0] FMCEN, [0] LPUART1EN, [0] SYSCFGEN, [0] DMA1SMEN, [0] GPIOASMEN, [0] FMCSMEN, [0] LPUART1SMEN, [0] SYSCFGSMEN, [1:0] USART1SEL, [0] LSEON, [0] LSION, [0] HSI48ON, [1:0] I2C4SEL
0x04 ICSCR
0x08 CFGR
0x0C PLLCFGR
0x18 CIER
0x1C CIFR
0x20 CICR
{0x24+4i} AHB{i}RSTR (i=1..3)
0x38 APB1RSTR1
0x3C APB1RSTR2
0x40 APB2RSTR
{0x44+4i} AHB{i}ENR (i=1..3)
0x58 APB1ENR1
0x5C APB1ENR2
0x60 APB2ENR
{0x64+4i} AHB{i}SMENR (i=1..3)
0x78 APB1SMENR1
0x7C APB1SMENR2
0x80 APB2SMENR
0x88 CCIPR
0x90 BDCR
0x94 CSR
0x98 CRRCR
0x9C CCIPR2
