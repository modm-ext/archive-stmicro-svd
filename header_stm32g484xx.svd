# STM32G484xx register map
File version: 1.0
Registers are 32-bit, access not given, reset 0x0 unless marked. A register's access mark holds for its fields unless they carry their own. Offsets are from the block's base; [hi:lo] are bit positions.

## ADC12_COMMON
Base 0x50000300
Same registers: ADC345_COMMON 0x50000700
0x00 CSR
  [26] JQOVF_SLV, [25] AWD3_SLV, [24] AWD2_SLV, [24] VBATSEL, [23] AWD1_SLV, [23] VSENSESEL, [22] JEOS_SLV, [22] VREFEN, [21] JEOC_SLV, [20] OVR_SLV, [19] EOS_SLV, [18] EOC_SLV, [21:18] PRESC, [17] EOSMP_SLV, [16] ADRDY_SLV, [17:16] CKMODE, [31:16] RDATA_SLV, [15:14] MDMA, [13] DMACFG, [10] JQOVF_MST, [9] AWD3_MST, [8] AWD2_MST, [11:8] DELAY, [7] AWD1_MST, [6] JEOS_MST, [5] JEOC_MST, [4] OVR_MST, [3] EOS_MST, [2] EOC_MST, [1] EOSMP_MST, [0] ADRDY_MST, [4:0] DUAL, [15:0] RDATA_MST
0x08 CCR
0x0C CDR

## DAC
Base 0x50000800
0x00 CR
  [31] BWST2, [30] CEN2, [30] CAL_FLAG2, [29] DMAUDRIE2, [29] DMAUDR2, [28] DMAEN2, [28] DORSTAT2, [27] DAC2RDY, [25] SINFORMAT2, [27:24] MAMP2, [24] DMADOUBLE2, [27:24] STINCTRIGSEL2, [23:22] WAVE2, [31:20] DACC1DHRB, [31:20] DACC2DHRB, [31:20] DACC2DHR, [21:18] TSEL2, [17] TEN2, [17] SWTRIGB2, [16] EN2, [16] SWTRIGB1, [27:16] DACC1DHRB, [27:16] DACC2DHRB, [27:16] DACC2DHR, [27:16] DACC1DORB, [27:16] DACC2DORB, [20:16] OTRIM2, [18:16] MODE2, [25:16] THOLD2, [23:16] TREFRESH2, [31:16] STINCDATA1, [31:16] STINCDATA2, [19:16] STRSTTRIGSEL2, [15] HFSEL, [15] BWST1, [14] CEN1, [14] CAL_FLAG1, [15:14] HFSEL, [13] DMAUDRIE1, [13] DMAUDR1, [12] DMAEN1, [12] DORSTAT1, [12] STDIR1, [12] STDIR2, [11] DAC1RDY, [9] SINFORMAT1, [11:8] MAMP1, [15:8] DACC1DHRB, [15:8] DACC2DHRB, [15:8] DACC2DHR, [8] DMADOUBLE1, [11:8] STINCTRIGSEL1, [7:6] WAVE1, [15:4] DACC1DHR, [15:4] DACC2DHR, [15:4] DACC1DHR, [5:2] TSEL1, [1] TEN1, [1] SWTRIG2, [0] EN1, [0] SWTRIG1, [11:0] DACC1DHR, [7:0] DACC1DHR, [11:0] DACC2DHR, [7:0] DACC2DHR, [11:0] DACC1DHR, [7:0] DACC1DHR, [11:0] DACC1DOR, [11:0] DACC2DOR, [4:0] OTRIM1, [2:0] MODE1, [9:0] TSAMPLE1, [9:0] TSAMPLE2, [9:0] THOLD1, [7:0] TREFRESH1, [11:0] STRSTDATA1, [11:0] STRSTDATA2, [3:0] STRSTTRIGSEL1
0x04 SWTRIGR
0x08 DHR12R1
0x0C DHR12L1
0x10 DHR8R1
0x14 DHR12R2
0x18 DHR12L2
0x1C DHR8R2
0x20 DHR12RD
0x24 DHR12LD
0x28 DHR8RD
0x2C DOR1
0x30 DOR2
0x34 SR
0x38 CCR
0x3C MCR
0x40 SHSR1
0x44 SHSR2
0x48 SHHR
0x4C SHRR
0x58 STR1
0x5C STR2
0x60 STMODR

## DAC1
Base 0x50000800
0x00 CR
  [31] BWST2, [30] CEN2, [30] CAL_FLAG2, [29] DMAUDRIE2, [29] DMAUDR2, [28] DMAEN2, [28] DORSTAT2, [27] DAC2RDY, [25] SINFORMAT2, [27:24] MAMP2, [24] DMADOUBLE2, [27:24] STINCTRIGSEL2, [23:22] WAVE2, [31:20] DACC1DHRB, [31:20] DACC2DHRB, [31:20] DACC2DHR, [21:18] TSEL2, [17] TEN2, [17] SWTRIGB2, [16] EN2, [16] SWTRIGB1, [27:16] DACC1DHRB, [27:16] DACC2DHRB, [27:16] DACC2DHR, [27:16] DACC1DORB, [27:16] DACC2DORB, [20:16] OTRIM2, [18:16] MODE2, [25:16] THOLD2, [23:16] TREFRESH2, [31:16] STINCDATA1, [31:16] STINCDATA2, [19:16] STRSTTRIGSEL2, [15] HFSEL, [15] BWST1, [14] CEN1, [14] CAL_FLAG1, [15:14] HFSEL, [13] DMAUDRIE1, [13] DMAUDR1, [12] DMAEN1, [12] DORSTAT1, [12] STDIR1, [12] STDIR2, [11] DAC1RDY, [9] SINFORMAT1, [11:8] MAMP1, [15:8] DACC1DHRB, [15:8] DACC2DHRB, [15:8] DACC2DHR, [8] DMADOUBLE1, [11:8] STINCTRIGSEL1, [7:6] WAVE1, [15:4] DACC1DHR, [15:4] DACC2DHR, [15:4] DACC1DHR, [5:2] TSEL1, [1] TEN1, [1] SWTRIG2, [0] EN1, [0] SWTRIG1, [11:0] DACC1DHR, [7:0] DACC1DHR, [11:0] DACC2DHR, [7:0] DACC2DHR, [11:0] DACC1DHR, [7:0] DACC1DHR, [11:0] DACC1DOR, [11:0] DACC2DOR, [4:0] OTRIM1, [2:0] MODE1, [9:0] TSAMPLE1, [9:0] TSAMPLE2, [9:0] THOLD1, [7:0] TREFRESH1, [11:0] STRSTDATA1, [11:0] STRSTDATA2, [3:0] STRSTTRIGSEL1
0x04 SWTRIGR
0x08 DHR12R1
0x0C DHR12L1
0x10 DHR8R1
0x14 DHR12R2
0x18 DHR12L2
0x1C DHR8R2
0x20 DHR12RD
0x24 DHR12LD
0x28 DHR8RD
0x2C DOR1
0x30 DOR2
0x34 SR
0x38 CCR
0x3C MCR
0x40 SHSR1
0x44 SHSR2
0x48 SHHR
0x4C SHRR
0x58 STR1
0x5C STR2
0x60 STMODR

## DAC2
Base 0x50000C00
0x00 CR
  [31] BWST2, [30] CEN2, [30] CAL_FLAG2, [29] DMAUDRIE2, [29] DMAUDR2, [28] DMAEN2, [28] DORSTAT2, [27] DAC2RDY, [25] SINFORMAT2, [27:24] MAMP2, [24] DMADOUBLE2, [27:24] STINCTRIGSEL2, [23:22] WAVE2, [31:20] DACC1DHRB, [31:20] DACC2DHRB, [31:20] DACC2DHR, [21:18] TSEL2, [17] TEN2, [17] SWTRIGB2, [16] EN2, [16] SWTRIGB1, [27:16] DACC1DHRB, [27:16] DACC2DHRB, [27:16] DACC2DHR, [27:16] DACC1DORB, [27:16] DACC2DORB, [20:16] OTRIM2, [18:16] MODE2, [25:16] THOLD2, [23:16] TREFRESH2, [31:16] STINCDATA1, [31:16] STINCDATA2, [19:16] STRSTTRIGSEL2, [15] HFSEL, [15] BWST1, [14] CEN1, [14] CAL_FLAG1, [15:14] HFSEL, [13] DMAUDRIE1, [13] DMAUDR1, [12] DMAEN1, [12] DORSTAT1, [12] STDIR1, [12] STDIR2, [11] DAC1RDY, [9] SINFORMAT1, [11:8] MAMP1, [15:8] DACC1DHRB, [15:8] DACC2DHRB, [15:8] DACC2DHR, [8] DMADOUBLE1, [11:8] STINCTRIGSEL1, [7:6] WAVE1, [15:4] DACC1DHR, [15:4] DACC2DHR, [15:4] DACC1DHR, [5:2] TSEL1, [1] TEN1, [1] SWTRIG2, [0] EN1, [0] SWTRIG1, [11:0] DACC1DHR, [7:0] DACC1DHR, [11:0] DACC2DHR, [7:0] DACC2DHR, [11:0] DACC1DHR, [7:0] DACC1DHR, [11:0] DACC1DOR, [11:0] DACC2DOR, [4:0] OTRIM1, [2:0] MODE1, [9:0] TSAMPLE1, [9:0] TSAMPLE2, [9:0] THOLD1, [7:0] TREFRESH1, [11:0] STRSTDATA1, [11:0] STRSTDATA2, [3:0] STRSTTRIGSEL1
0x04 SWTRIGR
0x08 DHR12R1
0x0C DHR12L1
0x10 DHR8R1
0x14 DHR12R2
0x18 DHR12L2
0x1C DHR8R2
0x20 DHR12RD
0x24 DHR12LD
0x28 DHR8RD
0x2C DOR1
0x30 DOR2
0x34 SR
0x38 CCR
0x3C MCR
0x40 SHSR1
0x44 SHSR2
0x48 SHHR
0x4C SHRR
0x58 STR1
0x5C STR2
0x60 STMODR
