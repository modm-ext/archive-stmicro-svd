# STM32G484xx register map
File version: 1.0
Registers are 32-bit, access not given, reset 0x0 unless marked. A register's access mark holds for its fields unless they carry their own. Offsets are from the block's base; [hi:lo] are bit positions; {n}, {i} and the like mark numbered series.

## HRTIM1_COMMON
Base 0x40016B80
0x00 CR1
  [31] BMSTAT, [31] OCHPEV, [31] AD1TEPER, [31] AD2TERST, [31] AD3TEPER, [31] AD4TERST, [8n-1] FLT{n}LCK (n=1..4), [8n-1] FLT{n}RSTM (n=1..4), [30] EEV8, [31:30] EEVSD, [30] AD{n}TEC4 (n=1..4), [8n-2] FLT{n}CRES (n=1..4), [29] EEV7, [6n-1] EE{n}FAST (n=1..5), [29] AD{n}TEC3 (n=1..4), [28] TDEEV8, [28] AD1TFRST, [28] AD2TEC2, [28] AD3TFRST, [28] AD4TEC2, [27] TAEEV7, [6n-2:6n-3] EE{n}SNS (n=1..5), [6n-32:6n-33] EE{n}SNS (n=6..10), [27] AD1TDPER, [27] AD2TDRST, [27] AD3TDPER, [27] AD4TDRST, [8n-2:8n-5] FLT{n}F (n=1..4), [26] TECMP2, [6n-4] EE{n}POL (n=1..5), [6n-34] EE{n}POL (n=6..10), [26] AD1TDC4, [26] AD2TDPER, [26] AD3TDC4, [26] AD4TDPER, [8n-6] FLT{n}SRC_0 (n=1..4), [30:26] AD10TRG, [8n-3:8n-6] FLT{n}CNT (n=1..4), [3n+15:3n+13] ADC{n}USRC (n=1..4), [25] TECMP1, [25] AD1TDC3, [25] AD2TDC4, [25] AD3TDC3, [25] AD4TDC4, [8n-7] FLT{n}P (n=1..4), [8n-7] FLT{n}BLKS (n=1..4), [24] TEREP, [6n-5:6n-6] EE{n}SRC (n=1..5), [6n-35:6n-36] EE{n}SRC (n=6..10), [6n-33:6n-36] EE{n}F (n=6..10), [24] AD{n}TFPER (n=1..4), [8n-8] FLT{n}E (n=1..4), [25:24] FLTSD, [6n-2:6n-6] AD{n}PSC (n=1..5), [6n-32:6n-36] AD{n}PSC (n=6..10), [8n-8] FLT{n}BLKE (n=1..4), [23] TFCMP1, [23] AD1TCPER, [23] AD2TDC2, [23] AD3TCPER, [23] AD4TDC2, [22] TFBM, [22] TDCMP2, [22] AD1TCC4, [22] AD2TCRST, [22] AD3TCC4, [22] AD4TCRST, [21] SWPF, [21] TEBM, [21] TFREP, [21] AD1TCC3, [21] AD2TCPER, [21] AD3TCC3, [21] AD4TCPER, [n+15] FLT{n}SRC_1 (n=1..6), [25:21] AD9TRG, [20] SWPE, [20] TDBM, [20] TDREP, [20] AD1TFC4, [20] AD2TCC4, [20] AD3TFC4, [20] AD4TCC4, [4n-18:4n-20] AD{n}USRC (n=5..10), [19] SWPD, [19] TCBM, [19] TDRST, [19] AD1TBRST, [19] AD2TFC4, [19] AD3TBRST, [19] AD4TFC4, [18] SWPC, [18] TBBM, [18] TFRST, [18] AD1TBPER, [18] AD2TCC2, [18] AD3TBPER, [18] AD4TCC2, [17] SWPB, [17] BMPER, [17] BMPERC, [17] BMPER, [17] TABM, [17] TCCMP1, [17] AD1TBC4, [17] AD2TBPER, [17] AD3TBC4, [17] AD4TBPER, [16] SWPA, [16] DLLRDY, [16] DLLRDYC, [16] DLLRDY, [16] MTBM, [16] TCREP, [16] AD1TBC3, [16] AD2TBC4, [16] AD3TBC3, [16] AD4TBC4, [20:16] AD8TRG, [15] TCRST, [15] AD{n}TFC3 (n=1..4), [15] FLT6LCK, [15] FLT6RSTM, [14] TFRST, [14] TBCMP2, [14] AD1TARST, [14] AD2TBC2, [14] AD3TARST, [14] AD4TBC2, [14] FLT6CRES, [13] TERST, [13] TBCMP1, [13] AD{n}TAPER (n=1..4), [12] TDRST, [12] TBREP, [12] AD{n}TAC4 (n=1..4), [11] TCRST, [11] TF2OEN, [11] TF2ODIS, [11] TF2ODS, [11] TBRST, [11] AD1TAC3, [11] AD2TFC2, [11] AD3TAC3, [11] AD4TFC2, [14:11] FLT6F, [10] TBRST, [10] TF1OEN, [10] TF1ODIS, [10] TF1ODS, [10] BMPREN, [10] TACMP2, [10] AD1TFC2, [10] AD2TAC2, [10] AD3TFC2, [10] AD4TAC2, [10] FLT6SRC_0, [14:10] AD7TRG, [13:10] FLT6CNT, [9] TARST, [9] TE2OEN, [9] TE2ODIS, [9] TE2ODS, [9] TACMP1, [n+4] AD1EEV{n} (n=1..5), [n-1] AD2EEV{n} (n=6..10), [n+4] AD3EEV{n} (n=1..5), [n-1] AD4EEV{n} (n=6..10), [9] FLT6P, [n+5] MCMP{n} (n=1..4), [9] FLT6BLKS, [8] MRST, [8] TE1OEN, [8] TE1ODIS, [8] TE1ODS, [8] TAREP, [8] FLT6E, [8] FLT6BLKE, [7] TD2OEN, [7] TD2ODIS, [7] TD2ODS, [7] TARST, [7] FLT5LCK, [7] FLT5RSTM, [6] TFUDIS, [6] TFSWU, [6] FLT6, [6] FLT6C, [6] FLT6, [6] TD1OEN, [6] TD1ODIS, [6] TD1ODS, [9:6] BMPRSC, [n+2] MSTCMP{n} (n=1..4), [6] FLT5CRES, [5] TEUDIS, [5] TESWU, [5] SYSFLT, [5] SYSFLTC, [5] SYSFLT, [5] TC2OEN, [5] TC2ODIS, [5] TC2ODS, [5] MREP, [9:5] AD6TRG, [4] TDUDIS, [4] TDSWU, [4] FLT5, [n-1] FLT{n}C (n=1..5), [4] FLT5, [4] TC1OEN, [4] TC1ODIS, [4] TC1ODS, [4] AD{n}MPER (n=1..4), [4] MPER, [3] TCUDIS, [3] TCSWU, [3] FLT4, [3] FLT4, [3] TB2OEN, [3] TB2ODIS, [3] TB2ODS, [3] AD{n}MC4 (n=1..4), [6:3] FLT5F, [3] MCNT, [2] TBUDIS, [2] TBSWU, [2] FLT3, [2] FLT3, [2] TB1OEN, [2] TB1ODIS, [2] TB1ODS, [5:2] BMCLK, [2] MSTREP, [2] AD{n}MC3 (n=1..4), [3:2] CALRTE, [2] FLT5SRC_0, [2] MDIER, [5:2] FLT5CNT, [1] TAUDIS, [1] TASWU, [1] FLT2, [1] FLT2, [1] TA2OEN, [1] TA2ODIS, [1] TA2ODS, [1] BMOM, [1] MSTRST, [1] AD{n}MC2 (n=1..4), [1] CALEN, [1] FLT5P, [1] MICR, [1] FLT5BLKS, [0] MUDIS, [0] MSWU, [0] FLT1, [0] FLT1, [0] TA1OEN, [0] TA1ODIS, [0] TA1ODS, [0] BME, [0] SW, [15:0] BMCMPR, [15:0] BMPER, [0] AD{n}MC1 (n=1..4), [0] CAL, [0] FLT5E, [0] MCR, [31:0] BDMADR, [4:0] AD5TRG, [0] FLT5BLKE
0x04 CR2
0x08 ISR
0x0C ICR
0x10 IER
0x14 OENR
0x18 ODISR
0x1C ODSR
0x20 BMCR
0x24 BMTRGR
0x28 BMCMPR
0x2C BMPER
{0x2C+4i} EECR{i} (i=1..3)
{0x38+4i} ADC{i}R (i=1..4)
0x4C DLLCR
0x50 FLTINR1
0x54 FLTINR2
0x58 BDMUPR
0x5C BDTAUPR
0x60 BDTBUPR
0x64 BDTCUPR
0x68 BDTDUPR
0x6C BDTEUPR
0x70 BDMADR
0x74 BDTFUPR
0x78 ADCER
0x7C ADCUR
0x80 ADCPS1
0x84 ADCPS2
0x88 FLTINR3
0x8C FLTINR4
