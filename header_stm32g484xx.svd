# STM32G484xx register map
File version: 1.0
Registers are 32-bit, access not given, reset 0x0 unless marked. A register's access mark holds for its fields unless they carry their own. Offsets are from the block's base; [hi:lo] are bit positions; {n}, {i} and the like mark numbered series.

## FDCAN_CONFIG
Base 0x40006500
0x00 CKDIV
  [3:0] PDIV

## PWR
Base 0x40007000
0x00 CR1
  [15] EIWF, [15] WUFI, [n+11] PVMO{n} (n=1..4), [n] PA{n} (n=12..15), [15] PB15, [15] PB15, [15] PC15, [15] PC15, [15] PD15, [15] PD15, [15] PE15, [15] PE15, [15] PF15, [15] PF15, [n] PG{n} (n=10..15), [14] LPR, [14] UCPD_DBDIS, [14] PB14, [14] PB14, [14] PC14, [14] PC14, [14] PD14, [14] PD14, [14] PE14, [14] PE14, [14] PF14, [14] PF14, [13] UCPD_STDBY, [13] PB13, [13] PB13, [13] PC13, [13] PC13, [13] PD13, [13] PD13, [13] PE13, [13] PE13, [13] PF13, [13] PF13, [12] PA12, [12] PB12, [12] PB12, [12] PC12, [12] PC12, [12] PD12, [12] PD12, [12] PE12, [12] PE12, [12] PF12, [12] PF12, [11] PVDO, [11] PA11, [11] PA11, [11] PB11, [11] PB11, [11] PC11, [11] PC11, [11] PD11, [11] PD11, [11] PE11, [11] PE11, [11] PF11, [11] PF11, [10] APC, [10] VOSF, [10] PA10, [10] PA10, [10] PB10, [10] PB10, [10] PC10, [10] PC10, [10] PD10, [10] PD10, [10] PE10, [10] PE10, [10] PF10, [10] PF10, [10] PG10, [10:9] VOS, [9] VBRS, [9] REGLPF, [9] PA9, [9] PA9, [9] PB9, [9] PB9, [9] PC9, [9] PC9, [9] PD9, [9] PD9, [9] PE9, [9] PE9, [9] PF9, [9] PF9, [9] PG9, [9] PG9, [8] DBP, [8] RRS, [8] VBE, [8] SBF, [8] REGLPS, [8] CSBF, [8] PA8, [8] PA8, [8] PB8, [8] PB8, [8] PC8, [8] PC8, [8] PD8, [8] PD8, [8] PE8, [8] PE8, [8] PF8, [8] PF8, [8] PG8, [8] PG8, [8] R1MODE, [n+3] PVME{n} (n=1..4), [7] PA7, [7] PA7, [7] PB7, [7] PB7, [7] PC7, [7] PC7, [7] PD7, [7] PD7, [7] PE7, [7] PE7, [7] PF7, [7] PF7, [7] PG7, [7] PG7, [6] PA6, [6] PA6, [6] PB6, [6] PB6, [6] PC6, [6] PC6, [6] PD6, [6] PD6, [6] PE6, [6] PE6, [6] PF6, [6] PF6, [6] PG6, [6] PG6, [5] PA5, [5] PA5, [5] PB5, [5] PB5, [5] PC5, [5] PC5, [5] PD5, [5] PD5, [5] PE5, [5] PE5, [5] PF5, [5] PF5, [5] PG5, [5] PG5, [n-1] EWUP{n} (n=1..5), [n-1] WP{n} (n=1..5), [n-1] WUF{n} (n=1..5), [n-1] CWUF{n} (n=1..5), [4] PA4, [4] PA4, [4] PB4, [4] PC4, [4] PC4, [4] PD4, [4] PD4, [4] PE4, [4] PE4, [4] PF4, [4] PF4, [4] PG4, [4] PG4, [3] PLS_LEV4, [3] PA3, [3] PA3, [3] PB3, [3] PB3, [3] PC3, [3] PC3, [3] PD3, [3] PD3, [3] PE3, [3] PE3, [3] PF3, [3] PF3, [3] PG3, [3] PG3, [2] LPMS_SHUTDOWN, [3:2] PLS_LEV6, [2] PA2, [2] PA2, [2] PB2, [2] PB2, [2] PC2, [2] PC2, [2] PD2, [2] PD2, [2] PE2, [2] PE2, [2] PF2, [2] PF2, [2] PG2, [2] PG2, [3:1] PLS_LEV7, [1] PA1, [1] PA1, [1] PB1, [1] PB1, [1] PC1, [1] PC1, [1] PD1, [1] PD1, [1] PE1, [1] PE1, [1] PF1, [1] PF1, [1] PG1, [1] PG1, [0] LPMS_STOP1, [0] PVDE, [0] PA0, [0] PA0, [0] PB0, [0] PB0, [0] PC0, [0] PC0, [0] PD0, [0] PD0, [0] PE0, [0] PE0, [0] PF0, [0] PF0, [0] PG0, [0] PG0
0x04 CR2
0x08 CR3
0x0C CR4
0x10 SR1
0x14 SR2
0x18 SCR
0x20 PUCRA
0x24 PDCRA
0x28 PUCRB
0x2C PDCRB
0x30 PUCRC
0x34 PDCRC
0x38 PUCRD
0x3C PDCRD
0x40 PUCRE
0x44 PDCRE
0x48 PUCRF
0x4C PDCRF
0x50 PUCRG
0x54 PDCRG
0x80 CR5

## LPTIM1
Base 0x40007C00
0x00 ISR
  [24] ENC, [23] COUNTMODE, [22] PRELOAD, [21] WAVPOL, [20] WAVE, [19] TIMOUT, [18:17] TRIGEN, [29:13] TRIGSEL, [11:9] PRESC, [6] DOWN, [6] DOWNCF, [6] DOWNIE, [7:6] TRGFLT, [5] UP, [5] UPCF, [5] UPIE, [4] ARROK, [4] ARROKCF, [4] ARROKIE, [4] RSTARE, [3] CMPOK, [3] CMPOKCF, [3] CMPOKIE, [4:3] CKFLT, [3] COUNTRST, [2] EXTTRIG, [2] EXTTRIGCF, [2] EXTTRIGIE, [2] CNTSTRT, [1] ARRM, [1] ARRMCF, [1] ARRMIE, [2:1] CKPOL, [1] SNGSTRT, [5:1] IN2, [0] CMPM, [0] CMPMCF, [0] CMPMIE, [0] CKSEL, [0] ENABLE, [15:0] CMP, [15:0] ARR, [15:0] CNT, [3:0] IN1
0x04 ICR
0x08 IER
0x0C CFGR
0x10 CR
0x14 CMP
0x18 ARR
0x1C CNT
0x20 OR

## UCPD1
Base 0x4000A000
0x00 CFG1
  [31] UCPDEN, [30] RXDMAEN, [29] TXDMAEN, [21] CC2TCDIS, [28:20] RXORDSETEN, [20] CC1TCDIS, [20] FRSEVTIE, [20] FRSEVT, [20] FRSEVTCF, [18] RDCH, [19:18] TYPEC_VSTATE_CC2, [19:17] PSC_UCPDCLK, [17] FRSTX, [16] FRSRXEN, [17:16] TYPEC_VSTATE_CC1, [15] TYPECEVT2IE, [15] TYPECEVT2, [15] TYPECEVT2CF, [14] TYPECEVT1IE, [14] TYPECEVT1, [14] TYPECEVT1CF, [13] RXERR, [12] RXMSGENDIE, [12] RXMSGEND, [12] RXMSGENDCF, [15:11] TRANSWIN, [11] RXOVRIE, [11] RXOVR, [11] RXOVRCF, [11:10] CCENABLE, [10] RXHRSTDETIE, [10] RXHRSTDET, [10] RXHRSTDETCF, [9] ANAMODE, [9] RXORDDETIE, [9] RXORDDET, [9] RXORDDETCF, [8] RXNEIE, [8] RXNE, [8:7] ANASUBMODE, [10:6] IFRGAP, [6] PHYCCSEL, [6] TXUNDIE, [6] TXUND, [6] TXUNDCF, [5] PHYRXEN, [5] HRSTSENTIE, [5] HRSTSENT, [5] HRSTSENTCF, [4] RXMODE, [4] HRSTDISCIE, [4] HRSTDISC, [4] HRSTDISCCF, [6:4] RXSOPKINVALID, [3] WUPEN, [3] TXHRST, [3] TXMSGABTIE, [3] TXMSGABT, [3] TXMSGABTCF, [3] RXSOP3OF4, [2] FORCECLK, [2] TXSEND, [2] TXMSGSENTIE, [2] TXMSGSENT, [2] TXMSGSENTCF, [1] RXFILT2N3, [1] TXMSGDISCIE, [1] TXMSGDISC, [1] TXMSGDISCCF, [5:0] HBITCLKDIV, [0] RXFILTDIS, [1:0] TXMODE, [0] TXISIE, [0] TXIS, [19:0] TXORDSET, [9:0] TXPAYSZ, [7:0] TXDATA, [2:0] RXORDSET, [9:0] RXPAYSZ, [7:0] RXDATA, [19:0] RXSOPX1, [19:0] RXSOPX2
0x04 CFG2
0x0C CR
0x10 IMR
0x14 SR
0x18 ICR
0x1C TX_ORDSET
0x20 TX_PAYSZ
0x24 TXDR
0x28 RX_ORDSET
0x2C RX_PAYSZ
0x30 RXDR
0x34 RX_ORDEXT1
0x38 RX_ORDEXT2
