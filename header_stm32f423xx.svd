# STM32F423xx register map
File version: 1.0
STM32F423CHU3,STM32F423CHU6,STM32F423CHU7,STM32F423MHY3,STM32F423MHY6,STM32F423MHY7,STM32F423RHT3,STM32F423RHT6,STM32F423RHT7,STM32F423VHH3,STM32F423VHH6,STM32F423VHH7,STM32F423VHT3,STM32F423VHT6,STM32F423VHT7,STM32F423ZHJ3,STM32F423ZHJ6,STM32F423ZHJ7,STM32F423ZHT3,STM32F423ZHT6,STM32F423ZHT7
Registers are 32-bit, access not given, reset 0x0 unless marked. A register's access mark holds for its fields unless they carry their own. Offsets are from the block's base; lines under a group give offsets from that group; [hi:lo] are bit positions; {n}, {i} and the like mark numbered series; 'fields as' and 'values as' point back to an identical list; <NAME> marks a mode.

## Memory map
0x40000000 TIM2
0x40000400 TIM3
0x40000800 TIM4
0x40000C00 TIM5
0x40001000 TIM6
0x40001400 TIM7
0x40001800 TIM12
0x40001C00 TIM13
0x40002000 TIM14
0x40002400 LPTIM1
0x40002800 RTC
0x40002C00 WWDG
0x40003000 IWDG
0x40003400 I2S2ext
0x40003800 SPI2
0x40003C00 SPI3
0x40004000 I2S3ext
0x40004400 USART2
0x40004800 USART3
0x40004C00 UART4
0x40005000 UART5
0x40005400 I2C1
0x40005800 I2C2
0x40005C00 I2C3
0x40006000 FMPI2C1
0x40006400 CAN1
0x40006800 CAN2
0x40006C00 CAN3
0x40007000 PWR
0x40007400 DAC1
0x40007800 UART7
0x40007C00 UART8
0x40010000 TIM1
0x40010400 TIM8
0x40011000 USART1
0x40011400 USART6
0x40011800 UART9
0x40011C00 UART10
0x40012000 ADC1
0x40012C00 SDIO
0x40013000 SPI1
0x40013400 SPI4
0x40013800 SYSCFG
0x40013C00 EXTI
0x40014000 TIM9
0x40014400 TIM10
0x40014800 TIM11
0x40015000 SPI5
0x40015800 SAI1
0x40016000 DFSDM1
0x40016400 DFSDM2
0x40020000 GPIOA
0x40020400 GPIOB
0x40020800 GPIOC
0x40020C00 GPIOD
0x40021000 GPIOE
0x40021400 GPIOF
0x40021800 GPIOG
0x40021C00 GPIOH
0x40023000 CRC
0x40023800 RCC
0x40023C00 FLASH
0x40026000 DMA1
0x40026400 DMA2
0x50000000 USB_OTG_FS
0x50060000 AES
0x50060800 RNG
0xA0000000 FSMC_Bank1
0xA0000104 FSMC_Bank1E
0xA0001000 QUADSPI
0xE0042000 DBGMCU

## TIM2
Base 0x40000000
Same registers: TIM3 0x40000400, TIM4 0x40000800, TIM5 0x40000C00, TIM6 0x40001000, TIM7 0x40001400, TIM12 0x40001800, TIM13 0x40001C00, TIM14 0x40002000, TIM1 0x40010000, TIM8 0x40010400, TIM9 0x40014000, TIM10 0x40014400, TIM11 0x40014800
0x00 CR1
  [15] ETP, [15] OC2CE, [15] OC4CE, [4n-1] CC{n}NP (n=1..4), [15] MOE, [2n+6] OIS{n} (n=1..4), [14] ECE, [14] TDE, [14] AOE, [13] OIS3N, [13] COMDE, [4n-3] CC{n}P (n=1..4), [13] BKP, [13:12] ETPS, [n+8] CC{n}DE (n=1..4), [n+8] CC{n}OF (n=1..4), [14:12] OC2M, [14:12] OC4M, [4n-4] CC{n}E (n=1..4), [12] BKE, [11] OIS2N, [11] OC2PE, [11] OC4PE, [11] OSSR, [10] OC2FE, [10] OC4FE, [10] CC3NE, [10] OSSI, [11:10] ITR1_RMP, [9] OIS1N, [9:8] CKD, [11:8] ETF, [8] UDE, [9:8] CC2S, [9:8] CC4S, [9:8] LOCK, [12:8] DBL, [7] ARPE, [7] TI1S, [7] MSM, [7] BIE, [7] BIF, [7] BG, [7] OC1CE, [7] OC3CE, [6] TIE, [6] TIF, [6] TG, [6] CC2NE, [7:6] TI4_RMP, [6:5] CMS, [5] COMIE, [5] COMIF, [5] COMG, [4] DIR, [6:4] MMS, [6:4] TS, [n] CC{n}IE (n=1..4), [n] CC{n}IF (n=1..4), [n] CC{n}G (n=1..4), [6:4] OC1M, [6:4] OC3M, [3] OPM, [3] CCDS, [3] OC1PE, [3] OC3PE, [2] URS, [2] CCUS, [2] OC1FE, [2] OC3FE, [2] CC1NE, [1] UDIS, [0] CEN, [0] CCPC, [2:0] SMS, [0] UIE, [0] UIF, [0] UG, [1:0] CC1S, [1:0] CC3S, [31:0] CNT, [15:0] PSC, [31:0] ARR, [7:0] REP, [15:0] CCR{n} (n=1..4), [7:0] DTG, [4:0] DBA, [15:0] DMAB, [1:0] TI1_RMP
0x04 CR2
0x08 SMCR
0x0C DIER
0x10 SR
0x14 EGR
0x18 CCMR1
0x1C CCMR2
0x20 CCER
0x24 CNT
0x28 PSC
0x2C ARR
0x30 RCR
{0x30+4i} CCR{i} (i=1..4)
0x44 BDTR
0x48 DCR
0x4C DMAR
0x50 OR

## LPTIM1
Base 0x40002400
0x00 ISR
  [24] ENC, [23] COUNTMODE, [22] PRELOAD, [21] WAVPOL, [20] WAVE, [19] TIMOUT, [18:17] TRIGEN, [15:13] TRIGSEL, [11:9] PRESC, [6] DOWN, [6] DOWNCF, [6] DOWNIE, [7:6] TRGFLT, [5] UP, [5] UPCF, [5] UPIE, [4] ARROK, [4] ARROKCF, [4] ARROKIE, [4] TIM9_ITR1_RMP, [3] CMPOK, [3] CMPOKCF, [3] CMPOKIE, [4:3] CKFLT, [3] TIM5_ITR1_RMP, [2] EXTTRIG, [2] EXTTRIGCF, [2] EXTTRIGIE, [2] CNTSTRT, [2] TIM1_ITR2_RMP, [1] ARRM, [1] ARRMCF, [1] ARRMIE, [2:1] CKPOL, [1] SNGSTRT, [0] CMPM, [0] CMPMCF, [0] CMPMIE, [0] CKSEL, [0] ENABLE, [15:0] CMP, [15:0] ARR, [15:0] CNT, [1:0] LPT_IN1_RMP
0x04 ICR
0x08 IER
0x0C CFGR
0x10 CR
0x14 CMP
0x18 ARR
0x1C CNT
0x20 OR
