# STM32F423xx register map
File version: 1.0
Registers are 32-bit, access not given, reset 0x0 unless marked. A register's access mark holds for its fields unless they carry their own. Offsets are from the block's base; [hi:lo] are bit positions; {n}, {i} and the like mark numbered series.

## RTC
Base 0x40002800
0x00 TR
  [31] MSK4, [31] MSK4, [31] ADD1S, [30] WDSEL, [30] WDSEL, [29:28] DT, [29:28] DT, [27:24] DU, [27:24] DU, [27:24] MASKSS, [27:24] MASKSS, [23] COE, [23] MSK3, [23] MSK3, [22] PM, [22] PM, [22] PM, [22] PM, [22:21] OSEL, [21:20] HT, [23:20] YT, [20] POL, [21:20] HT, [21:20] HT, [21:20] HT, [19] COSEL, [18] BKP, [18] ALARMOUTTYPE, [17] SUB1H, [17] TSINSEL, [19:16] HU, [19:16] YU, [16] ADD1H, [16] RECALPF, [22:16] PREDIV_A, [19:16] HU, [19:16] HU, [19:16] HU, [16] TAMP1INSEL, [15] TSIE, [15] MSK2, [15] MSK2, [15] CALP, [15] TAMPPUDIS, [14] WUTIE, [14] TAMP2F, [14] CALW8, [15:13] WDU, [13] ALRBIE, [13] TAMP1F, [15:13] WDU, [13] CALW16, [14:13] TAMPPRCH, [14:12] MNT, [12] MT, [12] ALRAIE, [12] TSOVF, [14:12] MNT, [14:12] MNT, [14:12] MNT, [12] MT, [11] TSE, [11] TSF, [12:11] TAMPFLT, [10] WUTE, [10] WUTF, [9] ALRBE, [9] ALRBF, [11:8] MNU, [11:8] MU, [8] ALRAE, [8] ALRAF, [11:8] MNU, [11:8] MNU, [11:8] MNU, [11:8] MU, [10:8] TAMPFREQ, [7] DCE, [7] INIT, [7] DCS, [7] MSK1, [7] MSK1, [7] TAMPTS, [6] FMT, [6] INITF, [5] BYPSHAD, [5] RSF, [6:4] ST, [5:4] DT, [4] REFCKON, [4] INITS, [6:4] ST, [6:4] ST, [6:4] ST, [5:4] DT, [4] TAMP2TRG, [3] TSEDGE, [3] SHPF, [3] TAMP2E, [2] WUTWF, [2] TAMPIE, [1] ALRBWF, [1] TAMP1TRG, [3:0] SU, [3:0] DU, [2:0] WUCKSEL, [0] ALRAWF, [14:0] PREDIV_S, [15:0] WUT, [4:0] DC, [3:0] SU, [3:0] SU, [7:0] KEY, [15:0] SS, [14:0] SUBFS, [3:0] SU, [3:0] DU, [15:0] SS, [8:0] CALM, [0] TAMP1E, [14:0] SS, [14:0] SS
0x04 DR
0x08 CR
0x0C ISR
0x10 PRER
0x14 WUTR
0x18 CALIBR
0x1C ALRMAR
0x20 ALRMBR
0x24 WPR
0x28 SSR
0x2C SHIFTR
0x30 TSTR
0x34 TSDR
0x38 TSSSR
0x3C CALR
0x40 TAFCR
0x44 ALRMASSR
0x48 ALRMBSSR
{0x50+4i} BKP{i}R (i=0..19)

## WWDG
Base 0x40002C00
0x00 CR
  [9] EWI, [7] WDGA, [8:7] WDGTB, [6:0] T, [6:0] W, [0] EWIF
0x04 CFR
0x08 SR

## IWDG
Base 0x40003000
0x00 KR
  [1] RVU, [15:0] KEY, [2:0] PR, [11:0] RL, [0] PVU
0x04 PR
0x08 RLR
0x0C SR

## I2S2ext
Base 0x40003400
Same registers: SPI2 0x40003800, SPI3 0x40003C00, I2S3ext 0x40004000, SPI1 0x40013000, SPI4 0x40013400, SPI5 0x40015000
0x00 CR1
  [15] BIDIMODE, [14] BIDIOE, [13] CRCEN, [12] CRCNEXT, [12] ASTRTEN, [11] DFF, [11] I2SMOD, [10] RXONLY, [10] I2SE, [9] SSM, [9] MCKOE, [8] SSI, [8] FRE, [9:8] I2SCFG, [8] ODD, [7] LSBFIRST, [7] TXEIE, [7] BSY, [7] PCMSYNC, [6] SPE, [6] RXNEIE, [6] OVR, [5] ERRIE, [5] MODF, [4] FRF, [4] CRCERR, [5:4] I2SSTD, [5:3] BR, [3] UDR, [3] CKPOL, [2] MSTR, [2] SSOE, [2] CHSIDE, [1] CPOL, [1] TXDMAEN, [1] TXE, [2:1] DATLEN, [0] CPHA, [0] RXDMAEN, [0] RXNE, [15:0] DR, [15:0] CRCPOLY, [15:0] RXCRC, [15:0] TXCRC, [0] CHLEN, [7:0] I2SDIV
0x04 CR2
0x08 SR
0x0C DR
0x10 CRCPR
0x14 RXCRCR
0x18 TXCRCR
0x1C I2SCFGR
0x20 I2SPR

## USART2
Base 0x40004400
Same registers: USART3 0x40004800, UART4 0x40004C00, UART5 0x40005000, UART7 0x40007800, UART8 0x40007C00, USART1 0x40011000, USART6 0x40011400, UART9 0x40011800, UART10 0x40011C00
0x00 SR
  [15] OVER8, [14] LINEN, [13] UE, [12] M, [13:12] STOP, [11] WAKE, [11] CLKEN, [11] ONEBIT, [10] PCE, [10] CPOL, [10] CTSIE, [9] CTS, [9] PS, [9] CPHA, [9] CTSE, [8] LBD, [8] PEIE, [8] LBCL, [8] RTSE, [15:8] GT, [7] TXE, [7] TXEIE, [7] DMAT, [6] TC, [6] TCIE, [6] LBDIE, [6] DMAR, [5] RXNE, [5] RXNEIE, [5] LBDL, [5] SCEN, [4] IDLE, [15:4] DIV_Mantissa, [4] IDLEIE, [4] NACK, [3] ORE, [3] TE, [3] HDSEL, [2] NE, [2] RE, [2] IRLP, [1] FE, [1] RWU, [1] IREN, [0] PE, [8:0] DR, [3:0] DIV_Fraction, [0] SBK, [3:0] ADD, [0] EIE, [7:0] PSC
0x04 DR
0x08 BRR
{0x8+4i} CR{i} (i=1..3)
0x18 GTPR

## I2C1
Base 0x40005400
Same registers: I2C2 0x40005800, I2C3 0x40005C00
0x00 CR1
  [15] SWRST, [15] ADDMODE, [15] SMBALERT, [15] FS, [14] TIMEOUT, [14] DUTY, [13] ALERT, [12] PEC, [12] LAST, [12] PECERR, [11] POS, [11] DMAEN, [11] OVR, [10] ACK, [10] ITBUFEN, [10] AF, [9] STOP, [9] ITEVTEN, [n] ADD{n} (n=0..9), [9] ARLO, [8] START, [8] ITERREN, [8] BERR, [15:8] PEC, [7] NOSTRETCH, [7] TXE, [7] DUALF, [6] ENGC, [6] RXNE, [6] SMBHOST, [5] ENPEC, [5] SMBDEFAULT, [4] ENARP, [4] STOPF, [4] GENCALL, [4] ANOFF, [3] SMBTYPE, [3] ADD10, [2] BTF, [2] TRA, [1] SMBUS, [7:1] ADD2, [1] ADDR, [1] BUSY, [0] PE, [5:0] FREQ, [0] ENDUAL, [7:0] DR, [0] SB, [0] MSL, [11:0] CCR, [5:0] TRISE, [3:0] DNF
0x04 CR2
0x08 OAR1
0x0C OAR2
0x10 DR
0x14 SR1
0x18 SR2
0x1C CCR
0x20 TRISE
0x24 FLTR
