# STM32F423xx register map
File version: 1.0
Registers are 32-bit, access not given, reset 0x0 unless marked. A register's access mark holds for its fields unless they carry their own. Offsets are from the block's base; [hi:lo] are bit positions; {n}, {i} and the like mark numbered series.

## DFSDM1
Base 0x40016000
Same registers: DFSDM2 0x40016400
0x00 CHCFGR10
  [31] DFSDMEN, [31] DFSDMEN, [31] DFSDMEN, [31] DFSDMEN, [31] DFSDMEN, [31] DFSDMEN, [31] DFSDMEN, [31] DFSDMEN, [31] DFSDMEN, [31] DFSDMEN, [31] DFSDMEN, [31] DFSDMEN, [31] DFSDMEN, [31] DFSDMEN, [31] DFSDMEN, [31] DFSDMEN, [31] DFSDMEN, [31] DFSDMEN, [30] CKOUTSRC, [30] CKOUTSRC, [30] CKOUTSRC, [30] CKOUTSRC, [30] CKOUTSRC, [30] CKOUTSRC, [30] CKOUTSRC, [30] CKOUTSRC, [30] CKOUTSRC, [30] CKOUTSRC, [30] CKOUTSRC, [30] CKOUTSRC, [30] CKOUTSRC, [30] CKOUTSRC, [30] CKOUTSRC, [30] CKOUTSRC, [30] CKOUTSRC, [30] CKOUTSRC, [23:22] AWFORD, [23:22] AWFORD, [23:22] AWFORD, [23:22] AWFORD, [23:22] AWFORD, [23:22] AWFORD, [23:22] AWFORD, [23:22] AWFORD, [23:22] AWFORD, [23:22] AWFORD, [23:22] AWFORD, [23:22] AWFORD, [23:22] AWFORD, [23:22] AWFORD, [23:22] AWFORD, [23:22] AWFORD, [23:22] AWFORD, [23:22] AWFORD, [23:16] CKOUTDIV, [20:16] AWFOSR, [23:16] CKOUTDIV, [23:16] CKOUTDIV, [31:16] INDAT1, [20:16] AWFOSR, [20:16] AWFOSR, [23:16] CKOUTDIV, [23:16] CKOUTDIV, [31:16] INDAT1, [31:16] INDAT1, [20:16] AWFOSR, [20:16] AWFOSR, [23:16] CKOUTDIV, [23:16] CKOUTDIV, [31:16] INDAT1, [31:16] INDAT1, [20:16] AWFOSR, [20:16] AWFOSR, [23:16] CKOUTDIV, [31:16] INDAT1, [31:16] INDAT1, [20:16] AWFOSR, [23:16] CKOUTDIV, [31:16] INDAT1, [20:16] AWFOSR, [23:16] CKOUTDIV, [31:16] INDAT1, [20:16] AWFOSR, [23:16] CKOUTDIV, [31:16] INDAT1, [20:16] AWFOSR, [23:16] CKOUTDIV, [23:16] CKOUTDIV, [31:16] INDAT1, [20:16] AWFOSR, [20:16] AWFOSR, [31:16] INDAT1, [31:16] INDAT1, [23:16] CKOUTDIV, [23:16] CKOUTDIV, [20:16] AWFOSR, [20:16] AWFOSR, [31:16] INDAT1, [31:16] INDAT1, [23:16] CKOUTDIV, [20:16] AWFOSR, [31:16] INDAT1, [23:16] CKOUTDIV, [20:16] AWFOSR, [31:16] INDAT1, [23:16] CKOUTDIV, [20:16] AWFOSR, [31:16] INDAT1, [15:14] DATPACK, [15:14] DATPACK, [15:14] DATPACK, [15:14] DATPACK, [15:14] DATPACK, [15:14] DATPACK, [15:14] DATPACK, [15:14] DATPACK, [15:14] DATPACK, [15:14] DATPACK, [15:14] DATPACK, [15:14] DATPACK, [15:14] DATPACK, [15:14] DATPACK, [15:14] DATPACK, [15:14] DATPACK, [15:14] DATPACK, [15:14] DATPACK, [13:12] DATMPX, [15:12] BKSCD, [13:12] DATMPX, [13:12] DATMPX, [15:12] BKSCD, [15:12] BKSCD, [13:12] DATMPX, [13:12] DATMPX, [15:12] BKSCD, [15:12] BKSCD, [13:12] DATMPX, [13:12] DATMPX, [15:12] BKSCD, [15:12] BKSCD, [13:12] DATMPX, [15:12] BKSCD, [13:12] DATMPX, [15:12] BKSCD, [13:12] DATMPX, [15:12] BKSCD, [13:12] DATMPX, [15:12] BKSCD, [13:12] DATMPX, [13:12] DATMPX, [15:12] BKSCD, [15:12] BKSCD, [13:12] DATMPX, [13:12] DATMPX, [15:12] BKSCD, [15:12] BKSCD, [13:12] DATMPX, [15:12] BKSCD, [13:12] DATMPX, [15:12] BKSCD, [13:12] DATMPX, [15:12] BKSCD, [8] CHINSEL, [31:8] OFFSET, [8] CHINSEL, [8] CHINSEL, [31:8] OFFSET, [31:8] OFFSET, [8] CHINSEL, [8] CHINSEL, [31:8] OFFSET, [31:8] OFFSET, [8] CHINSEL, [8] CHINSEL, [31:8] OFFSET, [31:8] OFFSET, [8] CHINSEL, [31:8] OFFSET, [8] CHINSEL, [31:8] OFFSET, [8] CHINSEL, [31:8] OFFSET, [8] CHINSEL, [31:8] OFFSET, [8] CHINSEL, [8] CHINSEL, [31:8] OFFSET, [31:8] OFFSET, [8] CHINSEL, [8] CHINSEL, [31:8] OFFSET, [31:8] OFFSET, [8] CHINSEL, [31:8] OFFSET, [8] CHINSEL, [31:8] OFFSET, [8] CHINSEL, [31:8] OFFSET, [7] CHEN, [7] CHEN, [7] CHEN, [7] CHEN, [7] CHEN, [7] CHEN, [7] CHEN, [7] CHEN, [7] CHEN, [7] CHEN, [7] CHEN, [7] CHEN, [7] CHEN, [7] CHEN, [7] CHEN, [7] CHEN, [7] CHEN, [7] CHEN, [6] CKABEN, [6] CKABEN, [6] CKABEN, [6] CKABEN, [6] CKABEN, [6] CKABEN, [6] CKABEN, [6] CKABEN, [6] CKABEN, [6] CKABEN, [6] CKABEN, [6] CKABEN, [6] CKABEN, [6] CKABEN, [6] CKABEN, [6] CKABEN, [6] CKABEN, [6] CKABEN, [5] SCDEN, [5] SCDEN, [5] SCDEN, [5] SCDEN, [5] SCDEN, [5] SCDEN, [5] SCDEN, [5] SCDEN, [5] SCDEN, [5] SCDEN, [5] SCDEN, [5] SCDEN, [5] SCDEN, [5] SCDEN, [5] SCDEN, [5] SCDEN, [5] SCDEN, [5] SCDEN, [7:3] DTRBS, [7:3] DTRBS, [7:3] DTRBS, [7:3] DTRBS, [7:3] DTRBS, [7:3] DTRBS, [7:3] DTRBS, [7:3] DTRBS, [7:3] DTRBS, [7:3] DTRBS, [7:3] DTRBS, [7:3] DTRBS, [7:3] DTRBS, [7:3] DTRBS, [7:3] DTRBS, [7:3] DTRBS, [7:3] DTRBS, [7:3] DTRBS, [3:2] SPICKSEL, [3:2] SPICKSEL, [3:2] SPICKSEL, [3:2] SPICKSEL, [3:2] SPICKSEL, [3:2] SPICKSEL, [3:2] SPICKSEL, [3:2] SPICKSEL, [3:2] SPICKSEL, [3:2] SPICKSEL, [3:2] SPICKSEL, [3:2] SPICKSEL, [3:2] SPICKSEL, [3:2] SPICKSEL, [3:2] SPICKSEL, [3:2] SPICKSEL, [3:2] SPICKSEL, [3:2] SPICKSEL, [1:0] SITP, [7:0] SCDT, [1:0] SITP, [1:0] SITP, [15:0] INDAT0, [7:0] SCDT, [7:0] SCDT, [1:0] SITP, [1:0] SITP, [15:0] INDAT0, [15:0] INDAT0, [7:0] SCDT, [7:0] SCDT, [1:0] SITP, [1:0] SITP, [15:0] INDAT0, [15:0] INDAT0, [7:0] SCDT, [7:0] SCDT, [1:0] SITP, [15:0] INDAT0, [15:0] INDAT0, [7:0] SCDT, [1:0] SITP, [15:0] INDAT0, [7:0] SCDT, [1:0] SITP, [15:0] INDAT0, [7:0] SCDT, [1:0] SITP, [15:0] INDAT0, [7:0] SCDT, [1:0] SITP, [1:0] SITP, [15:0] INDAT0, [7:0] SCDT, [7:0] SCDT, [15:0] INDAT0, [15:0] INDAT0, [1:0] SITP, [1:0] SITP, [7:0] SCDT, [7:0] SCDT, [15:0] INDAT0, [15:0] INDAT0, [1:0] SITP, [7:0] SCDT, [15:0] INDAT0, [1:0] SITP, [7:0] SCDT, [15:0] INDAT0, [1:0] SITP, [7:0] SCDT, [15:0] INDAT0
0x04 CHCFGR20
0x0C CHAWSCDR0
0x18 CHWDATAR0
0x20 CHCFGR11
0x24 CHCFGR21
0x28 CHDATINR0
0x2C CHAWSCDR1
0x38 CHWDATAR1
0x40 CHCFGR12
0x44 CHCFGR22
0x48 CHDATINR1
0x4C CHAWSCDR2
0x58 CHWDATAR2
0x60 CHCFGR13
0x64 CHCFGR23
0x68 CHDATINR2
0x6C CHAWSCDR3
0x78 CHWDATAR3
0x80 CHCFGR14
0x84 CHCFGR24
0x88 CHDATINR3
{0xC+0x20*i} CHAWSCDR{i} (i=4..7)
{0x18+0x20*i} CHWDATAR{i} (i=4..7)
0xA0 CHCFGR15
0xA4 CHCFGR25
{0x28+0x20*i} CHDATINR{i} (i=4..7)
0xC0 CHCFGR16
0xC4 CHCFGR26
0xE0 CHCFGR17
0xE4 CHCFGR27
0x100 CHCFGR10
0x104 CHCFGR20
0x10C CHAWSCDR0
0x118 CHWDATAR0
0x128 CHDATINR0
0x180 CHCFGR11
0x184 CHCFGR21
0x18C CHAWSCDR1
0x198 CHWDATAR1
0x1A8 CHDATINR1
0x200 CHCFGR12
0x204 CHCFGR22
0x20C CHAWSCDR2
0x218 CHWDATAR2
0x228 CHDATINR2
0x280 CHCFGR13
0x284 CHCFGR23
0x28C CHAWSCDR3
0x298 CHWDATAR3
0x2A8 CHDATINR3
0x400 CHCFGR10
0x404 CHCFGR20
0x40C CHAWSCDR0
0x418 CHWDATAR0
0x428 CHDATINR0
