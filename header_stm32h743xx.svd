# STM32H743xx register map
File version: 1.0
Registers are 32-bit, access not given, reset 0x0 unless marked. A register's access mark holds for its fields unless they carry their own. Offsets are from the block's base; [hi:lo] are bit positions; {n}, {i} and the like mark numbered series.

## ETH
Base 0x40028000
0x00 MACCR
  [31] ARP, [31] RA, [31] EIVLRXS, [31] RWKFILTRST, [31] AE, [31] AE, [31] AE, [31] AE, [31] ADDSUB, [31] TXTSSMIS, [31] TRGTBUSY0, [31] RPF, [30] ACTPHYSEL_RMII, [30] SA, [30] SA, [30] SA, [30:29] SARC_INSADDR1, [29] EIVLS_STRIPIFFAILS, [30:28] SARC_REPADDR1, [28] EIVLS_STRIPIFPASS, [30:28] ACTPHYSEL_REVMII, [30:28] AUXSNAPNUM, [27] IPC, [27] ERIVLT, [27] SAVLANINS, [30:27] L3L4FNUM, [27] PSE, [27] RXLPITRCIS, [27] TXLPITRCIS, [27] RXLPITRCIM, [27] TXLPITRCIM, [27] MISCNTOVF, [26] EDVLP, [26] TSSTSSEL_EXTERNAL, [26] BTB, [26] RXLPIUSCIS, [26] TXLPIUSCIS, [26] RXLPIUSCIM, [26] TXLPIUSCIM, [29:25] EIPG, [25] VTHM, [25] TSSTSSEL_INTERNAL, [29:25] ATSNS, [26:24] IPG, [24] EIPGEN, [24] EVLRXS, [28:24] RWKPTR, [24] MACADR64SEL, [25:24] HASHTBLSZ, [26:24] PPSOUTNUM, [29:24] MBC, [29:24] MBC, [29:24] MBC, [24] TXTSSTSM, [24] ATSSTM, [31:24] LMPDRI, [24] RXOIE, [23] GPSLCE, [23] MACADR32SEL, [22] S2KP, [22] EVLS_STRIPIFFAILS, [21] CST, [21] DNTU, [21] EVLS_STRIPIFPASS, [21] LPITCSE, [25:21] PA, [21] TXGPKTIS, [21] TXGPKTIM, [20] ACS, [20] IPFE, [20] DOVLTC, [20] VLTI, [20] VLTI, [20] LPITE, [20] AVSEL, [22:20] STXSTSF, [22:20] RQS, [19] WD, [19] ERSVLM, [19] CSVL, [19] CSVL, [19] LPITXA, [19] DBGMEMA, [19] CSC, [21:19] REB, [18] USP, [18] ESVL, [18] VLP, [18] VLP, [18] TFCSTS_GENERATEPCP, [22:18] ADDMACADRSEL, [18] TSOEN, [21:18] TXCHCNT, [18] TSENMACADDR, [20:18] DSL, [17] JD, [17] SPEN, [17] VTIM, [17] VLC_VLANTAGINSERT, [17] VLC_VLANTAGINSERT, [17] PLS, [17] TFCSTS_WAIT, [17] SPHEN, [17] RXUCGPIS, [17] RXUCGPIM, [17] MACIS, [16] JE, [16] DCRCC, [16] VTFE, [16] ETV, [17:16] VLC_VLANTAGREPLACE, [17:16] VLC_VLANTAGREPLACE, [31:16] PT, [16] LPIEN, [25:16] LST, [16] TPESTS, [16] RXCOESEL, [16] DCBEN, [20:16] RDA, [31:16] RA, [17:16] SNAPTYPSEL, [19:16] ATSSTN, [16] MACIS, [18:16] PTXQ, [16] RXOVFIS, [26:16] MISPKTCNT, [29:16] PRXQ, [17:16] INTM, [16] MTLIS, [21:16] TPBL, [21:16] RPBL, [18:16] TEB, [15] TXMCOLGPIS, [15] TXMCOLGPIM, [15] TSMSTRENA, [15] TXTSSIS, [15] RB, [15] NIE, [15] NIS, [15] MFCO, [14] FES, [14] RXSTSIS, [14] RXSTSIE, [14] TXCOESEL, [15:14] ADDR64, [14] TXSCOLGPIS, [14] TXSCOLGPIM, [14] TSEVNTENA, [16:14] RFD, [14] MB, [14] TPS_TIMESTAMP_WR, [14] AIE, [14] AIS, [13] DM, [15:13] VL_UP, [15:13] VLT_UP, [15:13] VLT_UP, [13] TXSTSIS, [13] TXSTSIE, [13] EEESEL, [13] ADVTHWORD, [15:13] RXCHCNT, [13] TSIPV4ENA, [13] TPS_WAITING, [13] CDEE, [13] CDE, [12] LM, [12] VL_CFIDEI, [12] VLT_CFIDEI, [12] VLT_CFIDEI, [12] TSIS, [12] TSIE, [12] TSSEL, [12] PTOEN, [14:12] NTC, [12] TSIPV6ENA, [14:12] PR, [12] AAL, [13:12] TPS_READING, [12] TSE, [12] FBEE, [12] FBE, [11] ECRSFD, [11] OSTEN, [11] CR_DIV4AR, [11] TSIPENA, [11] UFCNTOVF, [11] OVFCNTOVF, [11] TXPR, [11] ERIE, [11] ERI, [10] DO, [10] HPF, [10] MMCTXIS, [10] RWKPFE, [11:10] CR_DIV12AR, [10] TSVER2ENA, [10] ETIE, [10] ETI, [9] DCRS, [9] SAF, [9] MMCRXIS, [9] GLBLUCAST, [9] RLPIST, [9] ARPOFFSEL, [11:9] CR_DIV8AR, [9] TSCTRLSSR, [9] CNTCLR, [9] RWTE, [9] RWT, [8] DR, [8] SAIF, [8] PWE, [8] MMCIS, [8] RWT, [8] TLPIST, [15:8] USERVER, [8] MMCSEL, [11:8] CR_DIV6AR, [8] UCDBC, [8] TSENALL, [15:8] DN, [10:8] DRSYNCR, [8] CNTPRST, [8] TXUIE, [10:8] RFA, [11:8] RPS, [8] RSE, [8] RPS, [7] PCF_FORWARDALL, [7] DZPQ, [7] MGKSEL, [n+4] ATSEN{n} (n=0..3), [7] EHFC, [7] RBUE, [7] RBU, [7:6] PCF_FORWARDPASSEDADDRFILTER, [6] PLT_MINUS256, [6] RWKPRCVD, [6] RWKSEL, [10:6] TXFIFOSIZE, [9:6] TXQCNT, [6] RXALGNERPIS, [6] RXALGNERPIM, [6] DRRDIS, [6] DISTCPEF, [6] RIE, [6] RI, [6:5] BL, [5] DBF, [5] PLT_MINUS36, [5] LPIIS, [5] LPIIE, [5] EXCOL, [5] MGKPRCVD, [5] SMASEL, [5] CNTPRSTLVL, [5] RXCRCERPIS, [5] RXCRCERPIM, [5] TSADDREG, [6:5] TRGTMODSEL0, [5] APDREQTRIG, [5] TXSTSFSTS, [5] RSF, [5] RXQSTS_ABOVETHRESHOLD, [4] DC, [4] PM, [6:4] PLT_MINUS512, [4] PMTIS, [4] PMTIE, [4] LCOL, [4] VLHASH, [4] SKAP, [4] CNTPRST, [4] PPSEN0, [4] ASYNCTRIG, [6:4] TTC, [4] TXQSTS, [4] FEP, [5:4] RXQSTS_FULL, [4] OSP, [3] DAIF, [3] PHYIS, [3] PHYIE, [3] EXDEF, [3] RLPIEX, [3] PCSSEL, [3] MOC_PRDIA, [3] CNTFREEZ, [3] TSUPDT, [3] TSTRGTERR0, [3] TWCSTS, [3] FUP, [3:2] PRELEN, [2] HMC, [2] LCARR, [2] RWKPKTEN, [2] RLPIEN, [2] HDSEL, [2] MOC_WR, [2] RSTONRD, [2] TSINIT, [2] AUXTSTRIG, [2] APDREQEN, [2] RRCSTS_READINGSTATUS, [31:2] TDESLA, [31:2] RDESLA, [31:2] TDT, [31:2] RDT, [2] TBUE, [2] TBU, [1] TE, [1] HUC, [1] TFE, [1] UP, [1] NCARR, [1] MGKPKTEN, [1] TLPIEX, [2:1] RFCFCSTS, [1] GMIISEL, [1] C45E, [1] CNTSTOPRO, [1] TSCFUPDT, [1] TSTARGT0, [1] ASYNCEN, [1] DTXSTS, [1] TSF, [2:1] TRCSTS, [1] RRCSTS_READINGDATA, [1] DA, [14:1] RBSZ, [1] TXSE, [1] TPS, [0] RE, [13:0] GPSL, [0] PR, [3:0] WTO, [11:0] VL_VID, [15:0] VLHT, [11:0] VLT_VID, [11:0] VLT_VID, [0] FCB, [0] RFE, [0] TJT, [0] PWRDWN, [0] TLPIEN, [15:0] TWT, [19:0] LPIET, [11:0] TIC1USCNTR, [7:0] SNPSVER, [0] RPESTS, [0] MIISEL, [4:0] RXFIFOSIZE, [3:0] RXQCNT, [0] MB, [15:0] MD, [31:0] ARPPA, [15:0] ADDRHI, [31:0] ADDRLO, [15:0] ADDRHI, [31:0] ADDRLO, [15:0] ADDRHI, [31:0] ADDRLO, [15:0] ADDRHI, [31:0] ADDRLO, [0] CNTRST, [0] TSENA, [31:0] TSS, [30:0] TSSS, [31:0] TSS, [30:0] TSSS, [31:0] TSAR, [0] TSSOVF, [30:0] TXTSSLO, [31:0] TXTSSHI, [0] ATSFC, [30:0] AUXTSLO, [31:0] AUXTSHI, [31:0] OSTIAC, [31:0] OSTEAC, [31:0] TSIC, [31:0] TSEC, [3:0] PPSCTRL, [31:0] TSTRH0, [30:0] TTSL0, [31:0] PPSINT0, [31:0] PPSWIDTH0, [0] PTOEN, [31:0] SPI0, [31:0] SPI1, [15:0] SPI2, [7:0] LSI, [0] QIS, [0] FTQ, [10:0] UFPKTCNT, [0] TXQPAUSED, [0] TXUNFIS, [1:0] RTC, [10:0] OVFPKTCNT, [0] RWCSTS, [0] SWR, [0] FB, [0] DMACIS, [13:0] MSS, [0] ST, [0] SR, [9:0] TDRL, [9:0] RDRL, [0] TIE, [7:0] RWT, [31:0] CURTDESAPTR, [31:0] CURRDESAPTR, [31:0] CURTBUFAPTR, [31:0] CURRBUFAPTR, [0] TI, [10:0] MFC
0x04 MACECR
0x08 MACPFR
0x0C MACWTR
0x10 MACHT0R
0x14 MACHT1R
0x50 MACVTR
0x58 MACVHTR
0x60 MACVIR
0x64 MACIVIR
0x70 MACTFCR
0x90 MACRFCR
0xB0 MACISR
0xB4 MACIER
0xB8 MACRXTXSR
0xC0 MACPCSR
0xC4 MACRWKPFR
0xD0 MACLCSR
0xD4 MACLTCR
0xD8 MACLETR
0xDC MAC1USTCR
0x110 MACVR
0x114 MACDR
{0x11C+4i} MACHWF{i}R (i=0..2)
0x200 MACMDIOAR
0x204 MACMDIODR
0x210 MACARPAR
{0x300+8i} MACA{i}HR (i=0..3)
{0x304+8i} MACA{i}LR (i=0..3)
0x700 MMCCR
0x704 MMCRIR
0x708 MMCTIR
0x70C MMCRIMR
0x710 MMCTIMR
0x74C MMCTSCGPR
0x750 MMCTMCGPR
0x768 MMCTPCGR
0x794 MMCRCRCEPR
0x798 MMCRAEPR
0x7C4 MMCRUPGR
0x7EC MMCTLPIMSTR
0x7F0 MMCTLPITCR
0x7F4 MMCRLPIMSTR
0x7F8 MMCRLPITCR
0x900 MACL3L4C0R
0x904 MACL4A0R
{0x910+4i} MACL3A{i}R0R (i=0..3)
0x930 MACL3L4C1R
0x934 MACL4A1R
{0x940+4i} MACL3A{i}R1R (i=0..3)
0xB00 MACTSCR
0xB04 MACSSIR
0xB08 MACSTSR
0xB0C MACSTNR
0xB10 MACSTSUR
0xB14 MACSTNUR
0xB18 MACTSAR
0xB20 MACTSSR
0xB30 MACTTSSNR
0xB34 MACTTSSSR
0xB40 MACACR
0xB48 MACATSNR
0xB4C MACATSSR
0xB50 MACTSIACR
0xB54 MACTSEACR
0xB58 MACTSICNR
0xB5C MACTSECNR
0xB70 MACPPSCR
0xB80 MACPPSTTSR
0xB84 MACPPSTTNR
0xB88 MACPPSIR
0xB8C MACPPSWR
0xBC0 MACPOCR
{0xBC4+4i} MACSPI{i}R (i=0..2)
0xBD0 MACLMIR
0xC00 MTLOMR
0xC20 MTLISR
0xD00 MTLTQOMR
0xD04 MTLTQUR
0xD08 MTLTQDR
0xD2C MTLQICSR
0xD30 MTLRQOMR
0xD34 MTLRQMPOCR
0xD38 MTLRQDR
0x1000 DMAMR
0x1004 DMASBMR
0x1008 DMAISR
0x100C DMADSR
0x1100 DMACCR
0x1104 DMACTCR
0x1108 DMACRCR
0x1114 DMACTDLAR
0x111C DMACRDLAR
0x1120 DMACTDTPR
0x1128 DMACRDTPR
0x112C DMACTDRLR
0x1130 DMACRDRLR
0x1134 DMACIER
0x1138 DMACRIWTR
0x113C DMACSFCSR
0x1144 DMACCATDR
0x114C DMACCARDR
0x1154 DMACCATBR
0x115C DMACCARBR
0x1160 DMACSR
0x116C DMACMFCR
