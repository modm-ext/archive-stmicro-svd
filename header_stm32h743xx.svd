# STM32H743xx register map
File version: 1.0
Registers are 32-bit, access not given, reset 0x0 unless marked. A register's access mark holds for its fields unless they carry their own. Offsets are from the block's base; [hi:lo] are bit positions; {n}, {i} and the like mark numbered series.

## FMC_Bank5_6_R
Base 0x52004140
0x00 SDCR.0
  [27:24] TRCD, [27:24] TRCD, [23:20] TRP, [23:20] TRP, [19:16] TWR, [19:16] TWR, [14] REIE, [14:13] RPIPE, [14:13] RPIPE, [12] RBURST, [12] RBURST, [15:12] TRC, [15:12] TRC, [11:10] SDCLK, [11:10] SDCLK, [9] WP, [9] WP, [21:9] MRD, [11:8] TRAS, [11:8] TRAS, [8:7] CAS, [8:7] CAS, [6] NB, [6] NB, [8:5] NRFS, [5:4] MWID, [5:4] MWID, [7:4] TXSR, [7:4] TXSR, [4] CTB1, [3] CTB2, [4:3] MODES2, [3:2] NR, [3:2] NR, [13:1] COUNT, [2:1] MODES1, [1:0] NC, [1:0] NC, [3:0] TMRD, [3:0] TMRD, [2:0] MODE, [0] CRE, [0] RE
0x04 SDCR.1
0x08 SDTR.0
0x0C SDTR.1
0x10 SDCMR
0x14 SDRTR
0x18 SDSR

## QUADSPI
Base 0x52005000
0x00 CR
  [31] DDRM, [30] DHHC, [28] SIOO, [27:26] FMODE, [31:24] PRESCALER, [25:24] DMODE, [23] PMM, [22] APMS, [20] TOIE, [19] SMIE, [18] FTIE, [22:18] DCYC, [17] TCIE, [16] TEIE, [20:16] FSIZE, [17:16] ABSIZE, [15:14] ABMODE, [13:12] ADSIZE, [11:10] ADMODE, [11:8] FTHRES, [10:8] CSHT, [13:8] FLEVEL, [9:8] IMODE, [7] FSEL, [6] DFM, [5] BUSY, [4] SSHIFT, [4] TOF, [4] CTOF, [3] TCEN, [3] SMF, [3] CSMF, [2] DMAEN, [2] FTF, [1] ABORT, [1] TCF, [1] CTCF, [0] EN, [0] CKMODE, [0] TEF, [0] CTEF, [31:0] DL, [7:0] INSTRUCTION, [31:0] ADDRESS, [31:0] ALTERNATE, [31:0] DATA, [31:0] MASK, [31:0] MATCH, [15:0] INTERVAL, [15:0] TIMEOUT
0x04 DCR
0x08 SR
0x0C FCR
0x10 DLR
0x14 CCR
0x18 AR
0x1C ABR
0x20 DR
0x24 PSMKR
0x28 PSMAR
0x2C PIR
0x30 LPTR

## EXTI
Base 0x58000000
0x00 RTSR1
  [n] IM{n} (n=0..31), [n] EM{n} (n=20..31), [n-32] IM{n} (n=46..63), [n-32] EM{n} (n=46..63), [2n+1:2n] PCS{n} (n=0..15), [24] MR25, [n-64] IM{n} (n=84..87), [n-64] EM{n} (n=84..87), [22] TR86, [22] TR86, [22] SWIER86, [22] PR86, [21] TR21, [21] TR21, [n] SWIER{n} (n=0..21), [21] MR21, [n-32] MR{n} (n=48..53), [21] TR85, [21] TR85, [21] SWIER85, [n] PR{n} (n=0..21), [21] PR85, [20] TR20, [20] TR20, [20] MR20, [20] TR84, [20] TR84, [20] SWIER84, [20] PR84, [19] TR19, [19] TR19, [19] MR19, [19] TR51, [19] TR51, [19] SWIER51, [19] PR51, [18] TR18, [18] TR18, [19:18] PCS25, [19:18] PCS41, [18] TR82, [18] TR82, [18] SWIER82, [n] EM{n} (n=0..18), [18] IM82, [n-64] EM{n} (n=64..82), [18] PR82, [17] TR17, [17] TR17, [17] TR49, [17] TR49, [17] SWIER49, [17] PR49, [16] TR16, [16] TR16, [n-64] IM{n} (n=64..80), [15] TR15, [15] TR15, [n] MR{n} (n=0..15), [14] TR14, [14] TR14, [13] TR13, [13] TR13, [12] TR12, [12] TR12, [n-32] IM{n} (n=32..44), [n-32] EM{n} (n=32..44), [11] TR11, [11] TR11, [10] TR10, [10] TR10, [11:10] PCS21, [2n-95:2n-96] PCS{n} (n=48..53), [9] TR9, [9] TR9, [9] MR41, [8] TR8, [8] TR8, [9:8] PCS20, [7] TR7, [7] TR7, [6] TR6, [6] TR6, [7:6] PCS19, [7:6] PCS35, [5] TR5, [5] TR5, [4] TR4, [4] TR4, [5:4] PCS34, [3] TR3, [3] TR3, [3] MR35, [2] TR2, [2] TR2, [2] MR34, [1] TR1, [1] TR1, [0] TR0, [0] TR0
0x04 FTSR1
0x08 SWIER1
0x0C D3PMR1
0x10 D3PCR1L
0x14 D3PCR1H
0x20 RTSR2
0x24 FTSR2
0x28 SWIER2
0x2C D3PMR2
0x30 D3PCR2L
0x34 D3PCR2H
0x40 RTSR3
0x44 FTSR3
0x48 SWIER3
0x4C D3PMR3
0x50 D3PCR3L
0x54 D3PCR3H
{0x70+0x10*i} IMR{i} (i=1..3)
{0x74+0x10*i} EMR{i} (i=1..3)
{0x78+0x10*i} PR{i} (i=1..3)

## EXTI_D1
Base 0x58000080
Same registers: EXTI_D2 0x580000C0
0x00 IMR1
  [n] IM{n} (n=0..31), [n] EM{n} (n=20..31), [n-32] IM{n} (n=46..63), [n-32] EM{n} (n=46..63), [n-64] IM{n} (n=84..87), [n-64] EM{n} (n=84..87), [22] PR86, [n] PR{n} (n=0..21), [21] PR85, [20] PR84, [19] PR51, [n] EM{n} (n=0..18), [18] IM82, [n-64] EM{n} (n=64..82), [18] PR82, [17] PR49, [n-64] IM{n} (n=64..80), [n-32] IM{n} (n=32..44), [n-32] EM{n} (n=32..44)
0x04 EMR1
0x08 PR1
0x10 IMR2
0x14 EMR2
0x18 PR2
0x20 IMR3
0x24 EMR3
0x28 PR3

## SYSCFG
Base 0x58000400
0x04 PMCR
  [27] PC3SO, [26] PC2SO, [25] PA1SO, [24] PA0SO, [23:21] EPIS_SEL, [16] HSLV, [23:16] RDP, [31:16] BOOT_ADD0, [16] MEPAD_BANK1, [23:16] WRPN_BANK1, [27:16] PAEND_BANK1, [27:16] SAEND_BANK1, [16] MESAD_BANK2, [27:16] PABEG_BANK2, [27:16] SABEG_BANK2, [16] IWDG1M, [16] SECURE, [16] D1SBRST, [16] FZIWDGSTB, [16] PKP, [15] AXISRAML, [14] ITCML, [13] DTCML, [4n+3:4n] EXTI{n} (n=0..3), [4n-13:4n-16] EXTI{n} (n=4..7), [4n-29:4n-32] EXTI{n} (n=8..11), [4n-45:4n-48] EXTI{n} (n=12..15), [13-n] SRAM{n}L (n=1..4), [9] BOOSTVDDSEL, [8] BOOSTEN, [8] READY, [n-2] I2C_PB{n}_FMP (n=6..9), [7] BKRAML, [6] CM7L, [7:4] PCV, [7:4] PCC, [n-1] I2C{n}_FMP (n=1..4), [3] FLASHL, [2] PVDL, [1] CS, [0] EN, [3:0] NCV, [3:0] NCC, [0] ODEN, [3:0] PKG, [0] BKS, [1:0] BORH, [15:0] BOOT_ADD1, [0] MESAD_BANK1, [11:0] PABEG_BANK1, [11:0] SABEG_BANK1, [0] MEPAD_BANK2, [7:0] WRPN_BANK2, [11:0] PAEND_BANK2, [11:0] SAEND_BANK2, [1:0] SDRS, [0] D1STPRST, [0] FZIWDGSTP, [0] IOHSLV
0x08 EXTICR.0
0x0C EXTICR.1
0x10 EXTICR.2
0x14 EXTICR.3
0x18 CFGR
0x20 CCCSR
0x24 CCVR
0x28 CCCR
0x2C PWRCR
0x124 PKGR
{0x300+4i} UR{i} (i=0..17)
