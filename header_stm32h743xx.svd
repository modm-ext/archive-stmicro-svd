# STM32H743xx register map
File version: 1.0
Registers are 32-bit, access not given, reset 0x0 unless marked. A register's access mark holds for its fields unless they carry their own. Offsets are from the block's base; [hi:lo] are bit positions; {n}, {i} and the like mark numbered series.

## FDCAN_CCU
Base 0x4000A800
0x00 CREL
  [29] ARA, [29] ARAE, [31:28] REL, [28] PED, [28] PEDE, [27] PEA, [27] PEAE, [26] WDI, [26] WDIE, [25] BO, [25] BOE, [27:24] STEP, [24] EW, [24] EWE, [23] EP, [23] EPE, [22] ELO, [22] ELOE, [21] BEUE, [23:20] SUBSTEP, [20] BECE, [19] DRX, [19] DRXE, [18] TOO, [18] TOOE, [17] MRAF, [17] MRAFE, [19:16] YEAR, [16] TSW, [16] TSWE, [15] TEFL, [15] TEFLE, [14] TEFF, [14] TEFFE, [13] TEFW, [13] TEFWE, [12] TEFN, [12] TEFNE, [11] TFE, [11] TFEE, [10] TCF, [10] TCFE, [9] TC, [9] TCE, [15:8] MON, [8] HPM, [8] HPME, [7] RF1L, [7] RF1LE, [6] RF1F, [6] RF1FE, [5] RF1W, [5] RF1WE, [4] RF1N, [4] RF1NE, [3] RF0L, [3] RF0LE, [2] RF0F, [2] RF0FE, [1] RF0W, [1] RF0WE, [7:0] DAY, [0] RF0N, [0] RF0NE
0x04 CCFG
0x08 CSTAT
0x0C CWD
0x10 IR
0x14 IE

## SAI1
Base 0x40015800
Same registers: SAI2 0x40015C00, SAI3 0x40016000, SAI4 0x58005400
0x00 GCR
  [8n-2:8n-4] DLYM{n}R (n=1..4), [8n-6:8n-8] DLYM{n}L (n=1..4), [n+7] CKEN{n} (n=1..4), [5:4] SYNCOUT, [5:4] MICNBR, [1:0] SYNCIN, [0] PDMEN
0x04 CR1A
0x08 CR2A
0x10 FRCRA
0x1C SLOTRA
0x24 CR1B
0x28 CR2B
0x2C IMRA
0x30 FRCRB
0x3C SLOTRB
0x40 SRA
0x44 PDMCR
0x48 PDMDLY
0x4C IMRB
0x58 CLRFRA
0x60 SRB
0x74 DRA
0x78 CLRFRB
0x94 DRB

## HRTIM1_TIMA
Base 0x40017480
Same registers: HRTIM1_TIMB 0x40017500, HRTIM1_TIMC 0x40017580, HRTIM1_TIMD 0x40017600, HRTIM1_TIME 0x40017680
0x00 TIMxCR
0x04 TIMxISR
0x08 TIMxICR
0x0C TIMxDIER
0x10 CNTxR
0x14 PERxR
0x18 REPxR
0x1C CMP1xR
0x20 CMP1CxR
{0x1C+4i} CMP{i}xR (i=2..4)
0x30 CPT1xR
0x34 CPT2xR
0x38 DTxR
0x3C SETx1R
0x40 RSTx1R
0x44 SETx2R
0x48 RSTx2R
0x4C EEFxR1
0x50 EEFxR2
0x54 RSTxR
0x58 CHPxR
0x5C CPT1xCR
0x60 CPT2xCR
0x64 OUTxR
0x68 FLTxR

## HRTIM1_COMMON
Base 0x40017780
0x00 CR1
  [31] BMSTAT, [31] OCHPEV, [31] AD1TEPER, [31] AD2TERST, [31] AD3TEPER, [31] AD4TERST, [8n-1] FLT{n}LCK (n=1..4), [30] EEV8, [31:30] EEVSD, [30] AD{n}TEC4 (n=1..4), [29] EEV7, [6n-1] EE{n}FAST (n=1..5), [29] AD{n}TEC3 (n=1..4), [28] TDEEV8, [28] AD{n}TEC2 (n=1..4), [27] TAEEV7, [6n-2:6n-3] EE{n}SNS (n=1..5), [6n-32:6n-33] EE{n}SNS (n=6..10), [27] AD1TDPER, [27] AD2TDRST, [27] AD3TDPER, [27] AD4TDRST, [8n-2:8n-5] FLT{n}F (n=1..4), [26] TECMP2, [6n-4] EE{n}POL (n=1..5), [6n-34] EE{n}POL (n=6..10), [26] AD1TDC4, [26] AD2TDPER, [26] AD3TDC4, [26] AD4TDPER, [8n-6] FLT{n}SRC (n=1..4), [3n+15:3n+13] ADC{n}USRC (n=1..4), [25] TECMP1, [25] AD1TDC3, [25] AD2TDC4, [25] AD3TDC3, [25] AD4TDC4, [8n-7] FLT{n}P (n=1..4), [24] TEREP, [6n-5:6n-6] EE{n}SRC (n=1..5), [6n-35:6n-36] EE{n}SRC (n=6..10), [6n-33:6n-36] EE{n}F (n=6..10), [24] AD1TDC2, [24] AD2TDC3, [24] AD3TDC2, [24] AD4TDC3, [8n-8] FLT{n}E (n=1..4), [25:24] FLTSD, [23] TERST, [23] AD1TCPER, [23] AD2TDC2, [23] AD3TCPER, [23] AD4TDC2, [22] TDCMP2, [22] AD1TCC4, [22] AD2TCRST, [22] AD3TCC4, [22] AD4TCRST, [21] TEBM, [21] TDCMP1, [21] AD1TCC3, [21] AD2TCPER, [21] AD3TCC3, [21] AD4TCPER, [20] TDBM, [20] TDREP, [20] AD1TCC2, [20] AD2TCC4, [20] AD3TCC2, [20] AD4TCC4, [19] TCBM, [19] TDRST, [19] AD1TBRST, [19] AD2TCC3, [19] AD3TBRST, [19] AD4TCC3, [18] TBBM, [18] TCCMP2, [18] AD1TBPER, [18] AD2TCC2, [18] AD3TBPER, [18] AD4TCC2, [17] BMPER, [17] BMPERC, [17] BMPER, [17] TABM, [17] TCCMP1, [17] AD1TBC4, [17] AD2TBPER, [17] AD3TBC4, [17] AD4TBPER, [16] MTBM, [16] TCREP, [16] AD1TBC3, [16] AD2TBC4, [16] AD3TBC3, [16] AD4TBC4, [15] TCRST, [15] AD1TBC2, [15] AD2TBC3, [15] AD3TBC2, [15] AD4TBC3, [14] TBCMP2, [14] AD1TARST, [14] AD2TBC2, [14] AD3TARST, [14] AD4TBC2, [13] TERST, [13] TBCMP1, [13] AD{n}TAPER (n=1..4), [12] TDRST, [12] TBREP, [12] AD{n}TAC4 (n=1..4), [11] TCRST, [11] TBRST, [11] AD{n}TAC3 (n=1..4), [10] TBRST, [10] BMPREN, [10] TACMP2, [10] AD{n}TAC2 (n=1..4), [9] TARST, [9] TE2OEN, [9] TE2ODIS, [9] TE2ODS, [9] TACMP1, [n+4] AD1EEV{n} (n=1..5), [n-1] AD2EEV{n} (n=6..10), [n+4] AD3EEV{n} (n=1..5), [n-1] AD4EEV{n} (n=6..10), [n+5] MCMP{n} (n=1..4), [8] MRST, [8] TE1OEN, [8] TE1ODIS, [8] TE1ODS, [8] TAREP, [7] TD2OEN, [7] TD2ODIS, [7] TD2ODS, [7] TARST, [7] FLT5LCK, [6] TD1OEN, [6] TD1ODIS, [6] TD1ODS, [9:6] BMPRSC, [n+2] MSTCMP{n} (n=1..4), [5] TEUDIS, [5] TESWU, [5] SYSFLT, [5] SYSFLTC, [5] SYSFLT, [5] TC2OEN, [5] TC2ODIS, [5] TC2ODS, [5] MREP, [4] TDUDIS, [4] TDSWU, [4] FLT5, [n-1] FLT{n}C (n=1..5), [4] FLT5, [4] TC1OEN, [4] TC1ODIS, [4] TC1ODS, [4] AD{n}MPER (n=1..4), [4] MPER, [3] TCUDIS, [3] TCSWU, [3] FLT4, [3] FLT4, [3] TB2OEN, [3] TB2ODIS, [3] TB2ODS, [3] AD{n}MC4 (n=1..4), [6:3] FLT5F, [3] MCNT, [2] TBUDIS, [2] TBSWU, [2] FLT3, [2] FLT3, [2] TB1OEN, [2] TB1ODIS, [2] TB1ODS, [5:2] BMCLK, [2] MSTREP, [2] AD{n}MC3 (n=1..4), [2] FLT5SRC, [2] MDIER, [1] TAUDIS, [1] TASWU, [1] FLT2, [1] FLT2, [1] TA2OEN, [1] TA2ODIS, [1] TA2ODS, [1] BMOM, [1] MSTRST, [1] AD{n}MC2 (n=1..4), [1] FLT5P, [1] MICR, [0] MUDIS, [0] MSWU, [0] FLT1, [0] FLT1, [0] TA1OEN, [0] TA1ODIS, [0] TA1ODS, [0] BME, [0] SW, [15:0] BMCMPR, [15:0] BMPER, [0] AD{n}MC1 (n=1..4), [0] FLT5E, [0] MCR, [31:0] BDMADR
0x04 CR2
0x08 ISR
0x0C ICR
0x10 IER
0x14 OENR
0x18 ODISR
0x1C ODSR
0x20 BMCR
0x24 BMTRGR
0x28 BMCMPR
0x2C BMPER
{0x2C+4i} EECR{i} (i=1..3)
{0x38+4i} ADC{i}R (i=1..4)
0x50 FLTINR1
0x54 FLTINR2
0x58 BDMUPR
0x5C BDTAUPR
0x60 BDTBUPR
0x64 BDTCUPR
0x68 BDTDUPR
0x6C BDTEUPR
0x70 BDMADR
