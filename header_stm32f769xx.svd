# STM32F769xx register map
File version: 1.0
Registers are 32-bit, access not given, reset 0x0 unless marked. A register's access mark holds for its fields unless they carry their own. Offsets are from the block's base; [hi:lo] are bit positions; {n}, {i} and the like mark numbered series.

## RCC
Base 0x40023800
0x00 CR
  [31] UART8RST, [31] UART8EN, [31] UART8LPEN, [31] LPWRRSTF, [31] SSCGEN, [31:30] MCO2, [30] UART7RST, [30] MDIORST, [30] OTGHSULPIEN, [30] UART7EN, [30] MDIOEN, [30] OTGHSULPILPEN, [30] UART7LPEN, [30] MDIOLPEN, [30] WWDGRSTF, [30] SPREADSEL, [30] DSISEL, [29] PLLSAIRDY, [29] OTGHRST, [29] DACRST, [29] DFSDM1RST, [29] OTGHSEN, [29] DACEN, [29] DFSDM1EN, [29] OTGHSLPEN, [29] DACLPEN, [29] DFSDM1LPEN, [29] IWDGRSTF, [29] SDMMC2SEL, [28] PLLSAION, [30:28] PLLR, [28] PWRRST, [28] ETHMACPTPEN, [28] PWREN, [28] ETHMACPTPLPEN, [28] PWRLPEN, [28] SFTRSTF, [30:28] PLLI2SR, [30:28] PLLSAIR, [28] SDMMC1SEL, [27] PLLI2SRDY, [29:27] MCO2PRE, [27] CECRST, [27] DSIRST, [27] ETHMACRXEN, [27] CECEN, [27] DSIEN, [27] ETHMACRXLPEN, [27] CECLPEN, [27] DSILPEN, [27] PORRSTF, [27] CK48MSEL, [26] PLLI2SON, [26] CAN2RST, [26] LTDCRST, [26] ETHMACTXEN, [26] CAN2EN, [26] LTDCEN, [26] ETHMACTXLPEN, [26] CAN2LPEN, [26] LTDCLPEN, [26] PINRSTF, [26] ADFSDM1SEL, [26] CECSEL, [25] PLLRDY, [25] ETHMACRST, [25] CAN1RST, [25] ETHMACEN, [25] CAN1EN, [25] ETHMACLPEN, [25] CAN1LPEN, [25] BORRSTF, [25] DFSDM1SEL, [24] PLLON, [27:24] PLLQ, [26:24] MCO1PRE, [n+20] I2C{n}RST (n=1..4), [n+20] I2C{n}EN (n=1..4), [n+20] I2C{n}LPEN (n=1..4), [24] RMVF, [27:24] PLLI2SQ, [27:24] PLLSAIQ, [24] TIMPRE, [25:24] LPTIM1SEL, [23] I2SSRC, [23] CSSC, [23] DMA2DRST, [23] SAI2RST, [23] DMA2DEN, [23] SAI2EN, [23] DMA2DLPEN, [23] SAI2LPEN, [22] PLLSRC_HSE, [22] PLLSAIRDYC, [22] DMA2RST, [22] SAI1RST, [22] DMA2EN, [22] SAI1EN, [22] DMA2LPEN, [22] SAI1LPEN, [23:22] SAI2SEL, [2n+15:2n+14] I2C{n}SEL (n=1..4), [22:21] MCO1, [21] PLLI2SRDYC, [21] DMA1RST, [21] SPI6RST, [21] DMA1EN, [21] SPI6EN, [21] DMA1LPEN, [21] SPI6LPEN, [20] PLLRDYC, [20] UART5RST, [20] SPI5RST, [20] DTCMRAMEN, [20] UART5EN, [20] SPI5EN, [20] DTCMLPEN, [20] UART5LPEN, [20] SPI5LPEN, [21:20] SAI1SEL, [19] CSSON, [19] HSERDYC, [19] UART4RST, [19] UART4EN, [19] UART4LPEN, [18] HSEBYP, [18] HSIRDYC, [18] USART3RST, [18] TIM11RST, [18] BKPSRAMEN, [18] USART3EN, [18] TIM11EN, [18] BKPSRAMLPEN, [18] USART3LPEN, [18] TIM11LPEN, [17] HSERDY, [17] LSERDYC, [17] USART2RST, [17] TIM10RST, [17] USART2EN, [17] TIM10EN, [17] SRAM2LPEN, [17] USART2LPEN, [17] TIM10LPEN, [16] HSEON, [17:16] PLLP, [20:16] RTCPRE, [16] LSIRDYC, [16] SPDIFRXRST, [16] TIM9RST, [16] SPDIFRXEN, [16] TIM9EN, [16] SRAM1LPEN, [16] SPDIFRXLPEN, [16] TIM9LPEN, [16] BDRST, [17:16] PLLI2SP, [17:16] PLLSAIP, [17:16] PLLSAIDIVR, [15] SPI3RST, [15] SPI3EN, [15] FLITFLPEN, [15] SPI3LPEN, [15] RTCEN, [14] PLLSAIRDYIE, [14] SPI2RST, [14] SYSCFGRST, [14] SPI2EN, [14] SYSCFGEN, [14] SPI2LPEN, [14] SYSCFGLPEN, [15:14] UART8SEL, [15:13] PPRE2, [13] PLLI2SRDYIE, [13] CAN3RST, [13] SPI4RST, [13] CAN3EN, [13] SPI4EN, [13] AXILPEN, [13] CAN3LPEN, [13] SPI4LPEN, [27:13] INCSTEP, [12] PLLRDYIE, [12] CRCRST, [12] SPI1RST, [12] CRCEN, [12] SPI1EN, [12] CRCLPEN, [12] SPI1LPEN, [13:12] UART7SEL, [11] HSERDYIE, [11] WWDGRST, [11] SDMMC1RST, [11] WWDGEN, [11] SDMMC1EN, [11] WWDGLPEN, [11] SDMMC1LPEN, [12:10] PPRE1, [10] HSIRDYIE, [10] GPIOKRST, [10] GPIOKEN, [10] RTCEN, [10] ADC3EN, [10] GPIOKLPEN, [10] RTCLPEN, [10] ADC3LPEN, [11:10] USART6SEL, [9] LSERDYIE, [9] GPIOJRST, [9] LPTIM1RST, [9] GPIOJEN, [9] LPTIM1EN, [9] ADC2EN, [9] GPIOJLPEN, [9] LPTIM1LPEN, [9] ADC2LPEN, [15:8] HSICAL, [8] LSIRDYIE, [8] GPIOIRST, [8] TIM14RST, [8] ADCRST, [8] GPIOIEN, [8] TIM14EN, [8] ADC1EN, [8] GPIOILPEN, [8] TIM14LPEN, [8] ADC1LPEN, [9:8] RTCSEL, [12:8] PLLSAIDIVQ, [9:8] UART5SEL, [7] CSSF, [7] GPIOHRST, [7] OTGFSRST, [7] TIM13RST, [7] SDMMC2RST, [7] GPIOHEN, [7] OTGFSEN, [7] TIM13EN, [7] SDMMC2EN, [7] GPIOHLPEN, [7] OTGFSLPEN, [7] TIM13LPEN, [7] SDMMC2LPEN, [14:6] PLLN, [6] PLLSAIRDYF, [6] GPIOGRST, [6] RNGRST, [6] TIM12RST, [6] GPIOGEN, [6] RNGEN, [6] TIM12EN, [6] GPIOGLPEN, [6] RNGLPEN, [6] TIM12LPEN, [14:6] PLLI2SN, [14:6] PLLSAIN, [7:6] UART4SEL, [5] PLLI2SRDYF, [5] GPIOFRST, [n-2] TIM{n}RST (n=2..7), [5] USART6RST, [5] GPIOFEN, [n-2] TIM{n}EN (n=2..7), [5] USART6EN, [5] GPIOFLPEN, [n-2] TIM{n}LPEN (n=2..7), [5] USART6LPEN, [7:4] HPRE, [4] PLLRDYF, [4] GPIOERST, [4] USART1RST, [4] GPIOEEN, [4] USART1EN, [4] GPIOELPEN, [4] USART1LPEN, [5:4] USART3SEL, [7:3] HSITRIM, [3] HSERDYF, [3] GPIODRST, [3] GPIODEN, [3] GPIODLPEN, [4:3] LSEDRV, [3:2] SWS, [2] HSIRDYF, [2] GPIOCRST, [2] GPIOCEN, [2] GPIOCLPEN, [2] LSEBYP, [3:2] USART2SEL, [1] HSIRDY, [1] LSERDYF, [1] GPIOBRST, [1] JPEGRST, [1] QSPIRST, [1] TIM8RST, [1] GPIOBEN, [1] JPEGEN, [1] QSPIEN, [1] TIM8EN, [1] GPIOBLPEN, [1] JPEGLPEN, [1] QSPILPEN, [1] TIM8LPEN, [1] LSERDY, [1] LSIRDY, [0] HSION, [5:0] PLLM, [1:0] SW, [0] LSIRDYF, [0] GPIOARST, [0] DCMIRST, [0] FMCRST, [0] TIM1RST, [0] GPIOAEN, [0] DCMIEN, [0] FMCEN, [0] TIM1EN, [0] GPIOALPEN, [0] DCMILPEN, [0] FMCLPEN, [0] TIM1LPEN, [0] LSEON, [0] LSION, [12:0] MODPER, [4:0] PLLI2SDIVQ, [1:0] USART1SEL
0x04 PLLCFGR
0x08 CFGR
0x0C CIR
{0xC+4i} AHB{i}RSTR (i=1..3)
0x20 APB1RSTR
0x24 APB2RSTR
{0x2C+4i} AHB{i}ENR (i=1..3)
0x40 APB1ENR
0x44 APB2ENR
{0x4C+4i} AHB{i}LPENR (i=1..3)
0x60 APB1LPENR
0x64 APB2LPENR
0x70 BDCR
0x74 CSR
0x80 SSCGR
0x84 PLLI2SCFGR
0x88 PLLSAICFGR
0x8C DCKCFGR1
0x90 DCKCFGR2
