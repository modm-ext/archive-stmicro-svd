# STM32F769xx register map
File version: 1.0
Registers are 32-bit, access not given, reset 0x0 unless marked. A register's access mark holds for its fields unless they carry their own. Offsets are from the block's base; [hi:lo] are bit positions; {n}, {i} and the like mark numbered series.

## DSI
Base 0x40016C00
0x00 VR
0x04 CR
  [31] HS2LP_TIME7, [n+24] THSTRAIL{n} (n=0..7), [n+24] TLPXC{n} (n=0..7), [30] HS2LP_TIME6, [29] HS2LP_TIME5, [28] HS2LP_TIME4, [27] HS2LP_TIME3, [26] HS2LP_TIME2, [26] LPRXFT1, [25] HS2LP_TIME9, [25] HS2LP_TIME1, [25] LPRXFT0, [24] PGO, [24] MRDPS, [8n-1:8n-8] DATA{n} (n=1..4), [24] PM, [24] HS2LP_TIME8, [24] HS2LP_TIME0, [24] REGEN, [23] LPSIZE7, [n+16] WCMSB{n} (n=0..7), [23] HS2LP_TIME7, [23] LP2HS_TIME7, [23] LPSIZE7, [n+16] THSPREP{n} (n=0..7), [n+16] THSEXIT{n} (n=0..7), [22] LPSIZE6, [22] HS2LP_TIME6, [22] LP2HS_TIME6, [22] LPSIZE6, [22] FLPRXLPM, [21] LPSIZE5, [21] HS2LP_TIME5, [21] LP2HS_TIME5, [21] LPSIZE5, [20] LPSIZE4, [20] PGM, [20] HS2LP_TIME4, [20] LP2HS_TIME4, [20] LPSIZE4, [19] LPSIZE3, [19] DLWTX, [19] HS2LP_TIME3, [19] LP2HS_TIME3, [19] LPSIZE3, [19] HSTXSRCDL1, [18] LPSIZE2, [18] DSR0TX, [18] HS2LP_TIME2, [18] LP2HS_TIME2, [18] LPSIZE2, [18] HSTXSRCDL0, [17] LPSIZE1, [17] DSW1TX, [17] HS2LP_TIME1, [17] LP2HS_TIME1, [17] LPSIZE1, [17] HSTXSRCCL1, [17] PLL_ODF1, [16] LPSIZE0, [16] PGE, [16] DSW0TX, [16] S3DC, [16] HS2LP_TIME0, [16] LP2HS_TIME0, [16] LPSIZE0, [16] S3DC, [16] HSTXSRCCL0, [16] PLL_ODF0, [n+8] TOCKDIV{n} (n=0..7), [15] LPCE, [n] CMDSIZE{n} (n=0..15), [n+8] WCLSB{n} (n=0..7), [n] HSRD_TOCNT{n} (n=0..15), [n] LPRD_TOCNT{n} (n=0..15), [n] HSWR_TOCNT{n} (n=0..15), [n] LPWR_TOCNT{n} (n=0..15), [n] BTA_TOCNT{n} (n=0..15), [n+8] SW_TIME{n} (n=0..7), [15] LPCE, [15] LPRXVCDL1, [n+8] TCLKZERO{n} (n=0..7), [n+8] TLPXD{n} (n=0..7), [14] FBTAAE, [14] HLINE14, [14] GLWTX, [n] MRD_TIME{n} (n=0..14), [14] FBTAAE, [14] HLINE14, [14] LPRXVCDL0, [n+11] PLL_IDF{n} (n=0..3), [13] LPHFPE, [13] VPSIZE13, [13] HLINE13, [13] VA13, [13] GSR2TX, [13] LPHFE, [13] VPSIZE13, [13] HLINE13, [13] VA13, [13] RRIE, [13] RRIF, [13] CRRIF, [12] LPHBPE, [12] VPSIZE12, [12] NUMC12, [12] NPSIZE12, [12] HLINE12, [12] VA12, [12] GSR1TX, [12] GPRXE, [12] GPRXEIE, [12] FGPRXE, [12] LPHBPE, [12] VPSIZE12, [12] NUMC12, [12] NPSIZE12, [12] HLINE12, [12] VA12, [12] RRS, [12] SDDC, [11] LPVAE, [11] VPSIZE11, [11] NUMC11, [11] NPSIZE11, [11] HSA11, [11] HBP11, [11] HLINE11, [11] VA11, [11] GSR0TX, [11] GPRDE, [11] GPRDEIE, [11] FGPRDE, [11] LPVAE, [11] VPSIZE11, [11] NUMC11, [11] NPSIZE11, [11] HSA11, [11] HBP11, [11] HLINE11, [11] VA11, [10] LPVFPE, [10] VPSIZE10, [10] NUMC10, [10] NPSIZE10, [10] HSA10, [10] HBP10, [10] HLINE10, [10] VA10, [10] GSW2TX, [10] GPTXE, [10] GPTXEIE, [10] FGPTXE, [10] LPVFPE, [10] VPSIZE10, [10] NUMC10, [10] NPSIZE10, [10] HSA10, [10] HBP10, [10] HLINE10, [10] VA10, [10] PLLUIE, [10] PLLUIF, [10] CPLLUIF, [9] LPVBPE, [9] VPSIZE9, [9] NUMC9, [9] NPSIZE9, [9] HSA9, [9] HBP9, [9] HLINE9, [9] VSA9, [9] VBP9, [9] VFP9, [9] VA9, [9] GSW1TX, [9] LP2HS_TIME9, [9] GPWRE, [9] GPWREIE, [9] FGPWRE, [9] LPVBPE, [9] VPSIZE9, [9] NUMC9, [9] NPSIZE9, [9] HSA9, [9] HBP9, [9] HLINE9, [9] VSA9, [9] VBP9, [9] VFP9, [9] VA9, [9] PLLLIE, [9] PLLLIF, [9] CPLLLIF, [9] LPSRCDL1, [8] LPE, [8] LPVSAE, [8] VPSIZE8, [8] NUMC8, [8] NPSIZE8, [8] HSA8, [8] HBP8, [8] HLINE8, [8] VSA8, [8] VBP8, [8] VFP8, [8] VA8, [8] GSW0TX, [8] LP2HS_TIME8, [8] UAN1, [8] GCWRE, [8] GCWREIE, [8] FGCWRE, [8] UR, [8] LPE, [8] LPVSAE, [8] VPSIZE8, [8] NUMC8, [8] NPSIZE8, [8] HSA8, [8] HBP8, [8] HLINE8, [8] VSA8, [8] VBP8, [8] VFP8, [8] VA8, [8] PLLLS, [8] LPSRCDL0, [n+2] PLL_NDIV{n} (n=0..6), [n] TXECKDIV{n} (n=0..7), [7] COLC3, [7] VLPSIZE7, [7] VPSIZE7, [7] NUMC7, [7] NPSIZE7, [7] HSA7, [7] HBP7, [7] HLINE7, [7] VSA7, [7] VBP7, [7] VFP7, [7] VA7, [7] VCID1, [7] LP2HS_TIME7, [7] PSS1, [7] LPWRE, [7] LPWREIE, [7] FLPWRE, [7] VLPSIZE7, [7] VPSIZE7, [7] NUMC7, [7] NPSIZE7, [7] HSA7, [7] HBP7, [7] HLINE7, [7] VSA7, [7] VBP7, [7] VFP7, [7] VA7, [7] VSPOL, [7] LPSRCCL1, [n] TCLKPREP{n} (n=0..7), [n] THSZERO{n} (n=0..7), [n] TCLKPOST{n} (n=0..7), [6] COLC2, [6] VLPSIZE6, [6] VPSIZE6, [6] NUMC6, [6] NPSIZE6, [6] HSA6, [6] HBP6, [6] HLINE6, [6] VSA6, [6] VBP6, [6] VFP6, [6] VA6, [6] VCID0, [6] RCB, [6] LP2HS_TIME6, [6] RUE0, [6] EOTPE, [6] EOTPEIE, [6] FEOTPE, [6] VLPSIZE6, [6] VPSIZE6, [6] NUMC6, [6] NPSIZE6, [6] HSA6, [6] HBP6, [6] HLINE6, [6] VSA6, [6] VBP6, [6] VFP6, [6] VA6, [6] AR, [6] LPSRCCL0, [5] COLC1, [5] VLPSIZE5, [5] VPSIZE5, [5] NUMC5, [5] NPSIZE5, [5] HSA5, [5] HBP5, [5] HLINE5, [5] VSA5, [5] VBP5, [5] VFP5, [5] VA5, [n] DT{n} (n=0..5), [5] PRDFF, [5] RF, [5] LP2HS_TIME5, [5] UAN0, [5] PSE, [5] PSEIE, [5] FPSE, [5] VLPSIZE5, [5] VPSIZE5, [5] NUMC5, [5] NPSIZE5, [5] HSA5, [5] HBP5, [5] HLINE5, [5] VSA5, [5] VBP5, [5] VFP5, [5] VA5, [5] RF, [5] TEPOL, [4] VLPSIZE4, [4] CRCRXE, [4] VPSIZE4, [4] NUMC4, [4] NPSIZE4, [4] HSA4, [4] HBP4, [4] HLINE4, [4] VSA4, [4] VBP4, [4] VFP4, [4] VA4, [4] PRDFE, [4] SVS, [4] LP2HS_TIME4, [4] PSS0, [4] CRCE, [4] CRCEIE, [4] FCRCE, [4] VLPSIZE4, [4] VPSIZE4, [4] NUMC4, [4] NPSIZE4, [4] HSA4, [4] HBP4, [4] HLINE4, [4] VSA4, [4] VBP4, [4] VFP4, [4] VA4, [4] SVS, [4] TESRC, [3] VLPSIZE3, [3] ECCRXE, [3] VPSIZE3, [3] NUMC3, [3] NPSIZE3, [3] HSA3, [3] HBP3, [3] HLINE3, [3] VSA3, [3] VBP3, [3] VFP3, [3] VA3, [3] PWRFF, [3] LP2HS_TIME3, [3] UEDL, [n] TX_TRIG{n} (n=0..3), [3] UANC, [3] ECCME, [3] ECCMEIE, [3] FECCME, [3] COLC3, [3] VLPSIZE3, [3] VPSIZE3, [3] NUMC3, [3] NPSIZE3, [3] HSA3, [3] HBP3, [3] HLINE3, [3] VSA3, [3] VBP3, [3] VFP3, [3] VA3, [3] COLMUX2, [3] DSIEN, [3] HSTXDDL1, [2] HSP, [2] VLPSIZE2, [2] BTAE, [2] VPSIZE2, [2] NUMC2, [2] NPSIZE2, [2] HSA2, [2] HBP2, [2] HLINE2, [2] VSA2, [2] VBP2, [2] VFP2, [2] VA2, [2] PWRFE, [2] LP2HS_TIME2, [2] CKE, [2] URDL, [2] PSSC, [2] ECCSE, [2] ECCSEIE, [2] FECCSE, [2] COLC2, [2] VLPSIZE2, [2] VPSIZE2, [2] NUMC2, [2] NPSIZE2, [2] HSA2, [2] HBP2, [2] HLINE2, [2] VSA2, [2] VBP2, [2] VFP2, [2] VA2, [2] COLMUX1, [2] LTDCEN, [2] BUSY, [2] HSTXDDL0, [1] VCID1, [1] VSP, [1] VLPSIZE1, [1] ETRXE, [1] VCID1, [1] VMT1, [1] VPSIZE1, [1] NUMC1, [1] NPSIZE1, [1] HSA1, [1] HBP1, [1] HLINE1, [1] VSA1, [1] VBP1, [1] VFP1, [1] VA1, [1] ARE, [1] CMDFF, [1] ACR, [1] LP2HS_TIME1, [1] DEN, [1] NL1, [1] UECL, [1] PD, [1] TOLPRX, [1] TOLPRXIE, [1] FTOLPRX, [1] VCID1, [1] COLC1, [1] VLPSIZE1, [1] VMT1, [1] VPSIZE1, [1] NUMC1, [1] NPSIZE1, [1] HSA1, [1] HBP1, [1] HLINE1, [1] VSA1, [1] VBP1, [1] VFP1, [1] VA1, [1] COLMUX0, [1] SHTDN, [1] ERIE, [1] ERIF, [1] CERIF, [1] HSTXDCL1, [0] EN, [0] VCID0, [0] COLC0, [0] DEP, [0] VLPSIZE0, [0] ETTXE, [0] VCID0, [0] CMDM, [0] VMT0, [0] VPSIZE0, [0] NUMC0, [0] NPSIZE0, [0] HSA0, [0] HBP0, [0] HLINE0, [0] VSA0, [0] VBP0, [0] VFP0, [0] VA0, [0] TEARE, [0] CMDFE, [0] DPCC, [0] LP2HS_TIME0, [0] NL0, [0] URCL, [0] TOHSTX, [0] TOHSTXIE, [0] FTOHSTX, [0] EN, [0] VCID0, [0] COLC0, [0] VLPSIZE0, [0] VMT0, [0] VPSIZE0, [0] NUMC0, [0] NPSIZE0, [0] HSA0, [0] HBP0, [0] HLINE0, [0] VSA0, [0] VBP0, [0] VFP0, [0] VA0, [0] DSIM, [0] COLM, [0] TEIE, [0] TEIF, [0] CTEIF, [0] HSTXDCL0, [0] PLLEN
0x08 CCR
0x0C LVCIDR
0x10 LCOLCR
0x14 LPCR
0x18 LPMCR
0x2C PCR
0x30 GVCIDR
0x34 MCR
0x38 VMCR
0x3C VPCR
0x40 VCCR
0x44 VNPCR
0x48 VHSACR
0x4C VHBPCR
0x50 VLCR
0x54 VVSACR
0x58 VVBPCR
0x5C VVFPCR
0x60 VVACR
0x64 LCCR
0x68 CMCR
0x6C GHCR
0x70 GPDR
0x74 GPSR
0x78 TCCR.0
0x7C TCCR.1
0x80 TCCR.2
0x84 TCCR.3
0x88 TCCR.4
0x8C TCCR.5
0x90 TDCR
0x94 CLCR
0x98 CLTCR
0x9C DLTCR
0xA0 PCTLR
0xA4 PCONFR
0xA8 PUCR
0xAC PTTCR
0xB0 PSR
0xBC ISR.0
0xC0 ISR.1
0xC4 IER.0
0xC8 IER.1
0xD8 FIR.0
0xDC FIR.1
0x100 VSCR
0x10C LCVCIDR
0x110 LCCCR
0x118 LPMCCR
0x138 VMCCR
0x13C VPCCR
0x140 VCCCR
0x144 VNPCCR
0x148 VHSACCR
0x14C VHBPCCR
0x150 VLCCR
0x154 VVSACCR
0x158 VVBPCCR
0x15C VVFPCCR
0x160 VVACCR
0x190 TDCCR
0x400 WCFGR
0x404 WCR
0x408 WIER
0x40C WISR
0x410 WIFCR
0x418 WPCR.0
0x41C WPCR.1
0x420 WPCR.2
0x424 WPCR.3
0x428 WPCR.4
0x430 WRPCR
