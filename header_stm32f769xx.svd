# STM32F769xx register map
File version: 1.0
Registers are 32-bit, access not given, reset 0x0 unless marked. A register's access mark holds for its fields unless they carry their own. Offsets are from the block's base; [hi:lo] are bit positions; {n}, {i} and the like mark numbered series.

## ETH
Base 0x40028000
0x00 MACCR
  [31] RA, [31] WFFRPR, [31] AE, [31] AE, [31] AE, [31] STPNS, [31] TSUPNS, [30] SA, [30] SA, [30] SA, [29] TSTS, [28] PMTS, [28] OFOC, [27] MMCS, [26] DTCEFD, [25] TFF, [25] AAB, [25] EBS_DescAccess, [25] RSF, [24] TFNE, [29:24] MBC, [29:24] MBC, [29:24] MBC, [24] FPM, [24] EBS_ReadTransf, [24] DFRF, [23] WD, [23] USP, [23] EBS_DataTransfTx, [22] JD, [22] TPWA, [21] TFRS_WAITING, [21] TGFS, [21] TGFM, [21] TPS_Waiting, [21] TSF, [21:20] TFRS_WRITING, [21:20] TPS_Reading, [20] FTF, [19] MTP, [19] RPS_Suspended, [18] MTFCS_GENERATINGPCF, [19:17] IFG, [17] MTFCS_WAITING, [17] RGUFS, [17] RGUFM, [22:17] RDP, [18:17] RPS_Waiting, [27:17] MFA, [16] CSD, [31:16] PT, [16] VLANTC, [16] MMTEA, [17:16] TSCNT, [16] FB, [16] NIS, [16] NISE, [16] OMFC, [15] TGFMSCS, [15] TGFMSCM, [15] TSSMRME, [15] AIS, [15] AISE, [14] FES, [14] TGFSCS, [14] TGFSCM, [14] TSSEME, [15:14] RTPR, [14] ERS, [16:14] TTC, [14] ERIE, [13] ROD, [13] TSSIPV4FE, [13] FBES, [13] ST, [13] FBEIE, [12] LM, [12] TSSIPV6FE, [11] DM, [15:11] PA, [11] TSSPTPOEFE, [10] IPCO, [10] HPF, [10] TSPTPPSV2E, [10] ETS, [10] ETIE, [9] RD, [9] SAF, [9] GU, [9] RFFL_ABOVEFCT, [9] TSTS, [9] TSTIM, [9] TSSSR, [9] RWTS, [9] RWTIE, [8] SAIF, [9:8] RFFL_FULL, [8] TSSARFE, [13:8] PBL, [8] RPSS, [8] RPSIE, [7] APCS, [7] PCF_ForwardAll, [7] ZQPD, [7] EDE, [7] RBUS, [7] FEF, [7] RBUIE, [7:6] PCF_ForwardPassedAddrFilter, [10:6] MR, [6] WFR, [6] RFRCS_STATUSREADING, [6] MMCTS, [6] RFAES, [6] RFAEM, [6] RS, [6] FUGF, [6] RIE, [6:5] BL, [5] BFD, [5] PLT_Minus144, [5] MPR, [6:5] RFRCS_FLUSHING, [5] MMMCRS, [5] MCFHP, [5] RFCES, [5] RFCEM, [5] TSARU, [5] TSTTR, [5] TUS, [5] TUIE, [4] DC, [4] PAM, [4] CR_Div102, [4] PLT_Minus28, [4] RFWRA, [4] MMCS, [4] MCP, [4] TSITE, [4] TSSO, [4] ROS, [4] ROIE, [3] TE, [3] DAIF, [3] CR_Div16, [3] UPFD, [3] PMTS, [3] PMTIM, [3] MCF, [3] TSSTU, [3] TJTS, [4:3] RTC, [3] TJTIE, [2] RE, [2] HM, [2] CR_Div62, [2] RFCE, [2] WFE, [2] ROR, [2] TSSTI, [6:2] DSL, [2] TBUS, [2] OSF, [2] TBUIE, [1] HU, [1] MW, [1] TFCE, [1] MPE, [2:1] MSFRWCS, [1] CSR, [1] TSFCU, [1] DA, [1] TPSS, [1] SR, [1] TPSIE, [0] PM, [31:0] HTH, [31:0] HTL, [0] MB, [15:0] MD, [0] FCBBPA, [15:0] VLANTI, [31:0] D, [0] PD, [0] MMRPEA, [15:0] MACA{n}H (n=0..3), [31:0] MACA{n}L (n=0..3), [0] CR, [31:0] TGFSCC, [31:0] TGFMSCC, [31:0] TGFC, [31:0] RFCEC, [31:0] RFAEC, [31:0] RGUFC, [0] TSE, [7:0] STSSI, [31:0] STS, [30:0] STSS, [31:0] TSUS, [30:0] TSUSS, [31:0] TSA, [31:0] TTSH, [31:0] TTSL, [3:0] PPSFREQ, [0] SR, [31:0] TPD, [31:0] RPD, [31:0] SRL, [31:0] STL, [0] TS, [0] TIE, [15:0] MFC, [31:0] HTDAP, [31:0] HRDAP, [31:0] HTBAP, [31:0] HRBAP
0x04 MACFFR
0x08 MACHTHR
0x0C MACHTLR
0x10 MACMIIAR
0x14 MACMIIDR
0x18 MACFCR
0x1C MACVLANTR
0x28 MACRWUFFR
0x2C MACPMTCSR
0x34 MACDBGR
0x38 MACSR
0x3C MACIMR
{0x40+8i} MACA{i}HR (i=0..3)
{0x44+8i} MACA{i}LR (i=0..3)
0x100 MMCCR
0x104 MMCRIR
0x108 MMCTIR
0x10C MMCRIMR
0x110 MMCTIMR
0x14C MMCTGFSCCR
0x150 MMCTGFMSCCR
0x168 MMCTGFCR
0x194 MMCRFCECR
0x198 MMCRFAECR
0x1C4 MMCRGUFCR
0x700 PTPTSCR
0x704 PTPSSIR
0x708 PTPTSHR
0x70C PTPTSLR
0x710 PTPTSHUR
0x714 PTPTSLUR
0x718 PTPTSAR
0x71C PTPTTHR
0x720 PTPTTLR
0x728 PTPTSSR
0x72C PTPPPSCR
0x1000 DMABMR
0x1004 DMATPDR
0x1008 DMARPDR
0x100C DMARDLAR
0x1010 DMATDLAR
0x1014 DMASR
0x1018 DMAOMR
0x101C DMAIER
0x1020 DMAMFBOCR
0x1024 DMARSWTR
0x1048 DMACHTDR
0x104C DMACHRDR
0x1050 DMACHTBAR
0x1054 DMACHRBAR

## USB_OTG_HS
Base 0x40040000
Same registers: USB_OTG_FS 0x50000000
0x00 GOTGCTL
  [31] CTXPKT, [31] AHBIDL, [31] WKUINT, [31] WUIM, [30] FDMOD, [30] DMAREQ, [30] SRQINT, [30] SRQIM, [29] FHMOD, [29] DISCINT, [29] DISCINT, [28] CIDSCHG, [28] CIDSCHGM, [28] ENBESL, [27] LPMINT, [27] LPMINTM, [26] PTXFE, [26] PTXFEM, [25] ULPIIPD, [25] HCINT, [25] HCIM, [27:25] LPMRCNTSTS, [24] PTCI, [24] HPRTINT, [24] PRTIM, [24] SNDLPM, [23] PCCI, [23] RSTDET, [23] RSTDEM, [22] TSDPS, [22] DATAFSUSP, [22] FSUSPM, [21] ULPIEVBUSI, [21] PXFR_INCOMPISOOUT, [21] PXFRM_IISOOXFRM, [21] VBDEN, [23:21] LPMRCNT, [20] OTGVER, [20] IDCHNG, [20] ULPIEVBUSD, [20] IISOIXFR, [20] IISOIXFRM, [19] BSESVLD, [19] DBCDNE, [19] ULPICSM, [19] OEPINT, [19] OEPINT, [18] ASVLD, [18] ADTOCHG, [18] ULPIAR, [18] IEPINT, [18] IEPINT, [17] DBCT, [17] HNGDET, [17] ULPIFSLS, [17] EPMISM, [20:17] PKTSTS, [20:17] LPMCHIDX, [16] CIDSTS, [16] PWRDWN, [16] L1RSMOK, [31:16] PTXFD, [31:16] INEPTXFD, [31:16] INEPTXFD, [31:16] INEPTXFD, [31:16] INEPTXFD, [31:16] INEPTXFD, [31:16] INEPTXFD, [31:16] INEPTXFD, [31:16] INEPTXFD, [31:16] INEPTXFD, [31:16] INEPTXFD, [31:16] INEPTXFD, [31:16] INEPTXFD, [31:16] INEPTXFD, [31:16] INEPTXFD, [31:16] INEPTXFD, [15] PHYLPCS, [15] EOPF, [15] EOPFM, [16:15] DPID, [15] SLPSTS, [14] ISOODRP, [14] ISOODRPM, [13] ENUMDNE, [13] ENUMDNEM, [14:13] LPMRSP, [12] EHEN, [12] USBRST, [12] USBRST, [12] L1DSEN, [11] DHNPEN, [11] USBSUSP, [11] USBSUSPM, [10] HSHNPEN, [13:10] TRDT, [10] ESUSP, [10] ESUSPM, [9] HNPRQ, [9] HNSSCHG, [9] HNPCAP, [8] HNGSCS, [8] SRSSCHG, [8] PTXFELVL, [8] SRPCAP, [11:8] BESLTHRS, [7] BVALOVAL, [7] TXFELVL, [7] BOUTNAKEFF, [7] GONAKEFFM, [7] L1SSEN, [6] BVALOEN, [6] PHYSEL, [10:6] TXFNUM, [6] GINAKEFF, [6] GINAKEFFM, [6] REMWAKE, [5] AVALOVAL, [5] DMAEN, [5] TXFFLSH, [5] NPTXFE, [5] NPTXFEM, [4] AVALOEN, [4] RXFFLSH, [4] RXFLVL, [4] RXFLVLM, [14:4] BCNT, [3] VBVALOVAL, [3] SOF, [3] SOFM, [2] VBVALOEN, [2] SEDET, [2] FCRST, [2] OTGINT, [2] OTGINT, [5:2] BESL, [1] SRQ, [4:1] HBSTLEN, [1] HSRST, [1] MMIS, [1] MMISM, [1] LPMACK, [0] SRQSCS, [0] GINT, [2:0] TOCAL, [0] CSRST, [0] CMOD, [3:0] EPNUM, [15:0] RXFD, [31:0] PRODUCT_ID, [0] LPMEN, [15:0] PTXSA, [15:0] INEPTXSA, [15:0] INEPTXSA, [15:0] INEPTXSA, [15:0] INEPTXSA, [15:0] INEPTXSA, [15:0] INEPTXSA, [15:0] INEPTXSA, [15:0] INEPTXSA, [15:0] INEPTXSA, [15:0] INEPTXSA, [15:0] INEPTXSA, [15:0] INEPTXSA, [15:0] INEPTXSA, [15:0] INEPTXSA, [15:0] INEPTXSA
0x04 GOTGINT
0x08 GAHBCFG
0x0C GUSBCFG
0x10 GRSTCTL
0x14 GINTSTS
0x18 GINTMSK
0x1C GRXSTSR
0x20 GRXSTSP
0x24 GRXFSIZ
0x28 DIEPTXF0_HNPTXFSIZ
0x2C HNPTXSTS
0x38 GCCFG
0x3C CID
0x4C GHWCFG3
0x54 GLPMCFG
0x5C GDFIFOCFG
0x100 HPTXFSIZ
0x104 DIEPTXF.0
0x108 DIEPTXF.1
0x10C DIEPTXF.2
0x110 DIEPTXF.3
0x114 DIEPTXF.4
0x118 DIEPTXF.5
0x11C DIEPTXF.6
0x120 DIEPTXF.7
0x124 DIEPTXF.8
0x128 DIEPTXF.9
0x12C DIEPTXF.10
0x130 DIEPTXF.11
0x134 DIEPTXF.12
0x138 DIEPTXF.13
0x13C DIEPTXF.14
