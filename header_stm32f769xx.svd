# STM32F769xx register map
File version: 1.0
Registers are 32-bit, access not given, reset 0x0 unless marked. A register's access mark holds for its fields unless they carry their own. Offsets are from the block's base; [hi:lo] are bit positions; {n}, {i} and the like mark numbered series.

## RTC
Base 0x40002800
0x00 TR
  [31] MSK4, [31] MSK4, [31] ADD1S, [30] WDSEL, [30] WDSEL, [29:28] DT, [29:28] DT, [24] ITSE, [27:24] DU, [27:24] DU, [24] TAMP3MF, [27:24] MASKSS, [27:24] MASKSS, [23] COE, [23] MSK3, [23] MSK3, [23] TAMP3NOERASE, [22] PM, [22] PM, [22] PM, [22] PM, [22] TAMP3IE, [22:21] OSEL, [21] TAMP2MF, [21:20] HT, [23:20] YT, [20] POL, [21:20] HT, [21:20] HT, [21:20] HT, [20] TAMP2NOERASE, [19] COSEL, [19] TAMP2IE, [18] BKP, [18] TAMP1MF, [17] SUB1H, [17] ITSF, [17] TAMP1NOERASE, [19:16] HU, [19:16] YU, [16] ADD1H, [16] RECALPF, [22:16] PREDIV_A, [19:16] HU, [19:16] HU, [19:16] HU, [16] TAMP1IE, [15] TSIE, [15] TAMP3F, [15] MSK2, [15] MSK2, [15] CALP, [15] TAMPPUDIS, [14] WUTIE, [14] TAMP2F, [14] CALW8, [15:13] WDU, [13] ALRBIE, [13] TAMP1F, [15:13] WDU, [13] CALW16, [14:13] TAMPPRCH, [14:12] MNT, [12] MT, [12] ALRAIE, [12] TSOVF, [14:12] MNT, [14:12] MNT, [14:12] MNT, [12] MT, [11] TSE, [11] TSF, [12:11] TAMPFLT, [10] WUTE, [10] WUTF, [9] ALRBE, [9] ALRBF, [11:8] MNU, [11:8] MU, [8] ALRAE, [8] ALRAF, [11:8] MNU, [11:8] MNU, [11:8] MNU, [11:8] MU, [10:8] TAMPFREQ, [7] INIT, [7] MSK1, [7] MSK1, [7] TAMPTS, [6] FMT, [6] INITF, [6] TAMP3TRG, [5] BYPSHAD, [5] RSF, [5] TAMP3E, [6:4] ST, [5:4] DT, [4] REFCKON, [4] INITS, [6:4] ST, [6:4] ST, [6:4] ST, [5:4] DT, [4] TAMP2TRG, [3] TSEDGE, [3] SHPF, [3] TAMP2E, [3] ALARMOUTTYPE, [2] WUTWF, [2] TAMPIE, [1] ALRBWF, [1] TAMP1TRG, [2:1] TSINSEL, [3:0] SU, [3:0] DU, [2:0] WUCKSEL, [0] ALRAWF, [14:0] PREDIV_S, [15:0] WUT, [3:0] SU, [3:0] SU, [7:0] KEY, [15:0] SS, [14:0] SUBFS, [3:0] SU, [3:0] DU, [15:0] SS, [8:0] CALM, [0] TAMP1E, [14:0] SS, [14:0] SS
0x04 DR
0x08 CR
0x0C ISR
0x10 PRER
0x14 WUTR
0x1C ALRMAR
0x20 ALRMBR
0x24 WPR
0x28 SSR
0x2C SHIFTR
0x30 TSTR
0x34 TSDR
0x38 TSSSR
0x3C CALR
0x40 TAMPCR
0x44 ALRMASSR
0x48 ALRMBSSR
0x4C OR
{0x50+4i} BKP{i}R (i=0..31)

## WWDG
Base 0x40002C00
0x00 CR
  [9] EWI, [7] WDGA, [8:7] WDGTB, [6:0] T, [6:0] W, [0] EWIF
0x04 CFR
0x08 SR

## IWDG
Base 0x40003000
0x00 KR
  [2] WVU, [1] RVU, [15:0] KEY, [2:0] PR, [11:0] RL, [0] PVU, [11:0] WIN
0x04 PR
0x08 RLR
0x0C SR
0x10 WINR

## SPI2
Base 0x40003800
Same registers: SPI3 0x40003C00, SPI1 0x40013000, SPI4 0x40013400, SPI5 0x40015000, SPI6 0x40015400
0x00 CR1
  [15] BIDIMODE, [14] BIDIOE, [14] LDMATX, [13] CRCEN, [13] LDMARX, [12] CRCNEXT, [12] FRXTH, [12] ASTRTEN, [11] CRCL, [12:11] FTLVL, [11] I2SMOD, [10] RXONLY, [10] I2SE, [9] SSM, [10:9] FRLVL, [9] MCKOE, [8] SSI, [11:8] DS, [8] FRE, [9:8] I2SCFG, [8] ODD, [7] LSBFIRST, [7] TXEIE, [7] BSY, [7] PCMSYNC, [6] SPE, [6] RXNEIE, [6] OVR, [5] ERRIE, [5] MODF, [4] FRF, [4] CRCERR, [5:4] I2SSTD, [5:3] BR, [3] NSSP, [3] UDR, [3] CKPOL, [2] MSTR, [2] SSOE, [2] CHSIDE, [1] CPOL, [1] TXDMAEN, [1] TXE, [2:1] DATLEN, [0] CPHA, [0] RXDMAEN, [0] RXNE, [15:0] DR, [15:0] CRCPOLY, [15:0] RXCRC, [15:0] TXCRC, [0] CHLEN, [7:0] I2SDIV
0x04 CR2
0x08 SR
0x0C DR
0x10 CRCPR
0x14 RXCRCR
0x18 TXCRCR
0x1C I2SCFGR
0x20 I2SPR

## SPDIFRX
Base 0x40004000
0x00 CR
  [24] SOB, [18:16] INSEL, [30:16] WIDTH5, [23:16] CS, [28:16] TLO, [14] WFA, [13:12] NBTR, [11] CHSEL, [10] CBDMAEN, [9] PTMSK, [8] CUMSK, [8] TERR, [7] VMSK, [7] SERR, [6] PMSK, [6] IFEIE, [6] FERR, [5] SYNCDIE, [5] SYNCD, [5] SYNCDCF, [5:4] DRFMT, [4] SBLKIE, [4] SBD, [4] SBDCF, [3] RXSTEO, [3] OVRIE, [3] OVR, [3] OVRCF, [2] RXDMAEN, [2] PERRIE, [2] PERR, [2] PERRCF, [1] CSRNEIE, [1] CSRNE, [1:0] SPDIFEN, [0] RXNEIE, [0] RXNE, [15:0] USR, [12:0] THI
0x04 IMR
0x08 SR
0x0C IFCR
0x10 DR
0x14 CSR
0x18 DIR

## USART2
Base 0x40004400
Same registers: USART3 0x40004800, UART4 0x40004C00, UART5 0x40005000, UART7 0x40007800, UART8 0x40007C00, USART1 0x40011000, USART6 0x40011400
0x00 CR1
  [27] EOBIE, [26] RTOIE, [31:24] ADD, [31:24] BLEN, [23] RTOEN, [23] UCESM, [22] WUFIE, [22] REACK, [25:21] DEAT, [22:21] ABRMODE, [21] TEACK, [20] ABREN, [21:20] WUS, [20] WUF, [20] WUCF, [19] MSBFIRST, [19] RWU, [18] DATAINV, [18] SBKF, [17] TXINV, [19:17] SCARCNT, [17] CMF, [17] CMCF, [20:16] DEDT, [16] RXINV, [16] BUSY, [15] OVER8, [15] SWAP, [15] DEP, [15] ABRF, [14] CMIE, [14] LINEN, [14] DEM, [14] ABRE, [13] MME, [13] DDRE, [28:12] M, [13:12] STOP, [12] OVRDIS, [12] EOBF, [12] EOBCF, [11] WAKE, [11] CLKEN, [11] ONEBIT, [11] RTOF, [11] RTOCF, [10] PCE, [10] CPOL, [10] CTSIE, [10] CTS, [9] PS, [9] CPHA, [9] CTSE, [9] CTSIF, [9] CTSCF, [8] PEIE, [8] LBCL, [8] RTSE, [15:8] GT, [8] LBDF, [8] LBDCF, [7] TXEIE, [7] DMAT, [7] TXE, [6] TCIE, [6] LBDIE, [6] DMAR, [6] TC, [6] TCCF, [5] RXNEIE, [5] LBDL, [5] SCEN, [5] RXNE, [4] IDLEIE, [4] ADDM7, [4] NACK, [15:4] DIV_MANTISSA, [4] TXFRQ, [4] IDLE, [4] IDLECF, [3] TE, [3] HDSEL, [3] RXFRQ, [3] ORE, [3] ORECF, [2] RE, [2] IRLP, [2] MMRQ, [2] NE, [2] NCF, [1] UESM, [1] IREN, [1] SBKRQ, [1] FE, [1] FECF, [0] UE, [0] EIE, [3:0] DIV_FRACTION, [7:0] PSC, [23:0] RTO, [0] ABRRQ, [0] PE, [0] PECF, [8:0] RDR, [8:0] TDR
0x04 CR2
0x08 CR3
0x0C BRR
0x10 GTPR
0x14 RTOR
0x18 RQR
0x1C ISR
0x20 ICR
0x24 RDR
0x28 TDR
