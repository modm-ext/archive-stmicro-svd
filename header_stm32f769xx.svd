# STM32F769xx register map
File version: 1.0
Registers are 32-bit, access not given, reset 0x0 unless marked. A register's access mark holds for its fields unless they carry their own. Offsets are from the block's base; [hi:lo] are bit positions; {n}, {i} and the like mark numbered series.

## ADC1
Base 0x40012000
Same registers: ADC3 0x40012200
0x00 SR
  [30] SWSTART, [29:28] EXTEN, [3n+2:3n] SMP{n} (n=0..9), [26] OVRIE, [5n-31:5n-35] SQ{n} (n=7..12), [5n-1:5n-5] SQ{n} (n=1..6), [25:24] RES, [27:24] EXTSEL, [3n-28:3n-30] SMP{n} (n=10..18), [23] AWDEN, [22] JAWDEN, [22] JSWSTART, [21:20] JEXTEN, [23:20] L, [21:20] JL, [19:16] JEXTSEL, [31:16] ADC2DATA, [5n-61:5n-65] SQ{n} (n=13..16), [5n-1:5n-5] JSQ{n} (n=1..4), [15:13] DISCNUM, [12] JDISCEN, [11] DISCEN, [11] ALIGN, [10] JAUTO, [10] EOCS, [9] AWDSGL, [9] DDS, [8] SCAN, [8] DMA, [7] JEOCIE, [6] AWDIE, [5] OVR, [5] EOCIE, [4] STRT, [3] JSTRT, [2] JEOC, [1] EOC, [1] CONT, [0] AWD, [4:0] AWDCH, [0] ADON, [11:0] JOFFSET{n} (n=1..4), [11:0] HT, [11:0] LT, [15:0] DATA
0x04 CR1
0x08 CR2
0x0C SMPR1
0x10 SMPR2
{0x10+4i} JOFR{i} (i=1..4)
0x24 HTR
0x28 LTR
{0x28+4i} SQR{i} (i=1..3)
0x38 JSQR
{0x38+4i} JDR{i} (i=1..4)
0x4C DR

## ADC2
Base 0x40012100
0x00 SR
  [30] SWSTART, [29:28] EXTEN, [3n+2:3n] SMP{n} (n=0..9), [26] OVRIE, [5n-31:5n-35] SQ{n} (n=7..12), [5n-1:5n-5] SQ{n} (n=1..6), [25:24] RES, [27:24] EXTSEL, [3n-28:3n-30] SMP{n} (n=10..18), [23] AWDEN, [22] JAWDEN, [22] JSWSTART, [21:20] JEXTEN, [23:20] L, [21:20] JL, [19:16] JEXTSEL, [31:16] ADC2DATA, [5n-61:5n-65] SQ{n} (n=13..16), [5n-1:5n-5] JSQ{n} (n=1..4), [15:13] DISCNUM, [12] JDISCEN, [11] DISCEN, [11] ALIGN, [10] JAUTO, [10] EOCS, [9] AWDSGL, [9] DDS, [8] SCAN, [8] DMA, [7] JEOCIE, [6] AWDIE, [5] OVR, [5] EOCIE, [4] STRT, [3] JSTRT, [2] JEOC, [1] EOC, [1] CONT, [0] AWD, [4:0] AWDCH, [0] ADON, [11:0] JOFFSET{n} (n=1..4), [11:0] HT, [11:0] LT, [15:0] DATA
0x04 CR1
0x08 CR2
0x0C SMPR1
0x10 SMPR2
{0x10+4i} JOFR{i} (i=1..4)
0x24 HTR
0x28 LTR
{0x28+4i} SQR{i} (i=1..3)
0x38 JSQR
{0x38+4i} JDR{i} (i=1..4)
0x4C DR

## ADC
Base 0x40012300
0x00 CSR
  [23] TSVREFE, [22] VBATE, [21] OVR3, [20] STRT3, [19] JSTRT3, [18] JEOC3, [17] EOC3, [16] AWD3, [17:16] ADCPRE, [31:16] DATA2, [15:14] DMA, [13] OVR2, [13] DDS, [12] STRT2, [11] JSTRT2, [10] JEOC2, [9] EOC2, [8] AWD2, [11:8] DELAY, [5] OVR1, [4] STRT1, [3] JSTRT1, [2] JEOC1, [1] EOC1, [0] AWD1, [4:0] MULTI, [15:0] DATA1
0x04 CCR
0x08 CDR

## ADC123_COMMON
Base 0x40012300
0x00 CSR
  [23] TSVREFE, [22] VBATE, [21] OVR3, [20] STRT3, [19] JSTRT3, [18] JEOC3, [17] EOC3, [16] AWD3, [17:16] ADCPRE, [31:16] DATA2, [15:14] DMA, [13] OVR2, [13] DDS, [12] STRT2, [11] JSTRT2, [10] JEOC2, [9] EOC2, [8] AWD2, [11:8] DELAY, [5] OVR1, [4] STRT1, [3] JSTRT1, [2] JEOC1, [1] EOC1, [0] AWD1, [4:0] MULTI, [15:0] DATA1
0x04 CCR
0x08 CDR

## SYSCFG
Base 0x40013800
0x00 MEMRMP
  [23] MII_RMII_SEL, [18] ADC3DC2, [17] ADC2DC2, [18:16] ADCxDC2, [4n+3:4n] EXTI{n} (n=0..3), [4n-13:4n-16] EXTI{n} (n=4..7), [4n-29:4n-32] EXTI{n} (n=8..11), [4n-45:4n-48] EXTI{n} (n=12..15), [11:10] SWP_FMC, [8] SWP_FB, [8] READY, [n-2] I2C_PB{n}_FMP (n=6..9), [n-1] I2C{n}_FMP (n=1..4), [2] PVDL, [0] MEM_BOOT, [0] CLL, [0] CMP_PD
0x04 PMC
0x08 EXTICR.0
0x0C EXTICR.1
0x10 EXTICR.2
0x14 EXTICR.3
0x1C CBR
0x20 CMPCR

## EXTI
Base 0x40013C00
0x00 IMR
  [24] MR24, [24] MR24, [24] TR24, [24] TR24, [n] SWIER{n} (n=0..24), [n] PR{n} (n=0..24), [23] MR23, [23] MR23, [23] TR23, [23] TR23, [22] MR22, [22] MR22, [22] TR22, [22] TR22, [21] MR21, [21] MR21, [21] TR21, [21] TR21, [20] MR20, [20] MR20, [20] TR20, [20] TR20, [19] MR19, [19] MR19, [19] TR19, [19] TR19, [18] MR18, [18] MR18, [18] TR18, [18] TR18, [17] MR17, [17] MR17, [17] TR17, [17] TR17, [16] MR16, [16] MR16, [16] TR16, [16] TR16, [15] MR15, [15] MR15, [15] TR15, [15] TR15, [14] MR14, [14] MR14, [14] TR14, [14] TR14, [13] MR13, [13] MR13, [13] TR13, [13] TR13, [12] MR12, [12] MR12, [12] TR12, [12] TR12, [11] MR11, [11] MR11, [11] TR11, [11] TR11, [10] MR10, [10] MR10, [10] TR10, [10] TR10, [9] MR9, [9] MR9, [9] TR9, [9] TR9, [8] MR8, [8] MR8, [8] TR8, [8] TR8, [7] MR7, [7] MR7, [7] TR7, [7] TR7, [6] MR6, [6] MR6, [6] TR6, [6] TR6, [5] MR5, [5] MR5, [5] TR5, [5] TR5, [4] MR4, [4] MR4, [4] TR4, [4] TR4, [3] MR3, [3] MR3, [3] TR3, [3] TR3, [2] MR2, [2] MR2, [2] TR2, [2] TR2, [1] MR1, [1] MR1, [1] TR1, [1] TR1, [0] MR0, [0] MR0, [0] TR0, [0] TR0
0x04 EMR
0x08 RTSR
0x0C FTSR
0x10 SWIER
0x14 PR
