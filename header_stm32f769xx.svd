# STM32F769xx register map
File version: 1.0
Registers are 32-bit, access not given, reset 0x0 unless marked. A register's access mark holds for its fields unless they carry their own. Offsets are from the block's base; [hi:lo] are bit positions; {n}, {i} and the like mark numbered series.

## JPEG
Base 0x50051000
0x00 CONFR0
  [31:16] YSIZE, [31:16] XSIZE, [14] OFF, [13] IFF, [15:12] HSF, [15:12] HSF, [15:12] HSF, [15:12] HSF, [12] ODMAEN, [11] IDMAEN, [8] HDR, [11:8] VSF, [11:8] VSF, [11:8] VSF, [11:8] VSF, [7] COF, [7:6] NS, [6] HPDIE, [6] HPDF, [6] CHPDF, [5] EOCIE, [5] EOCF, [5] CEOCF, [5:4] COLORSPACE, [7:4] NB, [7:4] NB, [7:4] NB, [7:4] NB, [4] OFNEIE, [4] OFNEF, [3] DE, [3] OFTIE, [3] OFTF, [2] RE, [3:2] QT, [3:2] QT, [3:2] QT, [3:2] QT, [2] IFNFIE, [2] IFNFF, [1] HA, [1] HA, [1] HA, [1] HA, [1] IFTIE, [1] IFTF, [0] START, [1:0] NF, [25:0] NMCU, [15:0] NRST, [0] HD, [0] HD, [0] HD, [0] HD, [0] JCEN, [31:0] DATAIN, [31:0] DATAOUT
{0x0+4i} CONFR{i} (i=1..7)
0x30 CR
0x34 SR
0x38 CFR
0x40 DIR
0x44 DOR
0x50 QMEM0.0
0x54 QMEM0.1
0x58 QMEM0.2
0x5C QMEM0.3
0x60 QMEM0.4
0x64 QMEM0.5
0x68 QMEM0.6
0x6C QMEM0.7
0x70 QMEM0.8
0x74 QMEM0.9
0x78 QMEM0.10
0x7C QMEM0.11
0x80 QMEM0.12
0x84 QMEM0.13
0x88 QMEM0.14
0x8C QMEM0.15
0x90 QMEM1.0
0x94 QMEM1.1
0x98 QMEM1.2
0x9C QMEM1.3
0xA0 QMEM1.4
0xA4 QMEM1.5
0xA8 QMEM1.6
0xAC QMEM1.7
0xB0 QMEM1.8
0xB4 QMEM1.9
0xB8 QMEM1.10
0xBC QMEM1.11
0xC0 QMEM1.12
0xC4 QMEM1.13
0xC8 QMEM1.14
0xCC QMEM1.15
0xD0 QMEM2.0
0xD4 QMEM2.1
0xD8 QMEM2.2
0xDC QMEM2.3
0xE0 QMEM2.4
0xE4 QMEM2.5
0xE8 QMEM2.6
0xEC QMEM2.7
0xF0 QMEM2.8
0xF4 QMEM2.9
0xF8 QMEM2.10
0xFC QMEM2.11
0x100 QMEM2.12
0x104 QMEM2.13
0x108 QMEM2.14
0x10C QMEM2.15
0x110 QMEM3.0
0x114 QMEM3.1
0x118 QMEM3.2
0x11C QMEM3.3
0x120 QMEM3.4
0x124 QMEM3.5
0x128 QMEM3.6
0x12C QMEM3.7
0x130 QMEM3.8
0x134 QMEM3.9
0x138 QMEM3.10
0x13C QMEM3.11
0x140 QMEM3.12
0x144 QMEM3.13
0x148 QMEM3.14
0x14C QMEM3.15
0x150 HUFFMIN.0
0x154 HUFFMIN.1
0x158 HUFFMIN.2
0x15C HUFFMIN.3
0x160 HUFFMIN.4
0x164 HUFFMIN.5
0x168 HUFFMIN.6
0x16C HUFFMIN.7
0x170 HUFFMIN.8
0x174 HUFFMIN.9
0x178 HUFFMIN.10
0x17C HUFFMIN.11
0x180 HUFFMIN.12
0x184 HUFFMIN.13
0x188 HUFFMIN.14
0x18C HUFFMIN.15
0x190 HUFFBASE.0
0x194 HUFFBASE.1
0x198 HUFFBASE.2
0x19C HUFFBASE.3
0x1A0 HUFFBASE.4
0x1A4 HUFFBASE.5
0x1A8 HUFFBASE.6
0x1AC HUFFBASE.7
0x1B0 HUFFBASE.8
0x1B4 HUFFBASE.9
0x1B8 HUFFBASE.10
0x1BC HUFFBASE.11
0x1C0 HUFFBASE.12
0x1C4 HUFFBASE.13
0x1C8 HUFFBASE.14
0x1CC HUFFBASE.15
0x1D0 HUFFBASE.16
0x1D4 HUFFBASE.17
0x1D8 HUFFBASE.18
0x1DC HUFFBASE.19
0x1E0 HUFFBASE.20
0x1E4 HUFFBASE.21
0x1E8 HUFFBASE.22
0x1EC HUFFBASE.23
0x1F0 HUFFBASE.24
0x1F4 HUFFBASE.25
0x1F8 HUFFBASE.26
0x1FC HUFFBASE.27
0x200 HUFFBASE.28
0x204 HUFFBASE.29
0x208 HUFFBASE.30
0x20C HUFFBASE.31
0x210 HUFFSYMB.0
0x214 HUFFSYMB.1
0x218 HUFFSYMB.2
0x21C HUFFSYMB.3
0x220 HUFFSYMB.4
0x224 HUFFSYMB.5
0x228 HUFFSYMB.6
0x22C HUFFSYMB.7
0x230 HUFFSYMB.8
0x234 HUFFSYMB.9
0x238 HUFFSYMB.10
0x23C HUFFSYMB.11
0x240 HUFFSYMB.12
0x244 HUFFSYMB.13
0x248 HUFFSYMB.14
0x24C HUFFSYMB.15
0x250 HUFFSYMB.16
0x254 HUFFSYMB.17
0x258 HUFFSYMB.18
0x25C HUFFSYMB.19
0x260 HUFFSYMB.20
0x264 HUFFSYMB.21
0x268 HUFFSYMB.22
0x26C HUFFSYMB.23
0x270 HUFFSYMB.24
0x274 HUFFSYMB.25
0x278 HUFFSYMB.26
0x27C HUFFSYMB.27
0x280 HUFFSYMB.28
0x284 HUFFSYMB.29
0x288 HUFFSYMB.30
0x28C HUFFSYMB.31
0x290 HUFFSYMB.32
0x294 HUFFSYMB.33
0x298 HUFFSYMB.34
0x29C HUFFSYMB.35
0x2A0 HUFFSYMB.36
0x2A4 HUFFSYMB.37
0x2A8 HUFFSYMB.38
0x2AC HUFFSYMB.39
0x2B0 HUFFSYMB.40
0x2B4 HUFFSYMB.41
0x2B8 HUFFSYMB.42
0x2BC HUFFSYMB.43
0x2C0 HUFFSYMB.44
0x2C4 HUFFSYMB.45
0x2C8 HUFFSYMB.46
0x2CC HUFFSYMB.47
0x2D0 HUFFSYMB.48
0x2D4 HUFFSYMB.49
0x2D8 HUFFSYMB.50
0x2DC HUFFSYMB.51
0x2E0 HUFFSYMB.52
0x2E4 HUFFSYMB.53
0x2E8 HUFFSYMB.54
0x2EC HUFFSYMB.55
0x2F0 HUFFSYMB.56
0x2F4 HUFFSYMB.57
0x2F8 HUFFSYMB.58
0x2FC HUFFSYMB.59
0x300 HUFFSYMB.60
0x304 HUFFSYMB.61
0x308 HUFFSYMB.62
0x30C HUFFSYMB.63
0x310 HUFFSYMB.64
0x314 HUFFSYMB.65
0x318 HUFFSYMB.66
0x31C HUFFSYMB.67
0x320 HUFFSYMB.68
0x324 HUFFSYMB.69
0x328 HUFFSYMB.70
0x32C HUFFSYMB.71
0x330 HUFFSYMB.72
0x334 HUFFSYMB.73
0x338 HUFFSYMB.74
0x33C HUFFSYMB.75
0x340 HUFFSYMB.76
0x344 HUFFSYMB.77
0x348 HUFFSYMB.78
0x34C HUFFSYMB.79
0x350 HUFFSYMB.80
0x354 HUFFSYMB.81
0x358 HUFFSYMB.82
0x35C HUFFSYMB.83
0x360 DHTMEM.0
0x364 DHTMEM.1
0x368 DHTMEM.2
0x36C DHTMEM.3
0x370 DHTMEM.4
0x374 DHTMEM.5
0x378 DHTMEM.6
0x37C DHTMEM.7
0x380 DHTMEM.8
0x384 DHTMEM.9
0x388 DHTMEM.10
0x38C DHTMEM.11
0x390 DHTMEM.12
0x394 DHTMEM.13
0x398 DHTMEM.14
0x39C DHTMEM.15
0x3A0 DHTMEM.16
0x3A4 DHTMEM.17
0x3A8 DHTMEM.18
0x3AC DHTMEM.19
0x3B0 DHTMEM.20
0x3B4 DHTMEM.21
0x3B8 DHTMEM.22
0x3BC DHTMEM.23
0x3C0 DHTMEM.24
0x3C4 DHTMEM.25
0x3C8 DHTMEM.26
0x3CC DHTMEM.27
0x3D0 DHTMEM.28
0x3D4 DHTMEM.29
0x3D8 DHTMEM.30
0x3DC DHTMEM.31
0x3E0 DHTMEM.32
0x3E4 DHTMEM.33
0x3E8 DHTMEM.34
0x3EC DHTMEM.35
0x3F0 DHTMEM.36
0x3F4 DHTMEM.37
0x3F8 DHTMEM.38
0x3FC DHTMEM.39
0x400 DHTMEM.40
0x404 DHTMEM.41
0x408 DHTMEM.42
0x40C DHTMEM.43
0x410 DHTMEM.44
0x414 DHTMEM.45
0x418 DHTMEM.46
0x41C DHTMEM.47
0x420 DHTMEM.48
0x424 DHTMEM.49
0x428 DHTMEM.50
0x42C DHTMEM.51
0x430 DHTMEM.52
0x434 DHTMEM.53
0x438 DHTMEM.54
0x43C DHTMEM.55
0x440 DHTMEM.56
0x444 DHTMEM.57
0x448 DHTMEM.58
0x44C DHTMEM.59
0x450 DHTMEM.60
0x454 DHTMEM.61
0x458 DHTMEM.62
0x45C DHTMEM.63
0x460 DHTMEM.64
0x464 DHTMEM.65
0x468 DHTMEM.66
0x46C DHTMEM.67
0x470 DHTMEM.68
0x474 DHTMEM.69
0x478 DHTMEM.70
0x47C DHTMEM.71
0x480 DHTMEM.72
0x484 DHTMEM.73
0x488 DHTMEM.74
0x48C DHTMEM.75
0x490 DHTMEM.76
0x494 DHTMEM.77
0x498 DHTMEM.78
0x49C DHTMEM.79
0x4A0 DHTMEM.80
0x4A4 DHTMEM.81
0x4A8 DHTMEM.82
0x4AC DHTMEM.83
0x4B0 DHTMEM.84
0x4B4 DHTMEM.85
0x4B8 DHTMEM.86
0x4BC DHTMEM.87
0x4C0 DHTMEM.88
0x4C4 DHTMEM.89
0x4C8 DHTMEM.90
0x4CC DHTMEM.91
0x4D0 DHTMEM.92
0x4D4 DHTMEM.93
0x4D8 DHTMEM.94
0x4DC DHTMEM.95
0x4E0 DHTMEM.96
0x4E4 DHTMEM.97
0x4E8 DHTMEM.98
0x4EC DHTMEM.99
0x4F0 DHTMEM.100
0x4F4 DHTMEM.101
0x4F8 DHTMEM.102
0x500 HUFFENC_AC0.0
0x504 HUFFENC_AC0.1
0x508 HUFFENC_AC0.2
0x50C HUFFENC_AC0.3
0x510 HUFFENC_AC0.4
0x514 HUFFENC_AC0.5
0x518 HUFFENC_AC0.6
0x51C HUFFENC_AC0.7
0x520 HUFFENC_AC0.8
0x524 HUFFENC_AC0.9
0x528 HUFFENC_AC0.10
0x52C HUFFENC_AC0.11
0x530 HUFFENC_AC0.12
0x534 HUFFENC_AC0.13
0x538 HUFFENC_AC0.14
0x53C HUFFENC_AC0.15
0x540 HUFFENC_AC0.16
0x544 HUFFENC_AC0.17
0x548 HUFFENC_AC0.18
0x54C HUFFENC_AC0.19
0x550 HUFFENC_AC0.20
0x554 HUFFENC_AC0.21
0x558 HUFFENC_AC0.22
0x55C HUFFENC_AC0.23
0x560 HUFFENC_AC0.24
0x564 HUFFENC_AC0.25
0x568 HUFFENC_AC0.26
0x56C HUFFENC_AC0.27
0x570 HUFFENC_AC0.28
0x574 HUFFENC_AC0.29
0x578 HUFFENC_AC0.30
0x57C HUFFENC_AC0.31
0x580 HUFFENC_AC0.32
0x584 HUFFENC_AC0.33
0x588 HUFFENC_AC0.34
0x58C HUFFENC_AC0.35
0x590 HUFFENC_AC0.36
0x594 HUFFENC_AC0.37
0x598 HUFFENC_AC0.38
0x59C HUFFENC_AC0.39
0x5A0 HUFFENC_AC0.40
0x5A4 HUFFENC_AC0.41
0x5A8 HUFFENC_AC0.42
0x5AC HUFFENC_AC0.43
0x5B0 HUFFENC_AC0.44
0x5B4 HUFFENC_AC0.45
0x5B8 HUFFENC_AC0.46
0x5BC HUFFENC_AC0.47
0x5C0 HUFFENC_AC0.48
0x5C4 HUFFENC_AC0.49
0x5C8 HUFFENC_AC0.50
0x5CC HUFFENC_AC0.51
0x5D0 HUFFENC_AC0.52
0x5D4 HUFFENC_AC0.53
0x5D8 HUFFENC_AC0.54
0x5DC HUFFENC_AC0.55
0x5E0 HUFFENC_AC0.56
0x5E4 HUFFENC_AC0.57
0x5E8 HUFFENC_AC0.58
0x5EC HUFFENC_AC0.59
0x5F0 HUFFENC_AC0.60
0x5F4 HUFFENC_AC0.61
0x5F8 HUFFENC_AC0.62
0x5FC HUFFENC_AC0.63
0x600 HUFFENC_AC0.64
0x604 HUFFENC_AC0.65
0x608 HUFFENC_AC0.66
0x60C HUFFENC_AC0.67
0x610 HUFFENC_AC0.68
0x614 HUFFENC_AC0.69
0x618 HUFFENC_AC0.70
0x61C HUFFENC_AC0.71
0x620 HUFFENC_AC0.72
0x624 HUFFENC_AC0.73
0x628 HUFFENC_AC0.74
0x62C HUFFENC_AC0.75
0x630 HUFFENC_AC0.76
0x634 HUFFENC_AC0.77
0x638 HUFFENC_AC0.78
0x63C HUFFENC_AC0.79
0x640 HUFFENC_AC0.80
0x644 HUFFENC_AC0.81
0x648 HUFFENC_AC0.82
0x64C HUFFENC_AC0.83
0x650 HUFFENC_AC0.84
0x654 HUFFENC_AC0.85
0x658 HUFFENC_AC0.86
0x65C HUFFENC_AC0.87
0x660 HUFFENC_AC1.0
0x664 HUFFENC_AC1.1
0x668 HUFFENC_AC1.2
0x66C HUFFENC_AC1.3
0x670 HUFFENC_AC1.4
0x674 HUFFENC_AC1.5
0x678 HUFFENC_AC1.6
0x67C HUFFENC_AC1.7
0x680 HUFFENC_AC1.8
0x684 HUFFENC_AC1.9
0x688 HUFFENC_AC1.10
0x68C HUFFENC_AC1.11
0x690 HUFFENC_AC1.12
0x694 HUFFENC_AC1.13
0x698 HUFFENC_AC1.14
0x69C HUFFENC_AC1.15
0x6A0 HUFFENC_AC1.16
0x6A4 HUFFENC_AC1.17
0x6A8 HUFFENC_AC1.18
0x6AC HUFFENC_AC1.19
0x6B0 HUFFENC_AC1.20
0x6B4 HUFFENC_AC1.21
0x6B8 HUFFENC_AC1.22
0x6BC HUFFENC_AC1.23
0x6C0 HUFFENC_AC1.24
0x6C4 HUFFENC_AC1.25
0x6C8 HUFFENC_AC1.26
0x6CC HUFFENC_AC1.27
0x6D0 HUFFENC_AC1.28
0x6D4 HUFFENC_AC1.29
0x6D8 HUFFENC_AC1.30
0x6DC HUFFENC_AC1.31
0x6E0 HUFFENC_AC1.32
0x6E4 HUFFENC_AC1.33
0x6E8 HUFFENC_AC1.34
0x6EC HUFFENC_AC1.35
0x6F0 HUFFENC_AC1.36
0x6F4 HUFFENC_AC1.37
0x6F8 HUFFENC_AC1.38
0x6FC HUFFENC_AC1.39
0x700 HUFFENC_AC1.40
0x704 HUFFENC_AC1.41
0x708 HUFFENC_AC1.42
0x70C HUFFENC_AC1.43
0x710 HUFFENC_AC1.44
0x714 HUFFENC_AC1.45
0x718 HUFFENC_AC1.46
0x71C HUFFENC_AC1.47
0x720 HUFFENC_AC1.48
0x724 HUFFENC_AC1.49
0x728 HUFFENC_AC1.50
0x72C HUFFENC_AC1.51
0x730 HUFFENC_AC1.52
0x734 HUFFENC_AC1.53
0x738 HUFFENC_AC1.54
0x73C HUFFENC_AC1.55
0x740 HUFFENC_AC1.56
0x744 HUFFENC_AC1.57
0x748 HUFFENC_AC1.58
0x74C HUFFENC_AC1.59
0x750 HUFFENC_AC1.60
0x754 HUFFENC_AC1.61
0x758 HUFFENC_AC1.62
0x75C HUFFENC_AC1.63
0x760 HUFFENC_AC1.64
0x764 HUFFENC_AC1.65
0x768 HUFFENC_AC1.66
0x76C HUFFENC_AC1.67
0x770 HUFFENC_AC1.68
0x774 HUFFENC_AC1.69
0x778 HUFFENC_AC1.70
0x77C HUFFENC_AC1.71
0x780 HUFFENC_AC1.72
0x784 HUFFENC_AC1.73
0x788 HUFFENC_AC1.74
0x78C HUFFENC_AC1.75
0x790 HUFFENC_AC1.76
0x794 HUFFENC_AC1.77
0x798 HUFFENC_AC1.78
0x79C HUFFENC_AC1.79
0x7A0 HUFFENC_AC1.80
0x7A4 HUFFENC_AC1.81
0x7A8 HUFFENC_AC1.82
0x7AC HUFFENC_AC1.83
0x7B0 HUFFENC_AC1.84
0x7B4 HUFFENC_AC1.85
0x7B8 HUFFENC_AC1.86
0x7BC HUFFENC_AC1.87
0x7C0 HUFFENC_DC0.0
0x7C4 HUFFENC_DC0.1
0x7C8 HUFFENC_DC0.2
0x7CC HUFFENC_DC0.3
0x7D0 HUFFENC_DC0.4
0x7D4 HUFFENC_DC0.5
0x7D8 HUFFENC_DC0.6
0x7DC HUFFENC_DC0.7
0x7E0 HUFFENC_DC1.0
0x7E4 HUFFENC_DC1.1
0x7E8 HUFFENC_DC1.2
0x7EC HUFFENC_DC1.3
0x7F0 HUFFENC_DC1.4
0x7F4 HUFFENC_DC1.5
0x7F8 HUFFENC_DC1.6
0x7FC HUFFENC_DC1.7
