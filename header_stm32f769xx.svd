# STM32F769xx register map
File version: 1.0
Registers are 32-bit, access not given, reset 0x0 unless marked. A register's access mark holds for its fields unless they carry their own. Offsets are from the block's base; [hi:lo] are bit positions; {n}, {i} and the like mark numbered series.

## DCMI
Base 0x50050000
0x00 CR
  [31:24] FEC, [31:24] FEU, [8n+7:8n] BYTE{n} (n=0..3), [20] OELS, [19] LSM, [18] OEBS, [17:16] BSM, [23:16] LEC, [23:16] LEU, [14] ENABLE, [12] CRE, [15:8] LSC, [15:8] LSU, [7] VSPOL, [6] HSPOL, [5] PCKPOL, [4] ESS, [4] LINE_IE, [4] LINE_ISC, [3] JPEG, [3] VSYNC_IE, [3] VSYNC_ISC, [2] CROP, [2] FNE, [2] ERR_IE, [2] ERR_ISC, [1] CM, [1] VSYNC, [1] OVR_IE, [1] OVR_ISC, [0] CAPTURE, [0] HSYNC, [0] FRAME_IE, [0] FRAME_ISC, [7:0] FSC, [7:0] FSU
0x04 SR
0x08 RISR
0x0C IER
0x10 MISR
0x14 ICR
0x18 ESCR
0x1C ESUR
0x20 CWSTRTR
0x24 CWSIZER
0x28 DR

## RNG
Base 0x50060800
0x00 CR
  [6] SEIS, [5] CEIS, [3] IE, [2] RNGEN, [2] SECS, [1] CECS, [0] DRDY
0x04 SR
0x08 DR

## FMC_Bank1
Base 0xA0000000
0x00 BTCR.0
0x04 BTCR.1
0x08 BTCR.2
0x0C BTCR.3
0x10 BTCR.4
0x14 BTCR.5
0x18 BTCR.6
0x1C BTCR.7

## FMC_Bank3
Base 0xA0000080
0x00 PCR
  [31:24] MEMHIZ3, [31:24] ATTHIZ3, [19:17] ECCPS, [23:16] MEMHOLD3, [23:16] ATTHOLD3, [16:13] TAR, [12:9] TCLR, [15:8] MEMWAIT3, [15:8] ATTWAIT3, [6] ECCEN, [6] FEMPT, [5] IFEN, [5:4] PWID, [4] ILEN, [3] PTYP, [3] IREN, [2] PBKEN, [2] IFS, [1] PWAITEN, [1] ILS, [0] IRS, [7:0] MEMSET3, [7:0] ATTSET3, [31:0] ECC3
0x04 SR
0x08 PMEM
0x0C PATT
0x14 ECCR

## FMC_Bank1E
Base 0xA0000104
0x00 BWTR.0
  [29:28] ACCMOD, [29:28] ACCMOD, [29:28] ACCMOD, [29:28] ACCMOD, [19:16] BUSTURN, [19:16] BUSTURN, [19:16] BUSTURN, [19:16] BUSTURN, [15:8] DATAST, [15:8] DATAST, [15:8] DATAST, [15:8] DATAST, [7:4] ADDHLD, [7:4] ADDHLD, [7:4] ADDHLD, [7:4] ADDHLD, [3:0] ADDSET, [3:0] ADDSET, [3:0] ADDSET, [3:0] ADDSET
0x04 BWTR.1
0x08 BWTR.2
0x0C BWTR.3
0x10 BWTR.4
0x14 BWTR.5
0x18 BWTR.6

## FMC_Bank5_6
Base 0xA0000140
0x00 SDCR.0
  [27:24] TRCD, [27:24] TRCD, [23:20] TRP, [23:20] TRP, [19:16] TWR, [19:16] TWR, [14] REIE, [14:13] RPIPE, [14:13] RPIPE, [12] RBURST, [12] RBURST, [15:12] TRC, [15:12] TRC, [11:10] SDCLK, [11:10] SDCLK, [9] WP, [9] WP, [21:9] MRD, [11:8] TRAS, [11:8] TRAS, [8:7] CAS, [8:7] CAS, [6] NB, [6] NB, [8:5] NRFS, [5] BUSY, [5:4] MWID, [5:4] MWID, [7:4] TXSR, [7:4] TXSR, [4] CTB1, [3] CTB2, [4:3] MODES2, [3:2] NR, [3:2] NR, [13:1] COUNT, [2:1] MODES1, [1:0] NC, [1:0] NC, [3:0] TMRD, [3:0] TMRD, [2:0] MODE, [0] CRE, [0] RE
0x04 SDCR.1
0x08 SDTR.0
0x0C SDTR.1
0x10 SDCMR
0x14 SDRTR
0x18 SDSR

## QUADSPI
Base 0xA0001000
0x00 CR
  [31] DDRM, [30] DHHC, [28] SIOO, [27:26] FMODE, [31:24] PRESCALER, [25:24] DMODE, [23] PMM, [22] APMS, [20] TOIE, [19] SMIE, [18] FTIE, [22:18] DCYC, [17] TCIE, [16] TEIE, [20:16] FSIZE, [17:16] ABSIZE, [15:14] ABMODE, [13:12] ADSIZE, [11:10] ADMODE, [12:8] FTHRES, [10:8] CSHT, [13:8] FLEVEL, [9:8] IMODE, [7] FSEL, [6] DFM, [5] BUSY, [4] SSHIFT, [4] TOF, [4] CTOF, [3] TCEN, [3] SMF, [3] CSMF, [2] DMAEN, [2] FTF, [1] ABORT, [1] TCF, [1] CTCF, [0] EN, [0] CKMODE, [0] TEF, [0] CTEF, [31:0] DL, [7:0] INSTRUCTION, [31:0] ADDRESS, [31:0] ALTERNATE, [31:0] DATA, [31:0] MASK, [31:0] MATCH, [15:0] INTERVAL, [15:0] TIMEOUT
0x04 DCR
0x08 SR
0x0C FCR
0x10 DLR
0x14 CCR
0x18 AR
0x1C ABR
0x20 DR
0x24 PSMKR
0x28 PSMAR
0x2C PIR
0x30 LPTR

## DBGMCU
Base 0xE0042000
0x00 IDCODE
  [26] DBG_CAN2_STOP, [25] DBG_CAN1_STOP, [n+20] DBG_I2C{n}_SMBUS_TIMEOUT (n=1..4), [18] DBG_TIM11_STOP, [17] DBG_TIM10_STOP, [31:16] REV_ID, [16] DBG_TIM9_STOP, [13] DBG_CAN3_STOP, [12] DBG_IWDG_STOP, [11] DBG_WWDG_STOP, [10] DBG_RTC_STOP, [9] DBG_LPTIM1_STOP, [8] DBG_TIM14_STOP, [7] DBG_TIM13_STOP, [7:6] TRACE_MODE, [6] DBG_TIM12_STOP, [5] TRACE_IOEN, [n-2] DBG_TIM{n}_STOP (n=2..7), [2] DBG_STANDBY, [1] DBG_STOP, [1] DBG_TIM8_STOP, [11:0] DEV_ID, [0] DBG_SLEEP, [0] DBG_TIM1_STOP
0x04 CR
0x08 APB1FZ
0x0C APB2FZ
