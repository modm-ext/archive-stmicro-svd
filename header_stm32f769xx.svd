# STM32F769xx register map
File version: 1.0
Registers are 32-bit, access not given, reset 0x0 unless marked. A register's access mark holds for its fields unless they carry their own. Offsets are from the block's base; [hi:lo] are bit positions; {n}, {i} and the like mark numbered series.

## I2C1
Base 0x40005400
Same registers: I2C2 0x40005800, I2C3 0x40005C00, I2C4 0x40006000
0x00 CR1
  [31] TEXTEN, [31:28] PRESC, [26] PECBYTE, [25] AUTOEND, [24] RELOAD, [23] PECEN, [22] ALERTEN, [21] SMBDEN, [20] SMBHEN, [23:20] SCLDEL, [19] GCEN, [17] NOSTRETCH, [23:17] ADDCODE, [16] SBC, [23:16] NBYTES, [19:16] SDADEL, [27:16] TIMEOUTB, [16] DIR, [15] RXDMAEN, [15] NACK, [15] OA1EN, [15] OA2EN, [15] TIMOUTEN, [15] BUSY, [14] TXDMAEN, [14] STOP, [13] START, [13] ALERT, [13] ALERTCF, [12] ANFOFF, [12] HEAD10R, [12] TIDLE, [12] TIMEOUT, [12] TIMOUTCF, [11] ADD10, [11] PECERR, [11] PECCF, [10] RD_WRN, [10] OA1MODE, [10] OA2MASK04, [10] OVR, [10] OVRCF, [10:9] OA2MASK06, [9] ARLO, [9] ARLOCF, [11:8] DNF, [10:8] OA2MSK, [15:8] SCLH, [8] BERR, [8] BERRCF, [7] ERRIE, [7] TCR, [6] TCIE, [6] TC, [5] STOPIE, [5] STOPF, [5] STOPCF, [4] NACKIE, [4] NACKF, [4] NACKCF, [3] ADDRIE, [3] ADDR, [3] ADDRCF, [2] RXIE, [2] RXNE, [1] TXIE, [7:1] OA2, [1] TXIS, [0] PE, [9:0] SADD, [9:0] OA1, [7:0] SCLL, [11:0] TIMEOUTA, [0] TXE, [7:0] PEC, [7:0] RXDATA, [7:0] TXDATA
0x04 CR2
0x08 OAR1
0x0C OAR2
0x10 TIMINGR
0x14 TIMEOUTR
0x18 ISR
0x1C ICR
0x20 PECR
0x24 RXDR
0x28 TXDR

## CEC
Base 0x40006C00
0x00 CR
  [31] LSTN, [30:16] OAR, [12] TXACKE, [12] TXACKEIE, [11] TXERR, [11] TXERRIE, [10] TXUDR, [10] TXUDRIE, [9] TXEND, [9] TXENDIE, [8] SFTOPT, [8] TXBR, [8] TXBRIE, [7] BRDNOGEN, [7] ARBLST, [7] ARBLSTIE, [6] LBPEGEN, [6] RXACKE, [6] RXACKEIE, [5] BREGEN, [5] LBPE, [5] LBPEIE, [4] BRESTP, [4] SBPE, [4] SBPEIE, [3] RXTOL, [3] BRE, [3] BREIE, [2] TXEOM, [2] RXOVR, [2] RXOVRIE, [1] TXSOM, [1] RXEND, [1] RXENDIE, [0] CECEN, [2:0] SFT, [7:0] TXD, [7:0] RXD, [0] RXBR, [0] RXBRIE
0x04 CFGR
0x08 TXDR
0x0C RXDR
0x10 ISR
0x14 IER

## PWR
Base 0x40007000
0x00 CR1
  [19:18] UDEN, [19:18] UDRDY, [17] ODSWEN, [17] ODSWRDY, [16] ODEN, [16] ODRDY, [15:14] VOS, [14] VOSRDY, [13] ADCDC1, [n+7] WUPP{n} (n=1..6), [n+7] EWUP{n} (n=1..6), [11] MRUDS, [10] LPUDS, [9] FPDS, [9] BRE, [8] DBP, [8] EIWUP, [7] PLS_LEV4, [7:6] PLS_LEV6, [7:5] PLS_LEV7, [n-1] CWUPF{n} (n=1..6), [n-1] WUPF{n} (n=1..6), [4] PVDE, [3] CSBF, [3] BRR, [2] PVDO, [1] PDDS, [1] SBF, [0] LPDS, [0] WUIF
0x04 CSR1
0x08 CR2
0x0C CSR2

## DAC1
Base 0x40007400
0x00 CR
  [29] DMAUDRIE2, [29] DMAUDR2, [28] DMAEN2, [27:24] MAMP2, [23:22] WAVE2, [31:20] DACC2DHR, [21:19] TSEL2, [18] TEN2, [17] BOFF2, [16] EN2, [27:16] DACC2DHR, [13] DMAUDRIE1, [13] DMAUDR1, [12] DMAEN1, [11:8] MAMP1, [15:8] DACC2DHR, [7:6] WAVE1, [15:4] DACC1DHR, [15:4] DACC2DHR, [15:4] DACC1DHR, [5:3] TSEL1, [2] TEN1, [1] BOFF1, [1] SWTRIG2, [0] EN1, [0] SWTRIG1, [11:0] DACC1DHR, [7:0] DACC1DHR, [11:0] DACC2DHR, [7:0] DACC2DHR, [11:0] DACC1DHR, [7:0] DACC1DHR, [11:0] DACC1DOR, [11:0] DACC2DOR
0x04 SWTRIGR
0x08 DHR12R1
0x0C DHR12L1
0x10 DHR8R1
0x14 DHR12R2
0x18 DHR12L2
0x1C DHR8R2
0x20 DHR12RD
0x24 DHR12LD
0x28 DHR8RD
0x2C DOR1
0x30 DOR2
0x34 SR

## SDMMC2
Base 0x40011C00
Same registers: SDMMC1 0x40012C00
0x00 POWER
  [22] SDIOIT, [22] SDIOITC, [22] SDIOITIE, [21] RXDAVL, [21] RXDAVLIE, [20] TXDAVL, [20] TXDAVLIE, [19] RXFIFOE, [19] RXFIFOEIE, [18] TXFIFOE, [18] TXFIFOEIE, [17] RXFIFOF, [17] RXFIFOFIE, [16] TXFIFOF, [16] TXFIFOFIE, [15] RXFIFOHF, [15] RXFIFOHFIE, [14] HWFC_EN, [14] TXFIFOHE, [14] TXFIFOHEIE, [13] NEGEDGE, [13] RXACT, [13] RXACTIE, [12] TXACT, [12] TXACTIE, [12:11] WIDBUS, [11] SDIOSUSPEND, [11] SDIOEN, [11] CMDACT, [11] CMDACTIE, [10] BYPASS, [10] CPSMEN, [10] RWMOD, [10] DBCKEND, [10] DBCKENDC, [10] DBCKENDIE, [9] PWRSAV, [9] WAITPEND, [9] RWSTOP, [8] CLKEN, [8] WAITINT, [8] RWSTART, [8] DATAEND, [8] DATAENDC, [8] DATAENDIE, [7] CMDSENT, [7] CMDSENTC, [7] CMDSENTIE, [7:6] WAITRESP, [6] CMDREND, [6] CMDRENDC, [6] CMDRENDIE, [5] RXOVERR, [5] RXOVERRC, [5] RXOVERRIE, [7:4] DBLOCKSIZE, [4] TXUNDERR, [4] TXUNDERRC, [4] TXUNDERRIE, [3] DMAEN, [3] DTIMEOUT, [3] DTIMEOUTC, [3] DTIMEOUTIE, [2] DTMODE, [2] CTIMEOUT, [2] CTIMEOUTC, [2] CTIMEOUTIE, [1] DTDIR, [1] DCRCFAIL, [1] DCRCFAILC, [1] DCRCFAILIE, [1:0] PWRCTRL, [7:0] CLKDIV, [31:0] CMDARG, [5:0] CMDINDEX, [5:0] RESPCMD, [31:0] CARDSTATUS{n} (n=1..4), [31:0] DATATIME, [24:0] DATALENGTH, [0] DTEN, [24:0] DATACOUNT, [0] CCRCFAIL, [0] CCRCFAILC, [0] CCRCFAILIE, [23:0] FIFOCOUNT, [31:0] FIFODATA
0x04 CLKCR
0x08 ARG
0x0C CMD
0x10 RESPCMD
{0x10+4i} RESP{i} (i=1..4)
0x24 DTIMER
0x28 DLEN
0x2C DCTRL
0x30 DCOUNT
0x34 STA
0x38 ICR
0x3C MASK
0x48 FIFOCNT
0x80 FIFO
