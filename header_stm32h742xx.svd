# STM32H742xx register map
File version: 1.0
Registers are 32-bit, access not given, reset 0x0 unless marked. A register's access mark holds for its fields unless they carry their own. Offsets are from the block's base; [hi:lo] are bit positions; {n}, {i} and the like mark numbered series.

## WWDG1
Base 0x50003000
0x00 CR
  [13:11] WDGTB, [9] EWI, [7] WDGA, [6:0] T, [6:0] W, [0] EWIF
0x04 CFR
0x08 SR

## GPV
Base 0x51000000
{0x1FC0+4i} AXI_PERIPH_ID_{i} (i=4..7)
{0x1FE0+4i} AXI_PERIPH_ID_{i} (i=0..3)
{0x1FF0+4i} AXI_COMP_ID_{i} (i=0..3)
{0x1008+0x1000*i} AXI_TARG{i}_FN_MOD_ISS_BM (i=1..7)
0x2024 AXI_TARG1_FN_MOD2
0x202C AXI_TARG1_FN_MOD_LB
0x2108 AXI_TARG1_FN_MOD
0x3024 AXI_TARG2_FN_MOD2
0x302C AXI_TARG2_FN_MOD_LB
0x3108 AXI_TARG2_FN_MOD
0x8024 AXI_TARG7_FN_MOD2
0x802C AXI_TARG7_FN_MOD_LB
0x8108 AXI_TARG7_FN_MOD
0x42024 AXI_INI1_FN_MOD2
0x42028 AXI_INI1_FN_MOD_AHB
{0x41100+0x1000*i} AXI_INI{i}_READ_QOS (i=1..6)
{0x41104+0x1000*i} AXI_INI{i}_WRITE_QOS (i=1..6)
{0x41108+0x1000*i} AXI_INI{i}_FN_MOD (i=1..6)
0x44024 AXI_INI3_FN_MOD2
0x44028 AXI_INI3_FN_MOD_AHB

## FLASH
Base 0x52002000
0x00 ACR
  [31] SWAP_BANK, [30] OPTCHANGEERRIE, [30] CLR_OPTCHANGEERR, [5:4] WRHIGHFREQ, [4] MER, [1] OPTSTART, [3:0] LATENCY, [0] OPTLOCK, [31:0] CRC_DATA
0x04 KEYR1
0x08 OPTKEYR
0x0C CR1
0x10 SR1
0x14 CCR1
0x18 OPTCR
0x1C OPTSR_CUR
0x20 OPTSR_PRG
0x24 OPTCCR
0x28 PRAR_CUR1
0x2C PRAR_PRG1
0x30 SCAR_CUR1
0x34 SCAR_PRG1
0x38 WPSN_CUR1
0x3C WPSN_PRG1
0x40 BOOT_CUR
0x44 BOOT_PRG
0x50 CRCCR1
0x54 CRCSADD1
0x58 CRCEADD1
0x5C CRCDATA
0x60 ECC_FA1
0x104 KEYR2
0x10C CR2
0x110 SR2
0x114 CCR2
0x128 PRAR_CUR2
0x12C PRAR_PRG2
0x130 SCAR_CUR2
0x134 SCAR_PRG2
0x138 WPSN_CUR2
0x13C WPSN_PRG2
0x150 CRCCR2
0x154 CRCSADD2
0x158 CRCEADD2
0x15C CRCDATA2
0x160 ECC_FA2

## FMC_Bank1_R
Base 0x52004000
0x00 BTCR.0
0x04 BTCR.1
0x08 BTCR.2
0x0C BTCR.3
0x10 BTCR.4
0x14 BTCR.5
0x18 BTCR.6
0x1C BTCR.7

## FMC_Bank2_R
Base 0x52004060
0x00 PCR2
0x04 SR2
0x08 PMEM2
0x0C PATT2
0x14 ECCR2

## FMC_Bank3_R
Base 0x52004080
0x00 PCR
  [31:24] MEMHIZ, [31:24] ATTHIZ, [19:17] ECCPS, [23:16] MEMHOLD, [23:16] ATTHOLD, [16:13] TAR, [12:9] TCLR, [15:8] MEMWAIT, [15:8] ATTWAIT, [6] ECCEN, [6] FEMPT, [5] IFEN, [5:4] PWID, [4] ILEN, [3] IREN, [2] PBKEN, [2] IFS, [1] PWAITEN, [1] ILS, [0] IRS, [7:0] MEMSET, [7:0] ATTSET
0x04 SR
0x08 PMEM
0x0C PATT
0x14 ECCR

## FMC_Bank1E_R
Base 0x52004104
0x00 BWTR.0
  [29:28] ACCMOD, [29:28] ACCMOD, [29:28] ACCMOD, [29:28] ACCMOD, [29:28] ACCMOD, [29:28] ACCMOD, [29:28] ACCMOD, [19:16] BUSTURN, [19:16] BUSTURN, [19:16] BUSTURN, [19:16] BUSTURN, [19:16] BUSTURN, [19:16] BUSTURN, [19:16] BUSTURN, [15:8] DATAST, [15:8] DATAST, [15:8] DATAST, [15:8] DATAST, [15:8] DATAST, [15:8] DATAST, [15:8] DATAST, [7:4] ADDHLD, [7:4] ADDHLD, [7:4] ADDHLD, [7:4] ADDHLD, [7:4] ADDHLD, [7:4] ADDHLD, [7:4] ADDHLD, [3:0] ADDSET, [3:0] ADDSET, [3:0] ADDSET, [3:0] ADDSET, [3:0] ADDSET, [3:0] ADDSET, [3:0] ADDSET
0x04 BWTR.1
0x08 BWTR.2
0x0C BWTR.3
0x10 BWTR.4
0x14 BWTR.5
0x18 BWTR.6

## FMC_Bank5_6_R
Base 0x52004140
0x00 SDCR.0
  [27:24] TRCD, [27:24] TRCD, [23:20] TRP, [23:20] TRP, [19:16] TWR, [19:16] TWR, [14] REIE, [14:13] RPIPE, [14:13] RPIPE, [12] RBURST, [12] RBURST, [15:12] TRC, [15:12] TRC, [11:10] SDCLK, [11:10] SDCLK, [9] WP, [9] WP, [21:9] MRD, [11:8] TRAS, [11:8] TRAS, [8:7] CAS, [8:7] CAS, [6] NB, [6] NB, [8:5] NRFS, [5:4] MWID, [5:4] MWID, [7:4] TXSR, [7:4] TXSR, [4] CTB1, [3] CTB2, [4:3] MODES2, [3:2] NR, [3:2] NR, [13:1] COUNT, [2:1] MODES1, [1:0] NC, [1:0] NC, [3:0] TMRD, [3:0] TMRD, [2:0] MODE, [0] CRE, [0] RE
0x04 SDCR.1
0x08 SDTR.0
0x0C SDTR.1
0x10 SDCMR
0x14 SDRTR
0x18 SDSR

## QUADSPI
Base 0x52005000
0x00 CR
  [31] DDRM, [30] DHHC, [28] SIOO, [27:26] FMODE, [31:24] PRESCALER, [25:24] DMODE, [23] PMM, [22] APMS, [20] TOIE, [19] SMIE, [18] FTIE, [22:18] DCYC, [17] TCIE, [16] TEIE, [20:16] FSIZE, [17:16] ABSIZE, [15:14] ABMODE, [13:12] ADSIZE, [11:10] ADMODE, [11:8] FTHRES, [10:8] CSHT, [13:8] FLEVEL, [9:8] IMODE, [7] FSEL, [6] DFM, [5] BUSY, [4] SSHIFT, [4] TOF, [4] CTOF, [3] TCEN, [3] SMF, [3] CSMF, [2] DMAEN, [2] FTF, [1] ABORT, [1] TCF, [1] CTCF, [0] EN, [0] CKMODE, [0] TEF, [0] CTEF, [31:0] DL, [7:0] INSTRUCTION, [31:0] ADDRESS, [31:0] ALTERNATE, [31:0] DATA, [31:0] MASK, [31:0] MATCH, [15:0] INTERVAL, [15:0] TIMEOUT
0x04 DCR
0x08 SR
0x0C FCR
0x10 DLR
0x14 CCR
0x18 AR
0x1C ABR
0x20 DR
0x24 PSMKR
0x28 PSMAR
0x2C PIR
0x30 LPTR
