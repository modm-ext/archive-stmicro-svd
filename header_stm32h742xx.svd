# STM32H742xx register map
File version: 1.0
Registers are 32-bit, access not given, reset 0x0 unless marked. A register's access mark holds for its fields unless they carry their own. Offsets are from the block's base; [hi:lo] are bit positions; {n}, {i} and the like mark numbered series.

## IWDG1
Base 0x58004800
0x00 KR
  [2] WVU, [1] RVU, [15:0] KEY, [2:0] PR, [11:0] RL, [0] PVU, [11:0] WIN
0x04 PR
0x08 RLR
0x0C SR
0x10 WINR

## GPIOA
Base 0x58020000
Same registers: GPIOB 0x58020400, GPIOC 0x58020800, GPIOD 0x58020C00, GPIOE 0x58021000, GPIOF 0x58021400, GPIOG 0x58021800, GPIOH 0x58021C00, GPIOI 0x58022000, GPIOJ 0x58022400, GPIOK 0x58022800
0x00 MODER
  [n+16] BR{n} (n=0..15), [2n+1:2n] MODE{n} (n=0..15), [2n+1:2n] OSPEED{n} (n=0..15), [2n+1:2n] PUPD{n} (n=0..15), [4n+3:4n] AFSEL{n} (n=0..7), [4n-29:4n-32] AFSEL{n} (n=8..15), [16] LCKK, [n] OT{n} (n=0..15), [n] ID{n} (n=0..15), [n] OD{n} (n=0..15), [n] BS{n} (n=0..15), [n] LCK{n} (n=0..15)
0x04 OTYPER
0x08 OSPEEDR
0x0C PUPDR
0x10 IDR
0x14 ODR
0x18 BSRR
0x1C LCKR
0x20 AFR.0
0x24 AFR.1

## PWR
Base 0x58024800
0x00 CR1
  [26] USB33RDY, [2n+15:2n+14] WKUPPUPD{n} (n=1..6), [25] USBREGEN, [24] USB33DEN, [23] TEMPH, [22] TEMPL, [21] VBATH, [20] VBATL, [18] ALS_LEV2, [18:17] ALS_LEV3, [16] AVDEN, [16] AVDO, [16] BRRDY, [15:14] SVOS, [15:14] ACTVOS, [15:14] VOS, [13] ACTVOSRDY, [13] VOSRDY, [n+7] WKUPP{n} (n=1..6), [11] RUN_D3, [9] FLPS, [9] VBRS, [9] CSSF, [8] DBP, [8] VBE, [8] SBF_D2, [7] PLS_LEV4, [7] SBF_D1, [7:6] PLS_LEV6, [6] SBF, [7:5] PLS_LEV7, [5] STOPF, [n-1] WKUPC{n} (n=1..6), [n-1] WKUPF{n} (n=1..6), [n-1] WKUPEN{n} (n=1..6), [4] PVDEN, [4] PVDO, [4] MONEN, [2] SCUEN, [2] PDDS_D3, [1] LDOEN, [1] PDDS_D2, [0] LPDS, [0] BREN, [0] BYPASS, [0] PDDS_D1
0x04 CSR1
0x08 CR2
0x0C CR3
0x10 CPUCR
0x18 D3CR
0x20 WKUPCR
0x24 WKUPFR
0x28 WKUPEPR

## CRC
Base 0x58024C00
0x00 DR
  [7] REV_OUT, [6:5] REV_IN, [4:3] POLYSIZE, [31:0] DR, [31:0] IDR, [0] RESET, [31:0] INIT, [31:0] POL
0x04 IDR
0x08 CR
0x10 INIT
0x14 POL

## BDMA
Base 0x58025400
0x00 ISR
  [4n+3] TEIF{n} (n=0..7), [4n+3] CTEIF{n} (n=0..7), [4n+2] HTIF{n} (n=0..7), [4n+2] CHTIF{n} (n=0..7), [4n+1] TCIF{n} (n=0..7), [4n+1] CTCIF{n} (n=0..7), [4n] GIF{n} (n=0..7), [4n] CGIF{n} (n=0..7), [16] CT, [16] CT, [16] CT, [16] CT, [16] CT, [16] CT, [16] CT, [16] CT, [15] DBM, [15] DBM, [15] DBM, [15] DBM, [15] DBM, [15] DBM, [15] DBM, [15] DBM, [14] MEM2MEM, [14] MEM2MEM, [14] MEM2MEM, [14] MEM2MEM, [14] MEM2MEM, [14] MEM2MEM, [14] MEM2MEM, [14] MEM2MEM, [13:12] PL, [13:12] PL, [13:12] PL, [13:12] PL, [13:12] PL, [13:12] PL, [13:12] PL, [13:12] PL, [11:10] MSIZE, [11:10] MSIZE, [11:10] MSIZE, [11:10] MSIZE, [11:10] MSIZE, [11:10] MSIZE, [11:10] MSIZE, [11:10] MSIZE, [9:8] PSIZE, [9:8] PSIZE, [9:8] PSIZE, [9:8] PSIZE, [9:8] PSIZE, [9:8] PSIZE, [9:8] PSIZE, [9:8] PSIZE, [7] MINC, [7] MINC, [7] MINC, [7] MINC, [7] MINC, [7] MINC, [7] MINC, [7] MINC, [6] PINC, [6] PINC, [6] PINC, [6] PINC, [6] PINC, [6] PINC, [6] PINC, [6] PINC, [5] CIRC, [5] CIRC, [5] CIRC, [5] CIRC, [5] CIRC, [5] CIRC, [5] CIRC, [5] CIRC, [4] DIR, [4] DIR, [4] DIR, [4] DIR, [4] DIR, [4] DIR, [4] DIR, [4] DIR, [3] TEIE, [3] TEIE, [3] TEIE, [3] TEIE, [3] TEIE, [3] TEIE, [3] TEIE, [3] TEIE, [2] HTIE, [2] HTIE, [2] HTIE, [2] HTIE, [2] HTIE, [2] HTIE, [2] HTIE, [2] HTIE, [1] TCIE, [1] TCIE, [1] TCIE, [1] TCIE, [1] TCIE, [1] TCIE, [1] TCIE, [1] TCIE, [0] EN, [15:0] NDT, [31:0] PA, [0] EN, [31:0] MA, [15:0] NDT, [31:0] PA, [31:0] MA, [0] EN, [31:0] MA, [15:0] NDT, [31:0] PA, [31:0] MA, [0] EN, [31:0] MA, [15:0] NDT, [31:0] PA, [31:0] MA, [0] EN, [31:0] MA, [15:0] NDT, [31:0] PA, [31:0] MA, [0] EN, [31:0] MA, [15:0] NDT, [31:0] PA, [31:0] MA, [0] EN, [31:0] MA, [15:0] NDT, [31:0] PA, [31:0] MA, [0] EN, [31:0] MA, [15:0] NDT, [31:0] PA, [31:0] MA, [31:0] MA, [31:0] MA
0x04 IFCR
{0x8+0x14*i} CCR{i} (i=0..7)
{0xC+0x14*i} CNDTR{i} (i=0..7)
{0x14+0x14*i} CPAR{i} (i=0..7)
{0x20+0x14*i} CM0AR{i} (i=0..7)
{0x30+0x14*i} CM1AR{i} (i=0..7)
