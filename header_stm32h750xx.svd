# STM32H750xx register map
File version: 1.0
Registers are 32-bit, access not given, reset 0x0 unless marked. A register's access mark holds for its fields unless they carry their own. Offsets are from the block's base; [hi:lo] are bit positions; {n}, {i} and the like mark numbered series.

## USB1_OTG_HS
Base 0x40040000
Same registers: USB2_OTG_FS 0x40080000
0x00 GOTGCTL
  [31] CTXPKT, [31] AHBIDL, [31] WKUINT, [31] WUIM, [30] FDMOD, [30] DMAREQ, [30] SRQINT, [30] SRQIM, [29] FHMOD, [29] DISCINT, [29] DISCINT, [28] CIDSCHG, [28] CIDSCHGM, [28] ENBESL, [27] LPMINT, [27] LPMINTM, [26] PTXFE, [26] PTXFEM, [25] ULPIIPD, [25] HCINT, [25] HCIM, [27:25] LPMRCNTSTS, [24] PTCI, [24] HPRTINT, [24] PRTIM, [24] SNDLPM, [23] PCCI, [23] RSTDET, [23] RSTDEM, [23] ADPIF, [22] TSDPS, [22] DATAFSUSP, [22] FSUSPM, [21] ULPIEVBUSI, [21] PXFR_INCOMPISOOUT, [21] PXFRM_IISOOXFRM, [21] VBDEN, [23:21] LPMRCNT, [20] OTGVER, [20] ULPIEVBUSD, [20] IISOIXFR, [20] IISOIXFRM, [20] SDEN, [19] BSESVLD, [19] DBCDNE, [19] ULPICSM, [19] OEPINT, [19] OEPINT, [19] PDEN, [18] ASVLD, [18] ADTOCHG, [18] ULPIAR, [18] IEPINT, [18] IEPINT, [18] DCDEN, [17] DBCT, [17] HNGDET, [17] ULPIFSLS, [17] EPMISM, [20:17] PKTSTS, [17] BCDEN, [20:17] LPMCHIDX, [16] CIDSTS, [16] PWRDWN, [16] L1RSMOK, [31:16] PTXFD, [31:16] INEPTXFD, [31:16] INEPTXFD, [31:16] INEPTXFD, [31:16] INEPTXFD, [31:16] INEPTXFD, [31:16] INEPTXFD, [31:16] INEPTXFD, [31:16] INEPTXFD, [31:16] INEPTXFD, [31:16] INEPTXFD, [31:16] INEPTXFD, [31:16] INEPTXFD, [31:16] INEPTXFD, [31:16] INEPTXFD, [31:16] INEPTXFD, [15] PHYLPCS, [15] EOPF, [15] EOPFM, [16:15] DPID, [15] SLPSTS, [14] ISOODRP, [14] ISOODRPM, [13] ENUMDNE, [13] ENUMDNEM, [14:13] LPMRSP, [12] EHEN, [12] USBRST, [12] USBRST, [12] L1DSEN, [11] DHNPEN, [11] USBSUSP, [11] USBSUSPM, [10] HSHNPEN, [13:10] TRDT, [10] ESUSP, [10] ESUSPM, [9] HNPRQ, [9] HNSSCHG, [9] HNPCAP, [8] HNGSCS, [8] SRSSCHG, [8] PTXFELVL, [8] SRPCAP, [11:8] BESLTHRS, [7] BVALOVAL, [7] TXFELVL, [7] BOUTNAKEFF, [7] GONAKEFFM, [7] L1SSEN, [6] BVALOEN, [6] PHYSEL, [10:6] TXFNUM, [6] GINAKEFF, [6] GINAKEFFM, [6] REMWAKE, [5] AVALOVAL, [5] DMAEN, [5] TXFFLSH, [5] NPTXFE, [5] NPTXFEM, [4] AVALOEN, [4] RXFFLSH, [4] RXFLVL, [4] RXFLVLM, [14:4] BCNT, [3] VBVALOVAL, [3] SOF, [3] SOFM, [3] PS2DET, [2] VBVALOEN, [2] SEDET, [2] FCRST, [2] OTGINT, [2] OTGINT, [2] SDET, [5:2] BESL, [1] SRQ, [4:1] HBSTLEN, [1] HSRST, [1] MMIS, [1] MMISM, [1] PDET, [1] LPMACK, [0] SRQSCS, [0] GINT, [2:0] TOCAL, [0] CSRST, [0] CMOD, [3:0] EPNUM, [15:0] RXFD, [0] DCDET, [31:0] PRODUCT_ID, [0] LPMEN, [0] ADPMEN, [15:0] PTXSA, [15:0] INEPTXSA, [15:0] INEPTXSA, [15:0] INEPTXSA, [15:0] INEPTXSA, [15:0] INEPTXSA, [15:0] INEPTXSA, [15:0] INEPTXSA, [15:0] INEPTXSA, [15:0] INEPTXSA, [15:0] INEPTXSA, [15:0] INEPTXSA, [15:0] INEPTXSA, [15:0] INEPTXSA, [15:0] INEPTXSA, [15:0] INEPTXSA
0x04 GOTGINT
0x08 GAHBCFG
0x0C GUSBCFG
0x10 GRSTCTL
0x14 GINTSTS
0x18 GINTMSK
0x1C GRXSTSR
0x20 GRXSTSP
0x24 GRXFSIZ
0x28 DIEPTXF0_HNPTXFSIZ
0x2C HNPTXSTS
0x38 GCCFG
0x3C CID
0x40 GSNPSID
{0x40+4i} GHWCFG{i} (i=1..3)
0x54 GLPMCFG
0x58 GPWRDN
0x5C GDFIFOCFG
0x60 GADPCTL
0x100 HPTXFSIZ
0x104 DIEPTXF.0
0x108 DIEPTXF.1
0x10C DIEPTXF.2
0x110 DIEPTXF.3
0x114 DIEPTXF.4
0x118 DIEPTXF.5
0x11C DIEPTXF.6
0x120 DIEPTXF.7
0x124 DIEPTXF.8
0x128 DIEPTXF.9
0x12C DIEPTXF.10
0x130 DIEPTXF.11
0x134 DIEPTXF.12
0x138 DIEPTXF.13
0x13C DIEPTXF.14

## DCMI
Base 0x48020000
0x00 CR
  [31:24] FEC, [31:24] FEU, [8n+7:8n] BYTE{n} (n=0..3), [20] OELS, [19] LSM, [18] OEBS, [17:16] BSM, [23:16] LEC, [23:16] LEU, [14] ENABLE, [12] CRE, [15:8] LSC, [15:8] LSU, [7] VSPOL, [6] HSPOL, [5] PCKPOL, [4] ESS, [4] LINE_IE, [4] LINE_ISC, [3] JPEG, [3] VSYNC_IE, [3] VSYNC_ISC, [2] CROP, [2] FNE, [2] ERR_IE, [2] ERR_ISC, [1] CM, [1] VSYNC, [1] OVR_IE, [1] OVR_ISC, [0] CAPTURE, [0] HSYNC, [0] FRAME_IE, [0] FRAME_ISC, [7:0] FSC, [7:0] FSU
0x04 SR
0x08 RISR
0x0C IER
0x10 MISR
0x14 ICR
0x18 ESCR
0x1C ESUR
0x20 CWSTRTR
0x24 CWSIZER
0x28 DR

## CRYP
Base 0x48021000
0x00 CR
  [23:20] NPBLB, [19] ALGOMODE_AES_GCM, [17:16] GCM_CCMPH, [15] CRYPEN, [14] FFLUSH, [9:8] KEYSIZE, [7:6] DATATYPE, [5] ALGOMODE_AES_ECB, [4] ALGOMODE_DES_ECB, [4] BUSY, [3] ALGOMODE_TDES_CBC, [3] OFFU, [2] ALGODIR, [2] OFNE, [1] IFNF, [1] DOEN, [1] OUTIM, [1] OUTRIS, [1] OUTMIS, [0] IFEM, [0] DIEN, [0] INIM, [0] INRIS, [0] INMIS
0x04 SR
0x08 DIN
0x0C DOUT
0x10 DMACR
0x14 IMSCR
0x18 RISR
0x1C MISR
{0x20+8i} K{i}LR (i=0..3)
{0x24+8i} K{i}RR (i=0..3)
0x40 IV0LR
0x44 IV0RR
0x48 IV1LR
0x4C IV1RR
{0x50+4i} CSGCMCCM{i}R (i=0..7)
{0x70+4i} CSGCM{i}R (i=0..7)
