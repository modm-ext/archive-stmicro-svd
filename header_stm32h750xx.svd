# STM32H750xx register map
File version: 1.0
Registers are 32-bit, access not given, reset 0x0 unless marked. A register's access mark holds for its fields unless they carry their own. Offsets are from the block's base; [hi:lo] are bit positions; {n}, {i} and the like mark numbered series.

## COMP12
Base 0x58003800
0x00 SR
0x04 ICFR
0x08 OR

## COMP1
Base 0x5800380C
Same registers: COMP2 0x58003810, COMP12_COMMON 0x58003810
0x00 CFGR

## VREFBUF
Base 0x58003C00
0x00 CSR
  [5] VRS_OUT3, [5:4] VRS_OUT4, [3] VRR, [1] HIZ, [0] ENVR, [5:0] TRIM
0x04 CCR

## RTC
Base 0x58004000
0x00 TR
  [31] MSK4, [31] MSK4, [31] ADD1S, [30] WDSEL, [30] WDSEL, [29:28] DT, [29:28] DT, [24] ITSE, [27:24] DU, [27:24] DU, [24] TAMP3MF, [27:24] MASKSS, [27:24] MASKSS, [23] COE, [23] MSK3, [23] MSK3, [23] TAMP3NOERASE, [22] PM, [22] PM, [22] PM, [22] PM, [22] TAMP3IE, [22:21] OSEL, [21] TAMP2MF, [21:20] HT, [23:20] YT, [20] POL, [21:20] HT, [21:20] HT, [21:20] HT, [20] TAMP2NOERASE, [19] COSEL, [19] TAMP2IE, [18] BKP, [18] TAMP1MF, [17] SUB1H, [17] ITSF, [17] TAMP1NOERASE, [19:16] HU, [19:16] YU, [16] ADD1H, [16] RECALPF, [22:16] PREDIV_A, [19:16] HU, [19:16] HU, [19:16] HU, [16] TAMP1IE, [15] TSIE, [15] TAMP3F, [15] MSK2, [15] MSK2, [15] CALP, [15] TAMPPUDIS, [14] WUTIE, [14] TAMP2F, [14] CALW8, [15:13] WDU, [13] ALRBIE, [13] TAMP1F, [15:13] WDU, [13] CALW16, [14:13] TAMPPRCH, [14:12] MNT, [12] MT, [12] ALRAIE, [12] TSOVF, [14:12] MNT, [14:12] MNT, [14:12] MNT, [12] MT, [11] TSE, [11] TSF, [12:11] TAMPFLT, [10] WUTE, [10] WUTF, [9] ALRBE, [9] ALRBF, [11:8] MNU, [11:8] MU, [8] ALRAE, [8] ALRAF, [11:8] MNU, [11:8] MNU, [11:8] MNU, [11:8] MU, [10:8] TAMPFREQ, [7] INIT, [7] MSK1, [7] MSK1, [7] TAMPTS, [6] FMT, [6] INITF, [6] TAMP3TRG, [5] BYPSHAD, [5] RSF, [5] TAMP3E, [6:4] ST, [5:4] DT, [4] REFCKON, [4] INITS, [6:4] ST, [6:4] ST, [6:4] ST, [5:4] DT, [4] TAMP2TRG, [3] TSEDGE, [3] SHPF, [3] TAMP2E, [2] WUTWF, [2] TAMPIE, [1] ALRBWF, [1] TAMP1TRG, [1] OUT_RMP, [3:0] SU, [3:0] DU, [2:0] WUCKSEL, [0] ALRAWF, [14:0] PREDIV_S, [15:0] WUT, [3:0] SU, [3:0] SU, [7:0] KEY, [15:0] SS, [14:0] SUBFS, [3:0] SU, [3:0] DU, [15:0] SS, [8:0] CALM, [0] TAMP1E, [14:0] SS, [14:0] SS, [0] ALARMOUTTYPE
0x04 DR
0x08 CR
0x0C ISR
0x10 PRER
0x14 WUTR
0x1C ALRMAR
0x20 ALRMBR
0x24 WPR
0x28 SSR
0x2C SHIFTR
0x30 TSTR
0x34 TSDR
0x38 TSSSR
0x3C CALR
0x40 TAMPCR
0x44 ALRMASSR
0x48 ALRMBSSR
0x4C OR
{0x50+4i} BKP{i}R (i=0..31)

## IWDG1
Base 0x58004800
0x00 KR
  [2] WVU, [1] RVU, [15:0] KEY, [2:0] PR, [11:0] RL, [0] PVU, [11:0] WIN
0x04 PR
0x08 RLR
0x0C SR
0x10 WINR

## GPIOA
Base 0x58020000
Same registers: GPIOB 0x58020400, GPIOC 0x58020800, GPIOD 0x58020C00, GPIOE 0x58021000, GPIOF 0x58021400, GPIOG 0x58021800, GPIOH 0x58021C00, GPIOI 0x58022000, GPIOJ 0x58022400, GPIOK 0x58022800
0x00 MODER
  [n+16] BR{n} (n=0..15), [2n+1:2n] MODE{n} (n=0..15), [2n+1:2n] OSPEED{n} (n=0..15), [2n+1:2n] PUPD{n} (n=0..15), [4n+3:4n] AFSEL{n} (n=0..7), [4n-29:4n-32] AFSEL{n} (n=8..15), [16] LCKK, [n] OT{n} (n=0..15), [n] ID{n} (n=0..15), [n] OD{n} (n=0..15), [n] BS{n} (n=0..15), [n] LCK{n} (n=0..15)
0x04 OTYPER
0x08 OSPEEDR
0x0C PUPDR
0x10 IDR
0x14 ODR
0x18 BSRR
0x1C LCKR
0x20 AFR.0
0x24 AFR.1

## PWR
Base 0x58024800
0x00 CR1
  [26] USB33RDY, [2n+15:2n+14] WKUPPUPD{n} (n=1..6), [25] USBREGEN, [24] USB33DEN, [23] TEMPH, [22] TEMPL, [21] VBATH, [20] VBATL, [18] ALS_LEV2, [18:17] ALS_LEV3, [16] AVDEN, [16] AVDO, [16] BRRDY, [15:14] SVOS, [15:14] ACTVOS, [15:14] VOS, [13] ACTVOSRDY, [13] VOSRDY, [n+7] WKUPP{n} (n=1..6), [11] RUN_D3, [9] FLPS, [9] VBRS, [9] CSSF, [8] DBP, [8] VBE, [8] SBF_D2, [7] PLS_LEV4, [7] SBF_D1, [7:6] PLS_LEV6, [6] SBF, [7:5] PLS_LEV7, [5] STOPF, [n-1] WKUPC{n} (n=1..6), [n-1] WKUPF{n} (n=1..6), [n-1] WKUPEN{n} (n=1..6), [4] PVDEN, [4] PVDO, [4] MONEN, [2] SCUEN, [2] PDDS_D3, [1] LDOEN, [1] PDDS_D2, [0] LPDS, [0] BREN, [0] BYPASS, [0] PDDS_D1
0x04 CSR1
0x08 CR2
0x0C CR3
0x10 CPUCR
0x18 D3CR
0x20 WKUPCR
0x24 WKUPFR
0x28 WKUPEPR
